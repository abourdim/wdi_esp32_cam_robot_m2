/*
  ESP32-CAM Robot - corrected for the uploaded schematic

  Hardware used by this code (TB6612FNG / SparkFun ROB-14450):
    GPIO12 -> PWMA and PWMB (tied together in the schematic)
    GPIO2  -> AIN1
    GPIO13 -> AIN2
    GPIO15 -> BIN1
    GPIO14 -> BIN2
    STBY   -> +5V (hard-wired enabled)
    GPIO4  -> LED

  Because PWMA and PWMB share GPIO12, the firmware holds that common enable
  high and applies PWM to the direction inputs. This keeps independent speed
  control for Motor A and Motor B without changing the PCB. Motor A/J6 is
  treated as left and Motor B/J7 as right.

  Motor experimentation controls:
    - Independent left and right motor sliders.
    - Full PWM range: 0-255 for each motor.
    - Optional motor sync checkbox.
    - Exact -1 / +1 PWM adjustment buttons.
    - Sliders update the motors live while driving.
    - Short 255 PWM kick when a motor starts from zero.

  Network fallback:
    - Try configured Wi-Fi for 10 seconds.
    - If unavailable, start ESP32-Robot-XXXX access point.
    - Fallback AP password: 88888888
    - Fallback page: http://192.168.4.1
    - AP remains available while STA periodically retries normal Wi-Fi.

  Browser OTA:
    - OTA password: 88888888
    - Upload an exported Arduino .bin from the debug sidebar.
    - Motors are stopped before writing firmware.
    - Requires an OTA-capable partition scheme flashed once by USB.

  USB/UART0 serial console:
    - 115200 baud, 8N1.
    - ESP32 U0T / GPIO1 -> USB-TTL RX.
    - ESP32 U0R / GPIO3 <- USB-TTL TX.
    - Common GND. Use 3.3V TTL signalling, not RS-232 voltage levels.
    - Commands: help, status, log, camera, stop.

  Camera settings sidebar:
    - Resolution, display rotation (0/90/180/270), JPEG quality,
      brightness, contrast, saturation, vertical flip, horizontal mirror,
      and reset-to-defaults.
    - 90/270 rotation is browser-side to avoid expensive JPEG re-encoding.
*/

#include "esp_camera.h"
#include <WiFi.h>
#include "esp_timer.h"
#include "img_converters.h"
#include "Arduino.h"
#include "fb_gfx.h"
#include "soc/soc.h"
#include "soc/rtc_cntl_reg.h"
#include "esp_http_server.h"
#include "esp_wifi.h"
#include <Preferences.h>
#include <Update.h>

// Gzipped copy of the INDEX_HTML literal further down this file,
// generated by tools/gzip_ui.py. Re-run that tool after editing the UI.
#include "index_html_gz.h"

// Existing Wi-Fi configuration from your original sketch
// Compiled-in defaults. They are only used the first time: once a network is
// chosen in Settings the pair is stored in NVS and these are ignored, so a
// robot can move between a workshop and a classroom without being reflashed.
static const char *DEFAULT_SSID = "free_gazza";
static const char *DEFAULT_PASSWORD = "err_Safia080707";

static char ssid[33] = "free_gazza";
static char password[65] = "err_Safia080707";

// Set by the Wi-Fi handler and acted on in loop(), rather than inside the
// request: joining a network moves the radio off the AP's channel, which
// would kill the very connection the reply has to travel over.
static volatile bool wifiApplyRequested = false;

// Wi-Fi fallback configuration
// If the configured Wi-Fi cannot be reached within 10 seconds, the robot
// creates its own access point. Connect directly to it and open 192.168.4.1.
static const char *FALLBACK_AP_PASSWORD = "88888888";
static const uint32_t WIFI_CONNECT_TIMEOUT_MS = 10000;
static const uint32_t WIFI_RETRY_INTERVAL_MS = 30000;
// Retries back off up to this, so a robot left on a network that is not
// coming back stops scanning every 30 seconds and filling the event log.
static const uint32_t WIFI_RETRY_MAX_INTERVAL_MS = 300000;

// Motion safety
// Every motion command refreshes a deadline, and a held direction button in
// the web UI repeats its command well inside it. If nothing arrives for this
// long the motors stop on their own. Without it a single lost "stop" -- one
// dropped packet on a wobbling Wi-Fi link, a closed laptop lid, a browser
// that never fired the release event -- leaves a wheel turning until some
// later command happens to get through.
static const uint32_t MOTION_TIMEOUT_MS = 600;

// Saved settings
// Camera tuning, motor speeds and LED brightness belong to the robot, not to
// whichever browser last connected: two viewers would otherwise restore two
// different sets of values and fight over them. They live in NVS and come
// back at boot.
//
// Writes wait for the sliders to settle. The camera and motor controls send
// on every input event, and committing flash at that rate would be hundreds
// of writes for one drag of a slider.
static Preferences settingsStore;
static const char *SETTINGS_NAMESPACE = "robot";
static const uint32_t SETTINGS_SAVE_DELAY_MS = 4000;

static bool settingsDirty = false;
static unsigned long settingsChangedMs = 0;

// A name the class gives the robot. Eight identical boards in a room are
// only telling apart by this and the fallback AP suffix.
static char robotName[33] = "ESP32-CAM Robot";

static void noteSettingsChanged() {
  settingsDirty = true;
  settingsChangedMs = millis();
}

// Browser OTA firmware update
// NOTE: The board must be flashed once by USB using an OTA-capable partition
// scheme (for example "Minimal SPIFFS (1.9MB APP with OTA/190KB SPIFFS)").
static const char *OTA_PASSWORD = "88888888";
volatile bool otaInProgress = false;

char fallbackApSsid[32] = "";
bool fallbackApActive = false;
unsigned long lastWiFiRetryMs = 0;
static uint32_t wifiRetryIntervalMs = WIFI_RETRY_INTERVAL_MS;
static bool wifiRetryPaused = false;
wl_status_t previousStaStatus = WL_IDLE_STATUS;

// Camera pins
#define PWDN_GPIO_NUM 32
#define RESET_GPIO_NUM -1
#define XCLK_GPIO_NUM 0
#define SIOD_GPIO_NUM 26
#define SIOC_GPIO_NUM 27

#define Y9_GPIO_NUM 35
#define Y8_GPIO_NUM 34
#define Y7_GPIO_NUM 39
#define Y6_GPIO_NUM 36
#define Y5_GPIO_NUM 21
#define Y4_GPIO_NUM 19
#define Y3_GPIO_NUM 18
#define Y2_GPIO_NUM 5
#define VSYNC_GPIO_NUM 25
#define HREF_GPIO_NUM 23
#define PCLK_GPIO_NUM 22

// TB6612FNG / SparkFun ROB-14450 motor driver pins, matching the schematic.
// PWMA and PWMB are physically tied together to GPIO12, so this firmware
// holds the shared PWM enable high and PWM-modulates the input pins instead.
#define TB6612_PWM_AB_PIN 12
#define MOTOR_A_IN1_PIN 2
#define MOTOR_A_IN2_PIN 13
#define MOTOR_B_IN1_PIN 15
#define MOTOR_B_IN2_PIN 14

// Motor A (J6 / AO1-AO2) is treated as LEFT; Motor B (J7 / BO1-BO2) as RIGHT.
#define MOTOR_L_IN1_PIN MOTOR_A_IN1_PIN
#define MOTOR_L_IN2_PIN MOTOR_A_IN2_PIN
#define MOTOR_R_IN1_PIN MOTOR_B_IN1_PIN
#define MOTOR_R_IN2_PIN MOTOR_B_IN2_PIN

// LED pin
#define LED_GPIO_NUM 4

// Flash LED brightness control
static const int LED_MIN_PWM = 0;
static const int LED_MAX_PWM = 255;
volatile int ledBrightness = 255;
volatile bool ledEnabled = false;

// The flash LED runs on its own 12-bit LEDC channel instead of going through
// analogWrite(). At 8-bit, half a percent of full scale is a single step, so a
// dim pulse becomes an on/off stutter with no fade at all; 12 bits puts ~20
// levels in that same span, which is enough to look smooth. The motors keep
// using analogWrite at 8-bit on the TB6612 input pins -- only this LED pin
// uses the explicit 12-bit channel below.
//
// Channel and timer are pinned explicitly rather than letting the HAL allocate,
// because the camera driver holds LEDC_CHANNEL_0 / LEDC_TIMER_0 and a silent
// collision there is not something to discover on the bench. Channel 7 maps to
// timer 3.
static const uint8_t LED_LEDC_CHANNEL = 7;
static const uint8_t LED_LEDC_BITS = 12;
static const uint32_t LED_LEDC_FREQ_HZ = 5000;
static const int LED_LEDC_MAX = (1 << LED_LEDC_BITS) - 1;  // 4095

// Boot indicator: three short flashes. GPIO4 is the module's own flash LED and
// is painful to look at near full scale, which matters for something that
// fires on every boot.
static const float LED_BOOT_BLINK_PERCENT = 5.0f;
static const int LED_BOOT_BLINK_COUNT = 3;
static const int LED_BOOT_BLINK_MS = 120;

// Heartbeat: one short pulse, repeated. The gap between pulses is what carries
// the meaning -- a pulse a second when the configured Wi-Fi is joined, one
// every five seconds when it is not (fallback AP, or still retrying). Rate
// alone was a bad indicator: 1s against 3s of the same shape meant timing it
// by eye. A pulse against four and a half seconds of dark does not.
//
// Peak is a percentage of full scale, deliberately, so it can be tuned in one
// place without thinking about bit depth.
static const float LED_HEARTBEAT_PEAK_PERCENT = 0.5f;
static const uint32_t LED_HEARTBEAT_PULSE_MS = 450;
static const uint32_t LED_HEARTBEAT_INTERVAL_LINKED_MS = 1000;
static const uint32_t LED_HEARTBEAT_INTERVAL_UNLINKED_MS = 5000;

// UART0 / USB-TTL console pins
#define SERIAL_RX_PIN 3   // U0R
#define SERIAL_TX_PIN 1   // U0T
static const uint32_t SERIAL_BAUD = 115200;

// Camera orientation
bool Video_Flip = false;
bool cameraHasPsram = false;

// Motor control
// Full 8-bit PWM range is intentionally exposed for experimentation.
static const int MIN_PWM = 0;
static const int MAX_PWM = 255;

// Teacher's ceiling on motor PWM. Enforced here rather than in the browser,
// so it holds however the command arrives.
static int maxMotorPWM = MAX_PWM;

// Measured starting PWM of each motor, 0 when nobody has looked yet.
static int leftThreshold = 0;
static int rightThreshold = 0;

static const int START_KICK_MS = 120;  // brief boost when starting a motor from rest
// Wheels are let go before they are asked to turn the other way. Slamming a
// loaded geared motor from full speed into the opposite direction punishes
// the gearbox and drags a current spike through a supply that already
// brownout-resets this board.
static const int DIRECTION_CHANGE_PAUSE_MS = 60;

volatile int leftMotorSpeed = 220;
volatile int rightMotorSpeed = 220;

int currentLeftPWM = 0;
int currentRightPWM = 0;
// Which way the last write drove the wheels, so a reversal can be spotted.
bool currentReverse = false;

enum MotionState {
  MOTION_STOPPED,
  MOTION_FORWARD,
  MOTION_BACKWARD,
  MOTION_LEFT,
  MOTION_RIGHT
};

volatile MotionState motionState = MOTION_STOPPED;

// Browser debug/status panel
// Keep a short history on the ESP32 itself so quick button presses are not
// lost between browser polls.
#define DEBUG_EVENT_COUNT 64
#define DEBUG_EVENT_TEXT_LEN 80

struct DebugEvent {
  uint32_t id;
  uint32_t timeMs;
  char message[DEBUG_EVENT_TEXT_LEN];
};

char lastDebugMessage[128] = "Robot started";
DebugEvent debugEvents[DEBUG_EVENT_COUNT];
uint8_t debugEventHead = 0;   // next slot to write
uint8_t debugEventSize = 0;   // number of valid entries
uint32_t debugEventSequence = 0;
portMUX_TYPE debugMux = portMUX_INITIALIZER_UNLOCKED;

static const char *motionName(MotionState state) {
  switch (state) {
    case MOTION_FORWARD: return "FORWARD";
    case MOTION_BACKWARD: return "BACKWARD";
    case MOTION_LEFT:    return "LEFT";
    case MOTION_RIGHT:   return "RIGHT";
    case MOTION_STOPPED:
    default:             return "STOPPED";
  }
}

static void setDebugMessage(const char *message) {
  uint32_t now = millis();

  portENTER_CRITICAL(&debugMux);

  strncpy(lastDebugMessage, message, sizeof(lastDebugMessage) - 1);
  lastDebugMessage[sizeof(lastDebugMessage) - 1] = '\0';

  DebugEvent &event = debugEvents[debugEventHead];
  event.id = ++debugEventSequence;
  event.timeMs = now;
  strncpy(event.message, message, DEBUG_EVENT_TEXT_LEN - 1);
  event.message[DEBUG_EVENT_TEXT_LEN - 1] = '\0';

  debugEventHead = (debugEventHead + 1) % DEBUG_EVENT_COUNT;
  if (debugEventSize < DEBUG_EVENT_COUNT) {
    debugEventSize++;
  }

  portEXIT_CRITICAL(&debugMux);

  Serial.println(message);
}

static const char *networkModeName() {
  if (fallbackApActive) {
    if (WiFi.status() == WL_CONNECTED) return "AP+STA";
    return "AP";
  }

  if (WiFi.status() == WL_CONNECTED) return "STA";
  return "OFFLINE";
}

static const char *wifiStatusName(wl_status_t status) {
  switch (status) {
    case WL_IDLE_STATUS:
      return "idle / connecting";

    case WL_NO_SSID_AVAIL:
      return "SSID not found";

    case WL_SCAN_COMPLETED:
      return "scan completed";

    case WL_CONNECTED:
      return "connected";

    case WL_CONNECT_FAILED:
      return "connection/authentication failed";

    case WL_CONNECTION_LOST:
      return "connection lost";

    case WL_DISCONNECTED:
      return "disconnected";

    default:
      return "unknown";
  }
}

static void logWiFiStatus(const char *prefix, wl_status_t status) {
  char dbg[144];

  snprintf(
    dbg,
    sizeof(dbg),
    "%s: %s (code %d)",
    prefix,
    wifiStatusName(status),
    (int)status
  );

  setDebugMessage(dbg);
}

static void makeFallbackApName() {
  // Use the last 4 hex digits of the ESP32 eFuse MAC so multiple classroom
  // robots get distinct SSIDs, for example ESP32-Robot-57AC.
  //
  // ESP.getEfuseMac() packs the six MAC bytes little-endian, so mac[0] -- the
  // first byte of the vendor OUI -- lands in the LOW bits of the value.
  // Masking 0xFFFF therefore named the board after Espressif rather than
  // after itself: every ESP32-CAM sharing an OUI came up as the same
  // ESP32-Robot-AA8C, which is precisely the collision this is meant to
  // avoid. The half of the address that is unique per board is at the top.
  uint64_t chipId = ESP.getEfuseMac();
  uint8_t macByte4 = (uint8_t)((chipId >> 32) & 0xFF);
  uint8_t macByte5 = (uint8_t)((chipId >> 40) & 0xFF);

  snprintf(
    fallbackApSsid,
    sizeof(fallbackApSsid),
    "ESP32-Robot-%02X%02X",
    macByte4,
    macByte5
  );
}

static bool startFallbackAccessPoint() {
  makeFallbackApName();

  // Stop the timed-out STA association before enabling the fallback AP.  A
  // still-running Wi-Fi scan/association can keep moving the shared radio
  // between channels and make the AP answer ICMP while TCP connections time
  // out.  Keep AP+STA capability enabled, but leave STA idle until the retry
  // service decides it is safe to try again.
  WiFi.disconnect(false, false);
  delay(100);

  WiFi.mode(WIFI_AP_STA);
  // Changing mode resets the power-save setting, so re-apply it here too.
  WiFi.setSleep(false);

  bool ok = WiFi.softAP(fallbackApSsid, FALLBACK_AP_PASSWORD);
  fallbackApActive = ok;

  if (!ok) {
    setDebugMessage("ERROR: Could not start fallback access point");
    return false;
  }

  char dbg[128];

  snprintf(
    dbg,
    sizeof(dbg),
    "BOOT: Fallback AP started; SSID %s from base MAC %s",
    fallbackApSsid,
    WiFi.macAddress().c_str()
  );
  setDebugMessage(dbg);

  IPAddress apIp = WiFi.softAPIP();
  snprintf(
    dbg,
    sizeof(dbg),
    "BOOT: Fallback AP IP %u.%u.%u.%u",
    apIp[0], apIp[1], apIp[2], apIp[3]
  );
  setDebugMessage(dbg);

  // Do not call WiFi.begin() here.  The initial attempt has just timed out and
  // immediately starting a second association is exactly when users connect
  // to 192.168.4.1.  serviceWiFiFallback() will retry later, and pauses those
  // retries whenever an AP client is present.
  lastWiFiRetryMs = millis();
  wifiRetryIntervalMs = WIFI_RETRY_INTERVAL_MS;
  wifiRetryPaused = false;

  return true;
}

static void serviceWiFiFallback() {
  if (!fallbackApActive) return;

  wl_status_t currentStatus = WiFi.status();

  // Log only state changes so the event history remains readable.
  if (currentStatus != previousStaStatus) {
    if (currentStatus == WL_CONNECTED) {
      IPAddress ip = WiFi.localIP();
      char dbg[144];

      snprintf(
        dbg,
        sizeof(dbg),
        "NET: Configured Wi-Fi connected; IP %u.%u.%u.%u; fallback AP remains available",
        ip[0], ip[1], ip[2], ip[3]
      );
      setDebugMessage(dbg);
    } else {
      if (previousStaStatus == WL_CONNECTED) {
        setDebugMessage(
          "NET: Configured Wi-Fi connection lost; fallback AP remains available"
        );
      }

      logWiFiStatus("NET: Station status", currentStatus);
    }

    previousStaStatus = currentStatus;
  }

  if (currentStatus == WL_CONNECTED) {
    // Back on the configured network. Start from the short interval again if
    // it is ever lost.
    wifiRetryIntervalMs = WIFI_RETRY_INTERVAL_MS;
    wifiRetryPaused = false;
    return;
  }

  // The AP and the station share one radio and one channel, and the station
  // is the one that picks it. Reconnecting means a scan and an association,
  // which stalls AP traffic for a second or two and can throw AP clients off
  // altogether -- it was cutting the video and swallowing motor commands
  // every 30 seconds. Someone driving the robot over the fallback AP is
  // exactly who should not be interrupted to go looking for another network.
  if (WiFi.softAPgetStationNum() > 0) {
    if (!wifiRetryPaused) {
      wifiRetryPaused = true;
      setDebugMessage(
        "NET: Wi-Fi retry paused while the fallback AP is in use"
      );
    }

    // Hold the deadline open, or the retry fires the instant the last client
    // leaves rather than after a full interval.
    lastWiFiRetryMs = millis();
    return;
  }

  if (wifiRetryPaused) {
    wifiRetryPaused = false;

    // Start from the short interval again. Someone who disconnects from the
    // fallback AP to let the robot rejoin the normal network should not have
    // to wait out a five-minute backoff earned before they arrived.
    wifiRetryIntervalMs = WIFI_RETRY_INTERVAL_MS;

    setDebugMessage("NET: Fallback AP idle; resuming Wi-Fi retries");
  }

  // Periodically retry the configured Wi-Fi while preserving the AP.
  if (millis() - lastWiFiRetryMs >= wifiRetryIntervalMs) {
    lastWiFiRetryMs = millis();

    wifiRetryIntervalMs *= 2;
    if (wifiRetryIntervalMs > WIFI_RETRY_MAX_INTERVAL_MS) {
      wifiRetryIntervalMs = WIFI_RETRY_MAX_INTERVAL_MS;
    }

    char dbg[160];
    snprintf(
      dbg,
      sizeof(dbg),
      "NET: Retrying configured Wi-Fi; previous status: %s; next in %lus",
      wifiStatusName(currentStatus),
      (unsigned long)(wifiRetryIntervalMs / 1000)
    );
    setDebugMessage(dbg);

    WiFi.reconnect();
  }
}

#define PART_BOUNDARY "123456789000000000000987654321"
static const char *_STREAM_CONTENT_TYPE =
    "multipart/x-mixed-replace;boundary=" PART_BOUNDARY;
// Boundary and part header live in one format string so each frame costs one
// header write plus one payload write, instead of three separate chunks.
static const char *_STREAM_PART =
    "\r\n--" PART_BOUNDARY "\r\n"
    "Content-Type: image/jpeg\r\n"
    "Content-Length: %u\r\n\r\n";

httpd_handle_t camera_httpd = NULL;
httpd_handle_t stream_httpd = NULL;

// The stream handler owns its server worker for as long as the connection
// lasts, so only one viewer can be served at a time. A second browser used to
// hang on a socket that never produced a byte; now it is told to go away.
static volatile bool streamClientActive = false;

// Measured frame rate of the live stream, in tenths of a frame per second, so
// the debug panel can show whether the video is actually keeping up.
static volatile uint32_t streamFps10 = 0;

// How many streams have ended since boot. A viewer coming and going is
// normal; a number that climbs on its own is a link that keeps dropping.
static volatile uint32_t streamDropCount = 0;

bool startCameraServer();
static void checkIndexGzAsset();

static int clampMotorPWM(int value) {
  if (value < MIN_PWM) return MIN_PWM;
  if (value > maxMotorPWM) return maxMotorPWM;
  return value;
}

static int clampLedPWM(int value) {
  if (value < LED_MIN_PWM) return LED_MIN_PWM;
  if (value > LED_MAX_PWM) return LED_MAX_PWM;
  return value;
}

// Percentages of full scale, so brightness can be tuned without anyone having
// to know the channel is 12-bit.
static int ledDutyFromPercent(float percent) {
  if (percent <= 0.0f) return 0;
  if (percent >= 100.0f) return LED_LEDC_MAX;
  return (int)lroundf((percent / 100.0f) * (float)LED_LEDC_MAX);
}

static void applyLedOutput() {
  int output = ledEnabled ? clampLedPWM(ledBrightness) : 0;
  // The UI still speaks 0-255; scale it onto the 12-bit channel the LED runs
  // on now. Rounded rather than shifted so 255 lands exactly on full scale.
  ledcWrite(LED_LEDC_CHANNEL, (int)lroundf((float)output * (float)LED_LEDC_MAX / (float)LED_MAX_PWM));
}

// Non-blocking status pulse; called every pass of loop().
//
// Yields the LED completely whenever the flash is switched on from the UI.
// Someone who turned the light on wants light, not a status indicator winking
// underneath their hand -- and applyLedOutput() has already written their
// value, so returning here leaves it exactly as they set it. When they switch
// it off again the pulse simply resumes on the next pass; no state to track.
// "Linked" means somebody can reach the robot, by whichever route -- not that
// it reached one particular router.
//
// Checking WL_CONNECTED alone was wrong for how this robot is actually used:
// when the configured Wi-Fi is out of range or the credentials are off, it
// falls back to its own AP, you connect your phone to that, and you drive it
// perfectly well. Reporting "disconnected" through all of that is reporting on
// the robot's disappointment rather than on anything the person holding the
// phone cares about. On this build the fallback is the normal case, not the
// exception.
//
// So the slow pulse now means what it should: nobody is there.
// Signal strength of whichever link the browser is actually using. In station
// mode that is WiFi.RSSI(); on the fallback AP the station RSSI is meaningless
// and the useful number is how well the AP hears its client -- which is what
// tells a driver they are running out of range.
static bool currentLinkRssi(long *rssi) {
  if (!rssi) return false;

  if (WiFi.status() == WL_CONNECTED) {
    *rssi = (long)WiFi.RSSI();
    return true;
  }

  wifi_sta_list_t stations;

  if (esp_wifi_ap_get_sta_list(&stations) != ESP_OK || stations.num == 0) {
    return false;
  }

  // Strongest client: with one viewer that is the viewer, and with several it
  // is the most optimistic reading rather than a misleading worst case.
  int best = -127;

  for (int i = 0; i < stations.num; i++) {
    if (stations.sta[i].rssi > best) best = stations.sta[i].rssi;
  }

  *rssi = (long)best;
  return true;
}

static bool robotIsLinked() {
  if (WiFi.status() == WL_CONNECTED) return true;
  return WiFi.softAPgetStationNum() > 0;
}

static void serviceHeartbeat() {
  if (ledEnabled) return;

  const uint32_t interval = robotIsLinked()
                              ? LED_HEARTBEAT_INTERVAL_LINKED_MS
                              : LED_HEARTBEAT_INTERVAL_UNLINKED_MS;

  // One fixed-length pulse per interval, then dark for the remainder. Fixing
  // the pulse width rather than stretching it to fill the interval is the
  // whole point: at five seconds a stretched shape is a barely-moving glow,
  // where a 450ms pulse followed by four and a half seconds of nothing is
  // unmistakable at a glance.
  const uint32_t t = millis() % interval;
  int duty = 0;
  if (t < LED_HEARTBEAT_PULSE_MS) {
    // Raised cosine: eases in and out of both ends and starts and finishes at
    // exactly zero, so the pulse breathes rather than ticking on and off.
    const float phase = (float)t / (float)LED_HEARTBEAT_PULSE_MS;
    float shape = (1.0f - cosf(2.0f * (float)PI * phase)) * 0.5f;  // 0.0 .. 1.0
    // Squared for gamma. Perceived brightness is nothing like duty cycle down
    // here -- a linear ramp appears to leap off zero and then stall near the
    // top. Squaring spends more of the ramp in the dim end, where the eye is
    // actually looking.
    shape *= shape;
    duty = (int)lroundf(shape * (float)ledDutyFromPercent(LED_HEARTBEAT_PEAK_PERCENT));
  }
  ledcWrite(LED_LEDC_CHANNEL, duty);
}

static void writeTb6612(int in1Pin, int in2Pin, int pwm, bool reverse) {
  pwm = clampMotorPWM(pwm);

  // Shared PWMA/PWMB is held high, so direction is chosen by which of the two
  // direction inputs carries the PWM: IN1 drives the wheel forward, IN2
  // drives it back. Each motor keeps independent speed even though both
  // TB6612 PWM-enable inputs are tied to GPIO12 in the schematic.
  const int drivePin = reverse ? in2Pin : in1Pin;
  const int idlePin = reverse ? in1Pin : in2Pin;

  // Both pins go through analogWrite deliberately. Reverse attaches LEDC to
  // the IN2 pins as well, and once the GPIO matrix is driving a pin from
  // LEDC a later digitalWrite on it never reaches the output -- the wheel
  // would keep turning with no visible reason why. Idle pin first, so the
  // pair is never momentarily both-high, which is the TB6612's brake state.
  analogWrite(idlePin, 0);
  analogWrite(drivePin, pwm);
}

static void writeMotors(int leftPWM, int rightPWM, bool reverse) {
  leftPWM = clampMotorPWM(leftPWM);
  rightPWM = clampMotorPWM(rightPWM);

  // Turning wheels are stopped before they are asked to run the other way.
  // Stopping also zeroes the PWM state below, so the new direction starts
  // from rest and earns its stiction kick.
  if (reverse != currentReverse &&
      (currentLeftPWM > 0 || currentRightPWM > 0)) {
    stopMotors();
    delay(DIRECTION_CHANGE_PAUSE_MS);
  }

  // A motor that starts from zero gets a short full-power kick.
  // The exact requested PWM (0..255) is applied immediately afterward.
  bool kickLeft = (currentLeftPWM == 0 && leftPWM > 0);
  bool kickRight = (currentRightPWM == 0 && rightPWM > 0);

  if (kickLeft || kickRight) {
    writeTb6612(MOTOR_L_IN1_PIN, MOTOR_L_IN2_PIN,
                kickLeft ? maxMotorPWM : leftPWM, reverse);
    writeTb6612(MOTOR_R_IN1_PIN, MOTOR_R_IN2_PIN,
                kickRight ? maxMotorPWM : rightPWM, reverse);
    delay(START_KICK_MS);
  }

  writeTb6612(MOTOR_L_IN1_PIN, MOTOR_L_IN2_PIN, leftPWM, reverse);
  writeTb6612(MOTOR_R_IN1_PIN, MOTOR_R_IN2_PIN, rightPWM, reverse);

  currentLeftPWM = leftPWM;
  currentRightPWM = rightPWM;
  currentReverse = reverse;
}

static void stopMotors() {
  // TB6612 stop state: both direction inputs idle. PWMA/PWMB remain enabled.
  // analogWrite on all four, not digitalWrite: the IN2 pins are LEDC-driven
  // once reverse has been used, and a digitalWrite would not reach them.
  analogWrite(MOTOR_L_IN1_PIN, 0);
  analogWrite(MOTOR_L_IN2_PIN, 0);
  analogWrite(MOTOR_R_IN1_PIN, 0);
  analogWrite(MOTOR_R_IN2_PIN, 0);
  currentLeftPWM = 0;
  currentRightPWM = 0;
}

static void applyMotion() {
  int leftNow = leftMotorSpeed;
  int rightNow = rightMotorSpeed;

  switch (motionState) {
    case MOTION_FORWARD:
      writeMotors(leftNow, rightNow, false);
      break;

    case MOTION_BACKWARD:
      writeMotors(leftNow, rightNow, true);
      break;

    case MOTION_LEFT:
      writeMotors(0, rightNow, false);
      break;

    case MOTION_RIGHT:
      writeMotors(leftNow, 0, false);
      break;

    case MOTION_STOPPED:
    default:
      stopMotors();
      break;
  }
}

// millis() of the last motion command from the browser.
static volatile uint32_t lastMotionCommandMs = 0;

// How many times the dead man's switch has fired. The browser watches this so
// it can say why the robot stopped, rather than leaving it a mystery.
static volatile uint32_t motionTimeoutCount = 0;

static void noteMotionCommand() {
  lastMotionCommandMs = millis();
}

static void moveForward() {
  noteMotionCommand();
  motionState = MOTION_FORWARD;
  applyMotion();
}

static void moveBackward() {
  noteMotionCommand();
  motionState = MOTION_BACKWARD;
  applyMotion();
}

static void turnLeft() {
  noteMotionCommand();
  motionState = MOTION_LEFT;
  applyMotion();
}

static void turnRight() {
  noteMotionCommand();
  motionState = MOTION_RIGHT;
  applyMotion();
}

static void commandStop() {
  motionState = MOTION_STOPPED;
  stopMotors();
}

// Joining the chosen network. Called from loop() so the reply to the request
// that asked for it is already sent and gone.
static void serviceWifiApply() {
  if (!wifiApplyRequested) return;
  wifiApplyRequested = false;

  char dbg[96];
  snprintf(dbg, sizeof(dbg), "NET: Connecting to %s", ssid);
  setDebugMessage(dbg);

  // Keep the access point up throughout, so a failed attempt cannot strand
  // anyone outside the robot.
  if (!fallbackApActive) {
    WiFi.mode(WIFI_AP_STA);
    WiFi.setSleep(false);
    startFallbackAccessPoint();
  }

  WiFi.disconnect();
  delay(100);
  WiFi.begin(ssid, password);

  lastWiFiRetryMs = millis();
  wifiRetryIntervalMs = WIFI_RETRY_INTERVAL_MS;

  // The person asked for this one, so it is not subject to the rule that
  // pauses retries while somebody is using the AP.
  wifiRetryPaused = false;
}

// The dead man's switch. Nothing the browser, the network, or the person
// holding the phone can do should be able to leave a motor running.
static void serviceMotionTimeout() {
  if (motionState == MOTION_STOPPED) return;
  if (millis() - lastMotionCommandMs < MOTION_TIMEOUT_MS) return;

  motionTimeoutCount++;
  setDebugMessage("SAFETY: motion timeout; motors stopped");
  commandStop();
}

static const char *frameSizeName(framesize_t frameSize) {
  switch (frameSize) {
    case FRAMESIZE_QQVGA: return "QQVGA";
    case FRAMESIZE_QVGA:  return "QVGA";
    case FRAMESIZE_VGA:   return "VGA";
    case FRAMESIZE_SVGA:  return "SVGA";
    case FRAMESIZE_XGA:   return "XGA";
    case FRAMESIZE_SXGA:  return "SXGA";
    case FRAMESIZE_UXGA:  return "UXGA";
    default:               return "UNKNOWN";
  }
}

static bool parseFrameSize(const char *name, framesize_t *frameSize) {
  if (!name || !frameSize) return false;

  if (strcmp(name, "QQVGA") == 0) {
    *frameSize = FRAMESIZE_QQVGA;
  } else if (strcmp(name, "QVGA") == 0) {
    *frameSize = FRAMESIZE_QVGA;
  } else if (strcmp(name, "VGA") == 0) {
    *frameSize = FRAMESIZE_VGA;
  } else if (strcmp(name, "SVGA") == 0) {
    *frameSize = FRAMESIZE_SVGA;
  } else if (strcmp(name, "XGA") == 0) {
    *frameSize = FRAMESIZE_XGA;
  } else if (strcmp(name, "SXGA") == 0) {
    *frameSize = FRAMESIZE_SXGA;
  } else if (strcmp(name, "UXGA") == 0) {
    *frameSize = FRAMESIZE_UXGA;
  } else {
    return false;
  }

  return true;
}

static bool frameSizeNeedsPsram(framesize_t frameSize) {
  return frameSize == FRAMESIZE_SVGA ||
         frameSize == FRAMESIZE_XGA ||
         frameSize == FRAMESIZE_SXGA ||
         frameSize == FRAMESIZE_UXGA;
}

// Writes every saved setting in one pass. NVS skips a write when the stored
// value already matches, so an unchanged field costs nothing.
static void saveSettings() {
  sensor_t *sensor = esp_camera_sensor_get();

  if (!settingsStore.begin(SETTINGS_NAMESPACE, false)) {
    setDebugMessage("WARN: Could not open settings storage");
    return;
  }

  settingsStore.putString("name", robotName);
  settingsStore.putString("wifiSsid", ssid);
  settingsStore.putString("wifiPass", password);
  settingsStore.putInt("maxPwm", maxMotorPWM);
  settingsStore.putInt("leftThresh", leftThreshold);
  settingsStore.putInt("rightThresh", rightThreshold);
  settingsStore.putInt("leftSpeed", leftMotorSpeed);
  settingsStore.putInt("rightSpeed", rightMotorSpeed);
  settingsStore.putInt("ledBright", ledBrightness);
  settingsStore.putBool("ledOn", ledEnabled);

  if (sensor) {
    settingsStore.putInt("frameSize", (int)sensor->status.framesize);
    settingsStore.putInt("quality", (int)sensor->status.quality);
    settingsStore.putInt("brightness", (int)sensor->status.brightness);
    settingsStore.putInt("contrast", (int)sensor->status.contrast);
    settingsStore.putInt("saturation", (int)sensor->status.saturation);
    settingsStore.putBool("vflip", sensor->status.vflip != 0);
    settingsStore.putBool("hmirror", sensor->status.hmirror != 0);
  }

  settingsStore.end();
  setDebugMessage("SETTINGS: Saved to flash");
}

static void serviceSettingsSave() {
  if (!settingsDirty) return;
  if (millis() - settingsChangedMs < SETTINGS_SAVE_DELAY_MS) return;

  settingsDirty = false;
  saveSettings();
}

// Restores motor and LED values. Called before the camera exists, so the
// sensor half is separate.
static void loadMotorAndLedSettings() {
  if (!settingsStore.begin(SETTINGS_NAMESPACE, true)) return;

  String savedName = settingsStore.getString("name", robotName);
  savedName.toCharArray(robotName, sizeof(robotName));

  String savedSsid = settingsStore.getString("wifiSsid", DEFAULT_SSID);
  String savedPass = settingsStore.getString("wifiPass", DEFAULT_PASSWORD);

  if (savedSsid.length() > 0) {
    savedSsid.toCharArray(ssid, sizeof(ssid));
    savedPass.toCharArray(password, sizeof(password));
  }

  maxMotorPWM = settingsStore.getInt("maxPwm", maxMotorPWM);
  if (maxMotorPWM < 1 || maxMotorPWM > MAX_PWM) maxMotorPWM = MAX_PWM;

  leftThreshold = settingsStore.getInt("leftThresh", 0);
  rightThreshold = settingsStore.getInt("rightThresh", 0);

  leftMotorSpeed = clampMotorPWM(settingsStore.getInt("leftSpeed", leftMotorSpeed));
  rightMotorSpeed = clampMotorPWM(settingsStore.getInt("rightSpeed", rightMotorSpeed));
  ledBrightness = clampLedPWM(settingsStore.getInt("ledBright", ledBrightness));
  ledEnabled = settingsStore.getBool("ledOn", ledEnabled);

  settingsStore.end();

  char dbg[96];
  snprintf(
    dbg,
    sizeof(dbg),
    "SETTINGS: Restored motors %d/%d, LED %s %d",
    leftMotorSpeed,
    rightMotorSpeed,
    ledEnabled ? "on" : "off",
    ledBrightness
  );
  setDebugMessage(dbg);
}

static void loadCameraSettings() {
  sensor_t *sensor = esp_camera_sensor_get();
  if (!sensor) return;

  if (!settingsStore.begin(SETTINGS_NAMESPACE, true)) return;

  int frameSize = settingsStore.getInt("frameSize", -1);
  int quality = settingsStore.getInt("quality", -1);
  int brightness = settingsStore.getInt("brightness", 0);
  int contrast = settingsStore.getInt("contrast", 0);
  int saturation = settingsStore.getInt("saturation", 0);
  bool vflip = settingsStore.getBool("vflip", Video_Flip);
  bool hmirror = settingsStore.getBool("hmirror", false);

  settingsStore.end();

  // A resolution saved on a board with PSRAM must not be restored onto one
  // without it; the allocation would fail and take the stream with it.
  if (frameSize >= 0 &&
      !(frameSizeNeedsPsram((framesize_t)frameSize) && !cameraHasPsram)) {
    sensor->set_framesize(sensor, (framesize_t)frameSize);
  }

  if (quality >= 0) sensor->set_quality(sensor, quality);

  sensor->set_brightness(sensor, brightness);
  sensor->set_contrast(sensor, contrast);
  sensor->set_saturation(sensor, saturation);
  sensor->set_vflip(sensor, vflip ? 1 : 0);
  sensor->set_hmirror(sensor, hmirror ? 1 : 0);

  char dbg[96];
  snprintf(
    dbg,
    sizeof(dbg),
    "SETTINGS: Restored camera %s / quality %d",
    frameSizeName(sensor->status.framesize),
    (int)sensor->status.quality
  );
  setDebugMessage(dbg);
}

// Recorded programs. Keeping them on the robot rather than in one browser
// means the program follows the robot round the classroom.
static const size_t PROGRAM_SLOT_MAX = 2048;

static bool programSlotKey(const char *slot, char *out, size_t outLen) {
  if (!slot || !out) return false;
  if (slot[0] < '1' || slot[0] > '3' || slot[1] != '\0') return false;

  snprintf(out, outLen, "prog%c", slot[0]);
  return true;
}

static void printSerialCameraStatus() {
  sensor_t *sensor = esp_camera_sensor_get();

  if (!sensor) {
    Serial.println("[CAMERA] Sensor unavailable");
    return;
  }

  Serial.println("[CAMERA]");
  Serial.printf("  resolution : %s\n", frameSizeName(sensor->status.framesize));
  Serial.printf("  quality    : %u (lower = better JPEG quality)\n",
                (unsigned int)sensor->status.quality);
  Serial.printf("  brightness : %d\n", (int)sensor->status.brightness);
  Serial.printf("  contrast   : %d\n", (int)sensor->status.contrast);
  Serial.printf("  saturation : %d\n", (int)sensor->status.saturation);
  Serial.printf("  vflip      : %u\n", (unsigned int)sensor->status.vflip);
  Serial.printf("  hmirror    : %u\n", (unsigned int)sensor->status.hmirror);
  Serial.printf("  PSRAM      : %s\n", cameraHasPsram ? "yes" : "no");
}

static void printSerialRobotStatus() {
  Serial.println("[STATUS]");
  Serial.printf("  motion       : %s\n", motionName(motionState));
  Serial.printf("  left target  : %d / 255\n", leftMotorSpeed);
  Serial.printf("  right target : %d / 255\n", rightMotorSpeed);
  Serial.printf("  left output  : %d / 255\n", currentLeftPWM);
  Serial.printf("  right output : %d / 255\n", currentRightPWM);
  Serial.printf("  flash LED    : %s, brightness %d / 255\n",
                ledEnabled ? "ON" : "OFF",
                ledBrightness);
  Serial.printf("  network mode : %s\n", networkModeName());
  Serial.printf("  STA status   : %s\n", wifiStatusName(WiFi.status()));
  // The fallback SSID is built from the last two bytes of this address.
  // Printed because it is otherwise unobtainable from the robot: checking
  // that the name matches the hardware meant reading the BSSID from a
  // connected client and undoing the SoftAP's +1 by hand.
  Serial.printf("  base MAC     : %s\n", WiFi.macAddress().c_str());

  if (WiFi.status() == WL_CONNECTED) {
    IPAddress ip = WiFi.localIP();
    Serial.printf(
      "  STA IP       : %u.%u.%u.%u\n",
      ip[0], ip[1], ip[2], ip[3]
    );
    Serial.printf("  RSSI         : %ld dBm\n", (long)WiFi.RSSI());
  }

  if (fallbackApActive) {
    IPAddress apIp = WiFi.softAPIP();
    Serial.printf("  AP SSID      : %s\n", fallbackApSsid);
    Serial.printf(
      "  AP IP        : %u.%u.%u.%u\n",
      apIp[0], apIp[1], apIp[2], apIp[3]
    );
    Serial.printf(
      "  AP clients   : %u\n",
      (unsigned int)WiFi.softAPgetStationNum()
    );
  }

  Serial.printf("  uptime       : %lu ms\n", (unsigned long)millis());
}

static void printSerialDebugHistory() {
  uint8_t sizeCopy;
  uint8_t headCopy;

  portENTER_CRITICAL(&debugMux);
  sizeCopy = debugEventSize;
  headCopy = debugEventHead;
  portEXIT_CRITICAL(&debugMux);

  uint8_t oldest =
    (headCopy + DEBUG_EVENT_COUNT - sizeCopy) % DEBUG_EVENT_COUNT;

  Serial.printf("[LOG] %u retained event(s)\n", (unsigned int)sizeCopy);

  for (uint8_t i = 0; i < sizeCopy; i++) {
    uint8_t index = (oldest + i) % DEBUG_EVENT_COUNT;
    DebugEvent eventCopy;

    portENTER_CRITICAL(&debugMux);
    eventCopy = debugEvents[index];
    portEXIT_CRITICAL(&debugMux);

    Serial.printf(
      "  [%lu ms] #%lu %s\n",
      (unsigned long)eventCopy.timeMs,
      (unsigned long)eventCopy.id,
      eventCopy.message
    );
  }
}

static void printSerialHelp() {
  Serial.println();
  Serial.println("ESP32-CAM Robot UART0 Console");
  Serial.printf("UART0: %lu baud 8N1, RX=GPIO%d(U0R), TX=GPIO%d(U0T)\n",
                (unsigned long)SERIAL_BAUD,
                SERIAL_RX_PIN,
                SERIAL_TX_PIN);
  Serial.println("Commands:");
  Serial.println("  help    - show this command list");
  Serial.println("  status  - robot/motor/network status");
  Serial.println("  log     - dump retained debug event history");
  Serial.println("  camera  - current camera settings");
  Serial.println("  stop    - emergency motor stop");
  Serial.println();
}

static char serialCommandBuffer[96];
static size_t serialCommandLength = 0;

static void handleSerialCommand(char *command) {
  if (!command) return;

  while (*command == ' ' || *command == '\t') command++;

  for (char *p = command; *p; ++p) {
    if (*p >= 'A' && *p <= 'Z') {
      *p = (char)(*p - 'A' + 'a');
    }
  }

  if (strcmp(command, "") == 0) {
    return;
  }

  if (strcmp(command, "help") == 0 || strcmp(command, "?") == 0) {
    printSerialHelp();
  } else if (strcmp(command, "status") == 0) {
    printSerialRobotStatus();
  } else if (strcmp(command, "log") == 0) {
    printSerialDebugHistory();
  } else if (strcmp(command, "camera") == 0) {
    printSerialCameraStatus();
  } else if (strcmp(command, "stop") == 0) {
    commandStop();
    setDebugMessage("SERIAL: Emergency STOP");
  } else {
    Serial.printf(
      "Unknown command: %s. Type 'help'.\n",
      command
    );
  }
}

static void serviceSerialConsole() {
  while (Serial.available() > 0) {
    char c = (char)Serial.read();

    if (c == '\r' || c == '\n') {
      if (serialCommandLength > 0) {
        serialCommandBuffer[serialCommandLength] = '\0';
        handleSerialCommand(serialCommandBuffer);
        serialCommandLength = 0;
      }
      continue;
    }

    if (c == 8 || c == 127) {
      if (serialCommandLength > 0) {
        serialCommandLength--;
      }
      continue;
    }

    if (c >= 32 && c <= 126 &&
        serialCommandLength < sizeof(serialCommandBuffer) - 1) {
      serialCommandBuffer[serialCommandLength++] = c;
    }
  }
}

void setup() {
  WRITE_PERI_REG(RTC_CNTL_BROWN_OUT_REG, 0);

  pinMode(TB6612_PWM_AB_PIN, OUTPUT);
  pinMode(MOTOR_L_IN1_PIN, OUTPUT);
  pinMode(MOTOR_L_IN2_PIN, OUTPUT);
  pinMode(MOTOR_R_IN1_PIN, OUTPUT);
  pinMode(MOTOR_R_IN2_PIN, OUTPUT);

  // The schematic ties PWMA and PWMB to GPIO12 and STBY directly to +5V.
  // Keep both bridge channels enabled and generate per-motor PWM on IN1.
  digitalWrite(TB6612_PWM_AB_PIN, HIGH);

  // The LED gets its own 12-bit LEDC channel; everything that writes GPIO4
  // goes through ledcWrite() from here on, never analogWrite().
  ledcSetup(LED_LEDC_CHANNEL, LED_LEDC_FREQ_HZ, LED_LEDC_BITS);
  ledcAttachPin(LED_GPIO_NUM, LED_LEDC_CHANNEL);

  stopMotors();
  ledEnabled = false;
  ledBrightness = 255;
  applyLedOutput();

  // Three flashes, before Serial is even up: the earliest sign the CPU is
  // actually running. Worth having on a board whose only other way of saying
  // anything is a serial cable -- if the flashes appear, the ESP32 booted and
  // whatever comes next is a software problem rather than a dead board.
  const int bootBlinkDuty = ledDutyFromPercent(LED_BOOT_BLINK_PERCENT);
  for (int i = 0; i < LED_BOOT_BLINK_COUNT; i++) {
    ledcWrite(LED_LEDC_CHANNEL, bootBlinkDuty);
    delay(LED_BOOT_BLINK_MS);
    ledcWrite(LED_LEDC_CHANNEL, 0);
    delay(LED_BOOT_BLINK_MS);
  }
  applyLedOutput();  // back to the configured state (off)

  Serial.begin(SERIAL_BAUD, SERIAL_8N1, SERIAL_RX_PIN, SERIAL_TX_PIN);
  Serial.setDebugOutput(false);
  delay(50);
  printSerialHelp();

  // Startup events are stored in the same Wi-Fi debug history as runtime events.
  setDebugMessage("BOOT: ESP32-CAM startup");
  setDebugMessage("BOOT: UI features = motor sync, UART console, camera settings");
  setDebugMessage("BOOT: Motor outputs initialized and stopped");
  setDebugMessage("BOOT: Flash LED initialized OFF; brightness 255 / 255");

  loadMotorAndLedSettings();
  applyLedOutput();

  // Camera configuration
  setDebugMessage("BOOT: Configuring camera");
  // Zero-initialise: esp_camera_init() reads every field, including ones this
  // sketch never assigns (grab_mode, fb_location). Leaving them as stack
  // garbage made the driver hand out queued, stale frames.
  camera_config_t config = {};
  config.ledc_channel = LEDC_CHANNEL_0;
  config.ledc_timer = LEDC_TIMER_0;
  config.pin_d0 = Y2_GPIO_NUM;
  config.pin_d1 = Y3_GPIO_NUM;
  config.pin_d2 = Y4_GPIO_NUM;
  config.pin_d3 = Y5_GPIO_NUM;
  config.pin_d4 = Y6_GPIO_NUM;
  config.pin_d5 = Y7_GPIO_NUM;
  config.pin_d6 = Y8_GPIO_NUM;
  config.pin_d7 = Y9_GPIO_NUM;
  config.pin_xclk = XCLK_GPIO_NUM;
  config.pin_pclk = PCLK_GPIO_NUM;
  config.pin_vsync = VSYNC_GPIO_NUM;
  config.pin_href = HREF_GPIO_NUM;
  config.pin_sccb_sda = SIOD_GPIO_NUM;
  config.pin_sccb_scl = SIOC_GPIO_NUM;
  config.pin_pwdn = PWDN_GPIO_NUM;
  config.pin_reset = RESET_GPIO_NUM;
  config.xclk_freq_hz = 20000000;
  config.pixel_format = PIXFORMAT_JPEG;

  cameraHasPsram = psramFound();

  if (cameraHasPsram) {
    config.frame_size = FRAMESIZE_VGA;
    // Quality 12 rather than 10: VGA at 10 is ~50 KB a frame, which is more
    // than this radio can carry at a watchable frame rate.
    config.jpeg_quality = 12;
    config.fb_count = 2;
    config.fb_location = CAMERA_FB_IN_PSRAM;
    // With two buffers, always serve the newest one. The default queues them,
    // so the browser is shown a frame that is already one capture old.
    config.grab_mode = CAMERA_GRAB_LATEST;
    setDebugMessage("BOOT: PSRAM detected; camera VGA / 2 frame buffers / grab latest");
  } else {
    // HVGA in DRAM sits right at the allocation limit on a board with no
    // PSRAM; QVGA leaves headroom for the two web servers.
    config.frame_size = FRAMESIZE_QVGA;
    config.jpeg_quality = 12;
    config.fb_count = 1;
    config.fb_location = CAMERA_FB_IN_DRAM;
    config.grab_mode = CAMERA_GRAB_WHEN_EMPTY;
    setDebugMessage("BOOT: No PSRAM; camera QVGA / 1 frame buffer");
  }

  setDebugMessage("BOOT: Initializing camera");
  esp_err_t err = esp_camera_init(&config);
  if (err != ESP_OK) {
    char dbg[96];
    snprintf(dbg, sizeof(dbg), "ERROR: Camera init failed: 0x%x", err);
    setDebugMessage(dbg);
    return;
  }

  setDebugMessage("BOOT: Camera initialized OK");

  if (Video_Flip) {
    sensor_t *s = esp_camera_sensor_get();
    s->set_vflip(s, 1);
    s->set_hmirror(s, 0);
    setDebugMessage("BOOT: Camera vertical flip enabled");
  } else {
    setDebugMessage("BOOT: Camera orientation normal");
  }

  // After the Video_Flip default, so a saved orientation wins over it.
  loadCameraSettings();

  setDebugMessage("BOOT: Connecting to configured Wi-Fi");
  WiFi.mode(WIFI_STA);
  // Modem sleep parks the radio between beacons. On an MJPEG stream that
  // shows up as the picture freezing and then jumping; the camera is fine,
  // the frames are just sitting in a queue waiting for the radio.
  WiFi.setSleep(false);
  WiFi.begin(ssid, password);

  unsigned long wifiStart = millis();

  while (WiFi.status() != WL_CONNECTED &&
         millis() - wifiStart < WIFI_CONNECT_TIMEOUT_MS) {
    delay(250);
    Serial.print(".");
  }

  Serial.println();

  if (WiFi.status() == WL_CONNECTED) {
    char wifiDbg[128];
    IPAddress ip = WiFi.localIP();

    snprintf(
      wifiDbg,
      sizeof(wifiDbg),
      "BOOT: Wi-Fi connected; IP %u.%u.%u.%u",
      ip[0], ip[1], ip[2], ip[3]
    );
    setDebugMessage(wifiDbg);

    snprintf(
      wifiDbg,
      sizeof(wifiDbg),
      "BOOT: Wi-Fi RSSI %ld dBm",
      (long)WiFi.RSSI()
    );
    setDebugMessage(wifiDbg);

    Serial.print("Robot Ready! Open: http://");
    Serial.println(ip);

    previousStaStatus = WL_CONNECTED;
  } else {
    wl_status_t failedStatus = WiFi.status();

    char wifiDbg[160];
    snprintf(
      wifiDbg,
      sizeof(wifiDbg),
      "BOOT: Wi-Fi timeout after 10 seconds; status: %s (code %d)",
      wifiStatusName(failedStatus),
      (int)failedStatus
    );
    setDebugMessage(wifiDbg);

    if (failedStatus == WL_NO_SSID_AVAIL) {
      setDebugMessage("BOOT: Configured Wi-Fi SSID was not found");
    } else if (failedStatus == WL_CONNECT_FAILED) {
      setDebugMessage(
        "BOOT: Wi-Fi connection/authentication failed; check password and security settings"
      );
    } else if (failedStatus == WL_CONNECTION_LOST) {
      setDebugMessage("BOOT: Wi-Fi connection was lost before startup completed");
    } else if (failedStatus == WL_DISCONNECTED) {
      setDebugMessage(
        "BOOT: Wi-Fi remained disconnected; SSID, password, signal, or AP compatibility may be the cause"
      );
    }

    setDebugMessage("BOOT: Starting fallback access point");

    if (startFallbackAccessPoint()) {
      IPAddress apIp = WiFi.softAPIP();

      Serial.println();
      Serial.println("Configured Wi-Fi unavailable.");
      Serial.print("Fallback SSID: ");
      Serial.println(fallbackApSsid);
      Serial.println("Fallback password: 88888888");
      Serial.print("Open: http://");
      Serial.println(apIp);
    }

    previousStaStatus = WiFi.status();
  }

  checkIndexGzAsset();

  setDebugMessage("BOOT: Starting HTTP and camera-stream servers");
  if (startCameraServer()) {
    setDebugMessage("BOOT: Robot web server ready");
  } else {
    setDebugMessage("ERROR: Robot web server failed to start");
  }
}

void loop() {
  // First, and outside every guard: a stalled command stream must stop the
  // motors whatever else the robot is busy with.
  serviceMotionTimeout();

  serviceSerialConsole();

  if (!otaInProgress) {
    serviceWiFiFallback();
  }

  // Outside the OTA guard on purpose: a firmware write is exactly when you
  // most want to see that the board is still alive.
  serviceHeartbeat();
  serviceSettingsSave();
  serviceWifiApply();

  delay(10);
}

static const char PROGMEM INDEX_HTML[] = R"rawliteral(
<!DOCTYPE html>
<html>
<head>
  <title>ESP32-CAM Robot</title>
  <meta name="viewport" content="width=device-width, initial-scale=1">
  <meta charset="UTF-8"/>
  <meta http-equiv="Cache-Control" content="no-store, no-cache, must-revalidate, max-age=0">
  <meta http-equiv="Pragma" content="no-cache">
  <meta http-equiv="Expires" content="0">

  <style>
    * { box-sizing: border-box; }

    .svg-defs {
      position: absolute;
      width: 0;
      height: 0;
      overflow: hidden;
    }

    /* Above the sidebars on purpose: they slide underneath, so the pill that
       opened one is still there to close it. */
    .hero {
      position: sticky;
      top: 0;
      z-index: 1100;
      margin: -18px -12px 14px;
      padding: 9px 12px;
      border-bottom: 1px solid rgba(255, 255, 255, 0.10);
      border-radius: 0 0 16px 16px;
      background: linear-gradient(180deg, rgba(26, 37, 66, 0.94), rgba(15, 23, 42, 0.90));
      backdrop-filter: blur(8px);
      box-shadow: 0 10px 26px rgba(0, 0, 0, 0.22);
    }

    .hero-inner {
      display: flex;
      align-items: center;
      justify-content: space-between;
      gap: 12px;
      width: min(1100px, 100%);
      margin: 0 auto;
      text-align: left;
    }

    .hero-left {
      display: flex;
      align-items: center;
      gap: 10px;
      min-width: 0;
    }

    .hero-logo {
      flex: 0 0 auto;
      width: 44px;
      height: 24px;
    }

    .hero-titles {
      min-width: 0;
    }

    .hero-title {
      background: linear-gradient(90deg, #38bdf8, #7dd3fc);
      -webkit-background-clip: text;
      background-clip: text;
      color: transparent;
      font-size: 17px;
      font-weight: 900;
      letter-spacing: 0.01em;
      line-height: 1.15;
      white-space: nowrap;
    }

    .hero-subtitle {
      display: flex;
      align-items: center;
      gap: 6px;
      color: rgba(248, 250, 252, 0.6);
      font-size: 11px;
      font-weight: 600;
      white-space: nowrap;
    }

    .hero-badge {
      padding: 1px 7px;
      border-radius: 8px;
      background: rgba(255, 255, 255, 0.10);
      color: rgba(248, 250, 252, 0.65);
      font-size: 10px;
      font-weight: 700;
      letter-spacing: 0.03em;
    }

    [hidden] {
      display: none !important;
    }

    /* Two views of the same column. The video stays put above both, so a
       program can be watched while it runs. */
    .hero-tabs {
      display: flex;
      gap: 2px;
      padding: 3px;
      border: 1px solid rgba(255, 255, 255, 0.10);
      border-radius: 999px;
      background: rgba(255, 255, 255, 0.04);
    }

    .hero-tab {
      padding: 6px 15px;
      border: 0;
      border-radius: 999px;
      background: transparent;
      color: rgba(248, 250, 252, 0.65);
      font-size: 13px;
      font-weight: 700;
      font-family: inherit;
      cursor: pointer;
    }

    .hero-tab.is-active {
      background: linear-gradient(135deg, #38bdf8, #0ea5e9);
      color: #06243b;
    }

    .program-bar {
      display: flex;
      align-items: center;
      gap: 10px;
      width: min(390px, 100%);
      margin: 12px auto 0;
      padding: 8px 10px;
      border: 1px solid #d7dce5;
      border-radius: 12px;
      background: white;
      text-align: left;
    }

    .program-action {
      display: inline-flex;
      align-items: center;
      gap: 7px;
      min-height: 34px;
      padding: 6px 13px;
      border: 1px solid #cbd5e1;
      border-radius: 999px;
      background: #f1f5f9;
      color: #172033;
      font-size: 13px;
      font-weight: 700;
      font-family: inherit;
      cursor: pointer;
    }

    .program-action:disabled {
      opacity: 0.45;
      cursor: not-allowed;
    }

    .record-dot {
      width: 10px;
      height: 10px;
      border-radius: 50%;
      background: #ef4444;
    }

    .program-record.is-recording {
      border-color: #ef4444;
      background: #fee2e2;
    }

    .program-record.is-recording .record-dot {
      animation: linkPulse 1.1s ease-in-out infinite;
    }

    .program-play {
      border-color: #0ea5e9;
      background: #e0f2fe;
    }

    .program-stop {
      border-color: #ef4444;
      background: #fee2e2;
    }

    .program-status {
      flex: 1 1 auto;
      min-width: 0;
      color: #667085;
      font-size: 12px;
      line-height: 1.3;
    }

    .program-head {
      display: flex;
      align-items: baseline;
      justify-content: space-between;
      gap: 10px;
      margin-bottom: 10px;
      text-align: left;
    }

    .program-count {
      color: #667085;
      font-size: 12px;
    }

    .program-steps {
      max-height: 260px;
      overflow-y: auto;
      border: 1px solid #e2e8f0;
      border-radius: 10px;
      background: #f8fafc;
    }

    .program-steps:empty::after {
      display: block;
      padding: 18px 12px;
      color: #94a3b8;
      font-size: 13px;
      content: "Press Record, drive the robot, then press Stop.";
    }

    .program-step {
      display: flex;
      align-items: center;
      gap: 8px;
      padding: 6px 9px;
      border-bottom: 1px solid #e8edf3;
      font-size: 13px;
      text-align: left;
    }

    .program-step:last-child {
      border-bottom: 0;
    }

    .program-step.is-current {
      background: #e0f2fe;
    }

    .step-index {
      flex: 0 0 22px;
      color: #94a3b8;
      font-size: 11px;
    }

    .step-delay {
      flex: 0 0 66px;
      min-height: 30px;
      padding: 3px 6px;
      border: 1px solid #cbd5e1;
      border-radius: 7px;
      font-size: 13px;
      font-family: inherit;
    }

    .step-desc {
      flex: 1 1 auto;
      min-width: 0;
      font-weight: 700;
      overflow-wrap: anywhere;
    }

    .step-remove {
      flex: 0 0 auto;
      min-width: 30px;
      min-height: 30px;
      border: 0;
      border-radius: 8px;
      background: #f1f5f9;
      color: #64748b;
      font-size: 14px;
      cursor: pointer;
    }

    .program-buttons {
      display: flex;
      gap: 8px;
      margin-top: 12px;
    }

    .program-slots {
      margin-top: 12px;
      border-top: 1px solid #e2e8f0;
      padding-top: 10px;
    }

    .program-slot {
      display: flex;
      align-items: center;
      gap: 8px;
      margin-top: 6px;
      font-size: 13px;
      text-align: left;
    }

    .slot-name {
      flex: 0 0 54px;
      font-weight: 700;
    }

    .slot-info {
      flex: 1 1 auto;
      min-width: 0;
      color: #667085;
      font-size: 12px;
    }

    .slot-button {
      min-height: 30px;
      padding: 4px 11px;
      border: 1px solid #cbd5e1;
      border-radius: 999px;
      background: #f1f5f9;
      color: #172033;
      font-size: 12px;
      font-weight: 700;
      font-family: inherit;
      cursor: pointer;
    }

    .wifi-list {
      margin-top: 8px;
      max-height: 190px;
      overflow-y: auto;
    }

    .wifi-row {
      display: flex;
      align-items: center;
      justify-content: space-between;
      gap: 10px;
      width: 100%;
      min-height: 36px;
      margin-top: 4px;
      padding: 6px 10px;
      border: 1px solid #e2e8f0;
      border-radius: 9px;
      background: #f8fafc;
      color: #172033;
      font-family: inherit;
      font-size: 13px;
      text-align: left;
      cursor: pointer;
    }

    .wifi-row:hover {
      background: #eef2f7;
    }

    .wifi-name {
      min-width: 0;
      overflow-wrap: anywhere;
      font-weight: 700;
    }

    .wifi-signal {
      flex: 0 0 auto;
      color: #667085;
      font-size: 12px;
    }

    .robot-name-row {
      display: flex;
      gap: 8px;
      align-items: center;
    }

    .setting-note {
      margin-top: 6px;
      color: #667085;
      font-size: 12px;
      line-height: 1.4;
    }

    .modal {
      position: fixed;
      inset: 0;
      z-index: 1200;
      display: flex;
      align-items: center;
      justify-content: center;
      padding: 16px;
      background: rgba(9, 14, 26, 0.62);
    }

    .modal-card {
      width: min(520px, 100%);
      max-height: 86vh;
      overflow-y: auto;
      padding: 16px;
      border-radius: 16px;
      background: white;
      color: #172033;
      text-align: left;
      box-shadow: 0 24px 60px rgba(0, 0, 0, 0.35);
    }

    .modal-head {
      display: flex;
      align-items: center;
      justify-content: space-between;
      gap: 12px;
      margin-bottom: 12px;
      font-size: 17px;
    }

    .gallery-grid {
      display: grid;
      grid-template-columns: repeat(auto-fill, minmax(140px, 1fr));
      gap: 10px;
    }

    .gallery-cell {
      border: 1px solid #e2e8f0;
      border-radius: 10px;
      overflow: hidden;
      background: #f8fafc;
    }

    .gallery-image {
      display: block;
      width: 100%;
      height: auto;
    }

    .gallery-actions {
      display: flex;
      gap: 6px;
      padding: 7px;
    }

    .activity-line {
      margin: 0 0 12px;
      font-size: 15px;
      line-height: 1.5;
    }

    .activity-buttons {
      display: flex;
      flex-wrap: wrap;
      gap: 8px;
    }

    .activity-result {
      margin: 12px 0 0;
      color: #0f766e;
      font-size: 14px;
      font-weight: 700;
      line-height: 1.4;
    }

    .hero-right {
      display: flex;
      align-items: center;
      gap: 8px;
    }

    .hero-pill {
      display: inline-flex;
      align-items: center;
      gap: 7px;
      min-height: 38px;
      padding: 7px 13px;
      border: 1px solid rgba(255, 255, 255, 0.12);
      border-radius: 999px;
      background: rgba(255, 255, 255, 0.05);
      color: rgba(248, 250, 252, 0.92);
      font-size: 13px;
      font-weight: 700;
      font-family: inherit;
      cursor: pointer;
    }

    .hero-pill:hover {
      background: rgba(255, 255, 255, 0.10);
    }

    .pill-icon {
      font-size: 15px;
      line-height: 1;
    }

    .pill-dot {
      width: 9px;
      height: 9px;
      border-radius: 50%;
      background: rgba(248, 250, 252, 0.45);
    }

    /* Not a button: it reports, it does not act. */
    .hero-link {
      cursor: default;
    }

    .hero-link.is-live .pill-dot {
      background: #34d399;
      box-shadow: 0 0 8px rgba(52, 211, 153, 0.8);
    }

    .hero-link.is-novideo .pill-dot {
      background: #fbbf24;
      box-shadow: 0 0 8px rgba(251, 191, 36, 0.7);
    }

    .hero-link.is-offline {
      border-color: rgba(248, 113, 113, 0.55);
      background: linear-gradient(135deg, rgba(248, 113, 113, 0.30), rgba(239, 68, 68, 0.30));
      color: #fee2e2;
    }

    .hero-link.is-offline .pill-dot {
      background: #f87171;
      animation: linkPulse 1.4s ease-in-out infinite;
    }

    @keyframes linkPulse {
      0%, 100% { opacity: 1; }
      50%      { opacity: 0.25; }
    }

    /* Phones: the labels go, the icons and the link dot stay. */
    @media (max-width: 560px) {
      .hero-pill .pill-text {
        display: none;
      }

      .hero-link .pill-text {
        display: inline;
        font-size: 12px;
      }

      .hero-pill {
        padding: 7px 11px;
      }

      .hero-title {
        font-size: 15px;
      }

      .hero-subtitle {
        display: none;
      }

      .hero-tab {
        padding: 6px 11px;
        font-size: 12px;
      }

      .hero-inner {
        gap: 8px;
      }
    }

    body {
      font-family: Arial, sans-serif;
      text-align: center;
      margin: 0;
      padding: 18px 12px 35px;
      background: #f7f8fa;
      color: #172033;
    }


    .robot {
      width: min(620px, 100%);
      margin: 0 auto;
    }

    .video-frame {
      position: relative;
      width: 100%;
      aspect-ratio: 4 / 3;
      overflow: hidden;
      border: 2px solid #2f4468;
      border-radius: 12px;
      background: #111;
      transition: aspect-ratio 0.18s ease;
    }

    /* Overlays sit alongside #photo rather than on it: applyImageRotation()
       transforms the image only, so these stay upright at every rotation. */
    /* Positioning belongs to .video-footer: these are flex children of it,
       and absolutely positioning them stacks them on top of each other. */
    .video-overlay {
      display: flex;
      min-width: 0;
      align-items: center;
      gap: 7px;
      padding: 4px 9px;
      border-radius: 8px;
      background: rgba(17, 17, 17, 0.55);
      color: #e5e7eb;
      font-size: 12px;
      line-height: 1.2;
      pointer-events: none;
    }

    /* One bar across the bottom, so the mark and the readouts can never
       overlap however narrow the frame gets. */
    .video-footer {
      position: absolute;
      right: 8px;
      bottom: 8px;
      left: 8px;
      z-index: 2;
      display: flex;
      align-items: flex-end;
      justify-content: space-between;
      gap: 8px;
      pointer-events: none;
    }

    .video-brand {
      letter-spacing: 0.02em;
      /* A watermark, not a readout: present, never competing. */
      opacity: 0.3;
    }

    .brand-logo {
      display: block;
      flex: 0 0 auto;
      /* Both dimensions explicit. The viewBox lives on the <symbol> now, so
         this element has no intrinsic aspect ratio and height:auto would
         resolve to the 150px default for a replaced element -- which makes
         the pill 150px tall and lifts the wordmark off the footer line.
         34 x 18 keeps the mark's own 1.87 ratio. */
      width: 34px;
      height: 18px;
    }

    .video-telemetry {
      gap: 10px;
      font-variant-numeric: tabular-nums;
      opacity: 0.3;
      transition: opacity 0.18s ease;
    }

    /* Dim at rest, legible the moment it has something to say: the robot is
       moving, the signal is going, or the motors just timed out. */
    .video-telemetry.is-awake {
      opacity: 1;
    }

    /* The SSID is the only readout of unpredictable width -- a network name
       runs to 32 characters -- so it is the one that gives way when the frame
       is narrow, and it gives way only then. A fixed ch ceiling was worse
       than no ceiling: it clipped the robot's own 16-character name on a
       frame with room to spare. */
    #videoSsid {
      overflow: hidden;
      min-width: 0;
      text-overflow: ellipsis;
      white-space: nowrap;
    }

    /* Hold their natural width, or flex would shrink these too and the fps
       figure would start losing digits before the SSID had given up a
       character. */
    #videoFps,
    #videoRssi,
    #videoMotion {
      flex: 0 0 auto;
    }

    #videoRssi.is-weak {
      color: #fbbf24;
    }

    #videoMotion.is-moving {
      color: #7dd3fc;
    }

    #videoMotion.is-timeout {
      color: #f87171;
      font-weight: 700;
    }

    /* On a narrow frame the wordmark goes and the logo stays. */
    @media (max-width: 430px) {
      .video-brand span,
      #videoSsid {
        display: none;
      }
    }

    .stream-status {
      position: absolute;
      left: 8px;
      top: 8px;
      z-index: 2;
      max-width: calc(100% - 16px);
      padding: 4px 8px;
      border-radius: 8px;
      background: rgba(17, 17, 17, 0.78);
      color: #ffd9a0;
      font-size: 12px;
      line-height: 1.3;
    }

    /* Nothing to say means the stream is live; stay out of the picture. */
    .stream-status:empty {
      display: none;
    }

    #photo {
      position: absolute;
      top: 50%;
      left: 50%;
      display: block;
      max-width: none;
      max-height: none;
      transform-origin: center center;
      background: #111;
    }

    .panel {
      width: min(390px, 100%);
      margin: 16px auto 0;
      padding: 16px;
      background: white;
      border: 1px solid #d7dce5;
      border-radius: 16px;
    }

    .speed-row {
      display: flex;
      justify-content: space-between;
      align-items: baseline;
      gap: 12px;
      margin-bottom: 8px;
      font-weight: 700;
    }

    .speed-value {
      color: #2f4468;
      white-space: nowrap;
    }

    .motor-control {
      padding: 10px 0;
    }

    .motor-control + .motor-control {
      border-top: 1px solid #e4e7ec;
      margin-top: 8px;
    }

    .motor-slider {
      width: 100%;
      min-width: 0;
      accent-color: #2f4468;
      cursor: pointer;
    }

    .motor-adjust {
      display: grid;
      grid-template-columns: 50px minmax(0, 1fr) 50px;
      align-items: center;
      gap: 8px;
    }

    .pwm-step {
      min-height: 42px;
      border: 1px solid #cbd5e1;
      border-radius: 10px;
      background: #f8fafc;
      color: #172033;
      font-size: 15px;
      font-weight: 700;
      cursor: pointer;
    }

    .ui-version {
      margin-bottom: 10px;
      color: #667085;
      font-size: 11px;
      text-align: center;
      letter-spacing: 0.02em;
    }

    .sync-row {
      display: flex;
      align-items: center;
      justify-content: space-between;
      gap: 12px;
      margin-bottom: 8px;
      padding: 10px 0 12px;
      border-bottom: 1px solid #e4e7ec;
    }

    .sync-control {
      display: inline-flex;
      align-items: center;
      gap: 8px;
      font-weight: 700;
      cursor: pointer;
    }

    .sync-control input {
      width: 20px;
      height: 20px;
      accent-color: #2f4468;
    }

    .sync-note {
      color: #667085;
      font-size: 12px;
      text-align: right;
    }

    .speed-scale {
      display: flex;
      justify-content: space-between;
      font-size: 12px;
      color: #667085;
      margin-top: 3px;
    }

    .button-container {
      display: grid;
      grid-template-columns: repeat(3, 82px);
      grid-template-areas:
        ". forward led"
        "left stop right"
        ". backward .";
      gap: 10px;
      justify-content: center;
      margin-top: 18px;
    }

    button {
      touch-action: manipulation;
      user-select: none;
      -webkit-user-select: none;
    }

    .button, .led-button {
      border: 0;
      color: white;
      font-size: 22px;
      width: 82px;
      height: 58px;
      border-radius: 13px;
      cursor: pointer;
      background: #2f4468;
    }

    .button:active {
      transform: scale(0.97);
    }

    .forward { grid-area: forward; }
    .left { grid-area: left; }
    .stop { grid-area: stop; }
    .right { grid-area: right; }
    .backward { grid-area: backward; }
    .led { grid-area: led; }

    .stop {
      background: #9b2c2c;
    }

    .led-button {
      font-size: 16px;
      background: #777;
    }

    .led-on {
      background: #e9b900;
      color: #111;
    }

    .note {
      margin: 14px 0 0;
      padding: 10px 12px;
      border-radius: 10px;
      background: #fff5d8;
      color: #604b08;
      font-size: 13px;
      line-height: 1.35;
    }


    .settings-sidebar {
      position: fixed;
      top: 0;
      left: 0;
      z-index: 1050;
      width: min(360px, 90vw);
      height: 100vh;
      padding: 72px 16px 18px;
      background: #f8fafc;
      color: #172033;
      box-shadow: 8px 0 24px rgba(0,0,0,0.22);
      transform: translateX(-100%);
      transition: transform 0.22s ease;
      overflow-y: auto;
      text-align: left;
    }

    .settings-sidebar.open {
      transform: translateX(0);
    }

    .settings-sidebar h2 {
      margin: 0 0 14px;
      font-size: 21px;
    }

    .settings-section {
      margin-top: 14px;
      padding: 14px;
      border: 1px solid #d7dce5;
      border-radius: 14px;
      background: white;
    }

    .settings-section > summary {
      display: flex;
      align-items: center;
      justify-content: space-between;
      gap: 10px;
      font-size: 16px;
      font-weight: 700;
      cursor: pointer;
      /* The default marker cannot be positioned; this section uses its own. */
      list-style: none;
    }

    .settings-section > summary::-webkit-details-marker {
      display: none;
    }

    .settings-section > summary::after {
      content: "▾";
      color: #667085;
      font-size: 12px;
      transition: transform 0.18s ease;
    }

    .settings-section[open] > summary {
      margin-bottom: 12px;
    }

    .settings-section[open] > summary::after {
      transform: rotate(180deg);
    }

    .setting-row {
      margin-top: 12px;
    }

    .setting-row:first-of-type {
      margin-top: 0;
    }

    .setting-head {
      display: flex;
      justify-content: space-between;
      gap: 10px;
      margin-bottom: 5px;
      font-size: 13px;
      font-weight: 700;
    }

    .setting-value {
      font-family: monospace;
      color: #475569;
    }

    .camera-select,
    .camera-range {
      width: 100%;
    }

    .camera-select {
      min-height: 42px;
      border: 1px solid #cbd5e1;
      border-radius: 9px;
      background: white;
      padding: 7px 9px;
      color: #172033;
      font-size: 16px;
    }

    .camera-check {
      display: flex;
      align-items: center;
      gap: 9px;
      min-height: 40px;
      font-weight: 700;
      cursor: pointer;
    }

    .camera-check input {
      width: 20px;
      height: 20px;
    }

    .settings-action {
      width: 100%;
      min-height: 42px;
      margin-top: 12px;
      border: 1px solid #94a3b8;
      border-radius: 9px;
      background: #f8fafc;
      color: #172033;
      font-weight: 700;
      cursor: pointer;
    }

    .camera-status {
      margin-top: 10px;
      min-height: 42px;
      padding: 9px 10px;
      border-radius: 9px;
      background: #eef2f7;
      color: #475569;
      font-family: monospace;
      font-size: 12px;
      line-height: 1.4;
      overflow-wrap: anywhere;
    }

    .serial-web-status {
      margin-bottom: 10px;
      padding: 9px 10px;
      border-radius: 9px;
      background: #eef2f7;
      color: #475569;
      font-size: 12px;
      line-height: 1.4;
      overflow-wrap: anywhere;
    }

    .serial-web-status.ok {
      background: #dcfce7;
      color: #14532d;
    }

    .serial-web-status.error {
      background: #fee2e2;
      color: #7f1d1d;
    }

    .serial-toolbar {
      display: grid;
      grid-template-columns: 1fr 1fr;
      gap: 7px;
    }

    .serial-inline-button {
      margin-top: 0;
    }

    .serial-port-info {
      display: flex;
      justify-content: space-between;
      gap: 10px;
      margin-top: 10px;
      padding: 8px 10px;
      border-radius: 9px;
      background: #eef2f7;
      font-size: 12px;
    }

    .serial-port-info span {
      color: #64748b;
    }

    .serial-port-info strong {
      max-width: 65%;
      font-family: monospace;
      text-align: right;
      overflow-wrap: anywhere;
    }

    .serial-capture-actions {
      display: flex;
      align-items: center;
      justify-content: flex-end;
      flex-wrap: wrap;
      gap: 6px;
      margin-top: 10px;
    }

    .serial-autoscroll {
      margin-right: auto;
      min-height: 34px;
      font-size: 12px;
    }

    .serial-terminal {
      width: 100%;
      height: 230px;
      margin: 9px 0 0;
      padding: 10px;
      overflow: auto;
      border-radius: 10px;
      background: #070d18;
      color: #d1fae5;
      font-family: Consolas, "Courier New", monospace;
      font-size: 12px;
      line-height: 1.45;
      white-space: pre-wrap;
      overflow-wrap: anywhere;
    }

    .serial-send-row {
      display: grid;
      grid-template-columns: minmax(0, 1fr) auto;
      gap: 7px;
      margin-top: 8px;
    }

    .serial-send-button {
      width: auto;
      min-width: 70px;
      margin-top: 0;
    }

    .serial-info {
      margin: 12px 0 0;
      padding-left: 19px;
      color: #475569;
      font-size: 13px;
      line-height: 1.55;
    }

    .serial-commands {
      margin-top: 10px;
      padding: 9px 10px;
      border-radius: 9px;
      background: #111827;
      color: #e5e7eb;
      font-family: monospace;
      font-size: 12px;
      line-height: 1.5;
    }


    .debug-sidebar {
      position: fixed;
      top: 0;
      right: 0;
      z-index: 1050;
      width: min(340px, 88vw);
      height: 100vh;
      padding: 72px 16px 18px;
      background: #111827;
      color: #f9fafb;
      box-shadow: -8px 0 24px rgba(0,0,0,0.22);
      transform: translateX(100%);
      transition: transform 0.22s ease;
      overflow-y: auto;
      text-align: left;
    }

    .debug-sidebar.open {
      transform: translateX(0);
    }

    .debug-sidebar h2 {
      margin: 0 0 14px;
      font-size: 21px;
    }

    .debug-grid {
      display: grid;
      grid-template-columns: 1fr auto;
      gap: 8px 14px;
      padding: 12px;
      border-radius: 12px;
      background: #1f2937;
      font-size: 14px;
    }

    .debug-grid .label { color: #cbd5e1; }
    .debug-grid .value { font-family: monospace; font-weight: 700; }

    .debug-message {
      margin-top: 12px;
      padding: 12px;
      border-radius: 12px;
      background: #0b1220;
      font-family: monospace;
      font-size: 13px;
      line-height: 1.45;
      min-height: 70px;
      white-space: pre-wrap;
      overflow-wrap: anywhere;
    }

    .debug-small {
      margin-top: 10px;
      color: #94a3b8;
      font-size: 12px;
      line-height: 1.4;
    }

    .debug-status-row {
      display: flex;
      align-items: center;
      justify-content: space-between;
      gap: 10px;
      margin-top: 12px;
    }

    .debug-connection {
      display: inline-flex;
      align-items: center;
      min-height: 30px;
      padding: 5px 10px;
      border-radius: 999px;
      background: #374151;
      color: #e5e7eb;
      font-size: 12px;
      font-weight: 700;
    }

    .debug-connection.live {
      background: #14532d;
      color: #dcfce7;
    }

    .debug-connection.error {
      background: #7f1d1d;
      color: #fee2e2;
    }

    .debug-log-actions {
      display: flex;
      flex-wrap: wrap;
      justify-content: flex-end;
      gap: 6px;
    }

    .debug-clear {
      min-height: 34px;
      padding: 5px 10px;
      border: 1px solid #475569;
      border-radius: 8px;
      background: #1f2937;
      color: #f8fafc;
      cursor: pointer;
    }

    /* The OTA card lives inside a settings-section, which already draws the
       white card and its border. */
    .ota-panel {
      padding: 0;
    }

    .ota-build {
      display: flex;
      justify-content: space-between;
      gap: 12px;
      margin-bottom: 10px;
      font-size: 13px;
    }

    .ota-build span {
      color: #667085;
    }

    .ota-label,
    .ota-file-label {
      display: block;
      margin: 9px 0 5px;
      color: #475569;
      font-size: 12px;
      font-weight: 700;
    }

    .ota-input,
    .ota-file {
      width: 100%;
      min-height: 40px;
      border: 1px solid #cbd5e1;
      border-radius: 8px;
      background: white;
      color: #172033;
      padding: 8px 9px;
      font-size: 16px;
    }

    .ota-file {
      padding: 7px;
      font-size: 13px;
    }

    .ota-upload {
      width: 100%;
      min-height: 42px;
      margin-top: 10px;
      border: 0;
      border-radius: 9px;
      background: #334155;
      color: #f8fafc;
      font-weight: 700;
      cursor: pointer;
    }

    .ota-upload:disabled {
      opacity: 0.5;
      cursor: not-allowed;
    }

    .ota-progress-shell {
      width: 100%;
      height: 10px;
      margin-top: 10px;
      overflow: hidden;
      border-radius: 999px;
      background: #e2e8f0;
    }

    .ota-progress-bar {
      width: 0%;
      height: 100%;
      background: #334155;
      transition: width 0.12s linear;
    }

    .ota-progress-text {
      margin-top: 7px;
      color: #475569;
      font-family: monospace;
      font-size: 12px;
      overflow-wrap: anywhere;
    }

    .ota-warning {
      margin-top: 9px;
      color: #b45309;
      font-size: 11px;
      line-height: 1.4;
    }

    .debug-log-title {
      margin-top: 14px;
      margin-bottom: 6px;
      color: #cbd5e1;
      font-size: 12px;
      font-weight: 700;
      text-transform: uppercase;
      letter-spacing: 0.06em;
    }

    .debug-log {
      min-height: 110px;
      max-height: 230px;
      overflow-y: auto;
      padding: 10px;
      border-radius: 12px;
      background: #070d18;
      color: #d1d5db;
      font-family: monospace;
      font-size: 12px;
      line-height: 1.45;
    }

    .debug-log-entry {
      padding: 3px 0;
      border-bottom: 1px solid #172033;
      overflow-wrap: anywhere;
    }

    .debug-log-entry:last-child {
      border-bottom: 0;
    }

    @media (max-width: 420px) {
      .button-container {
        grid-template-columns: repeat(3, 76px);
      }

      .button, .led-button {
        width: 76px;
        height: 56px;
      }
    }
  </style>
</head>

<body>
  <!-- The workshop-diy mark, defined once and referenced by both the header
       and the video watermark: two inline copies would cost 3.5 KB twice. -->
  <svg class="svg-defs" aria-hidden="true" focusable="false">
    <symbol id="wdiLogo" viewBox="-92.820084 179.975632 6.000000 3.214096">
      <path style="stroke:none;fill:#007BFF;fill-rule:evenodd" d="M-90.27,180.71C-90.27,180.7,-90.28,180.55,-90.29,180.38C-90.3,180.2,-90.32,180.04,-90.32,180.03L-90.32,180.01L-90.3,180.01C-90.28,180.01,-90.26,180.01,-90.24,180.01C-90.22,180.01,-90.19,180.01,-90.17,180L-90.14,180L-90.13,180.13C-90.12,180.2,-90.12,180.27,-90.12,180.28L-90.12,180.3L-90.05,180.21C-90.02,180.15,-89.98,180.08,-89.96,180.05L-89.92,179.99L-89.88,179.99C-89.86,179.98,-89.82,179.98,-89.8,179.98C-89.77,179.98,-89.74,179.97,-89.73,179.98L-89.71,179.98L-89.83,180.15L-89.94,180.32L-89.8,180.49C-89.72,180.59,-89.66,180.67,-89.66,180.67C-89.66,180.67,-89.66,180.67,-89.66,180.67C-89.68,180.67,-89.86,180.68,-89.86,180.69C-89.87,180.69,-89.9,180.65,-89.97,180.55C-90.03,180.48,-90.08,180.42,-90.08,180.42C-90.08,180.42,-90.09,180.43,-90.09,180.45L-90.11,180.47L-90.1,180.58C-90.09,180.67,-90.09,180.7,-90.09,180.7C-90.1,180.7,-90.14,180.71,-90.21,180.71C-90.26,180.71,-90.27,180.71,-90.27,180.71z"/>
      <path style="stroke:none;fill:#007BFF;fill-rule:evenodd" d="M-89.19,180.77C-89.27,180.75,-89.31,180.74,-89.36,180.72C-89.39,180.7,-89.47,180.65,-89.48,180.64C-89.48,180.64,-89.48,180.63,-89.45,180.49C-89.44,180.47,-89.43,180.47,-89.4,180.5C-89.35,180.57,-89.27,180.62,-89.19,180.64C-89.15,180.64,-89.15,180.64,-89.13,180.64C-89.09,180.62,-89.08,180.6,-89.08,180.57C-89.09,180.54,-89.12,180.51,-89.18,180.48C-89.25,180.45,-89.28,180.43,-89.31,180.4C-89.37,180.35,-89.38,180.29,-89.37,180.22C-89.35,180.14,-89.3,180.08,-89.21,180.06C-89.17,180.05,-89.1,180.05,-89.05,180.06C-88.98,180.07,-88.91,180.1,-88.84,180.15C-88.81,180.17,-88.81,180.17,-88.81,180.18C-88.81,180.19,-88.82,180.22,-88.83,180.26C-88.85,180.32,-88.85,180.33,-88.86,180.32C-88.86,180.32,-88.87,180.32,-88.87,180.31C-88.89,180.3,-88.93,180.25,-88.95,180.24C-89,180.2,-89.07,180.18,-89.11,180.19C-89.17,180.19,-89.2,180.23,-89.18,180.27C-89.17,180.28,-89.14,180.3,-89.08,180.34C-88.98,180.39,-88.92,180.43,-88.9,180.49C-88.89,180.51,-88.89,180.57,-88.89,180.6C-88.92,180.71,-89.01,180.77,-89.14,180.77C-89.16,180.77,-89.18,180.77,-89.19,180.77z"/>
      <path style="stroke:none;fill:#007BFF;fill-rule:evenodd" d="M-91.1,180.9C-91.13,180.83,-91.2,180.69,-91.25,180.59C-91.29,180.48,-91.33,180.39,-91.33,180.39C-91.33,180.39,-91.25,180.35,-91.14,180.3C-91.08,180.28,-91.02,180.25,-91,180.25C-90.92,180.22,-90.85,180.23,-90.8,180.28C-90.78,180.3,-90.76,180.33,-90.74,180.37C-90.73,180.4,-90.73,180.41,-90.73,180.44C-90.73,180.47,-90.73,180.49,-90.74,180.51C-90.75,180.54,-90.77,180.57,-90.78,180.58C-90.78,180.58,-90.79,180.59,-90.79,180.59C-90.79,180.59,-90.75,180.61,-90.58,180.7C-90.52,180.73,-90.47,180.76,-90.46,180.76C-90.45,180.77,-90.46,180.77,-90.55,180.81C-90.6,180.83,-90.65,180.85,-90.65,180.85C-90.65,180.85,-90.72,180.82,-90.8,180.78L-90.93,180.7L-90.96,180.71C-90.97,180.72,-90.99,180.72,-90.99,180.72C-90.99,180.72,-90.97,180.78,-90.94,180.84C-90.91,180.9,-90.89,180.95,-90.89,180.95C-90.89,180.96,-90.91,180.97,-90.96,180.99C-91.01,181.01,-91.04,181.03,-91.04,181.03C-91.05,181.03,-91.07,180.97,-91.1,180.9zM-90.99,180.59C-90.93,180.55,-90.9,180.53,-90.9,180.49C-90.9,180.45,-90.93,180.41,-90.95,180.4C-90.98,180.38,-91.01,180.39,-91.07,180.42C-91.1,180.43,-91.11,180.44,-91.12,180.44C-91.12,180.44,-91.04,180.61,-91.04,180.61C-91.04,180.61,-91.02,180.6,-90.99,180.59z"/>
      <path style="stroke:none;fill:#007BFF;fill-rule:evenodd" d="M-88.33,181.18C-88.37,181.15,-88.4,181.13,-88.4,181.13C-88.4,181.13,-88.36,181.07,-88.31,181C-88.27,180.93,-88.23,180.88,-88.23,180.87C-88.23,180.87,-88.36,180.78,-88.4,180.75L-88.42,180.74L-88.51,180.87C-88.55,180.94,-88.59,180.99,-88.6,180.99C-88.6,180.99,-88.74,180.9,-88.74,180.89C-88.74,180.89,-88.56,180.63,-88.38,180.37C-88.36,180.35,-88.34,180.32,-88.34,180.32C-88.34,180.32,-88.23,180.39,-88.2,180.42C-88.2,180.42,-88.23,180.47,-88.27,180.52C-88.3,180.58,-88.34,180.62,-88.34,180.63C-88.34,180.63,-88.3,180.66,-88.25,180.7C-88.2,180.73,-88.15,180.76,-88.15,180.76C-88.15,180.76,-88.11,180.72,-88.08,180.66C-88.04,180.6,-88,180.56,-88,180.56C-88,180.56,-87.86,180.65,-87.86,180.66C-87.86,180.66,-88.25,181.23,-88.26,181.23C-88.26,181.23,-88.29,181.21,-88.33,181.18z"/>
      <path style="stroke:none;fill:#007BFF;fill-rule:evenodd" d="M-91.75,181.53C-91.89,181.51,-92.04,181.37,-92.08,181.22C-92.09,181.18,-92.09,181.11,-92.08,181.07C-92.05,180.96,-91.94,180.85,-91.82,180.82C-91.79,180.81,-91.7,180.81,-91.66,180.82C-91.6,180.84,-91.54,180.88,-91.48,180.93C-91.43,180.99,-91.39,181.04,-91.37,181.1C-91.36,181.13,-91.36,181.14,-91.36,181.18C-91.36,181.23,-91.36,181.26,-91.38,181.3C-91.4,181.36,-91.47,181.44,-91.53,181.48C-91.6,181.53,-91.67,181.54,-91.75,181.53zM-91.61,181.36C-91.55,181.34,-91.51,181.27,-91.53,181.21C-91.55,181.11,-91.66,181,-91.76,180.97C-91.81,180.96,-91.85,180.97,-91.88,181.01C-91.9,181.02,-91.92,181.06,-91.93,181.09C-91.94,181.14,-91.9,181.22,-91.83,181.28C-91.75,181.36,-91.67,181.39,-91.61,181.36z"/>
      <path style="stroke:none;fill:#007BFF;fill-rule:evenodd" d="M-90.37,181.63C-90.38,181.62,-90.39,181.61,-90.42,181.55C-90.47,181.42,-90.47,181.42,-90.49,181.42C-90.5,181.42,-90.55,181.42,-90.61,181.42L-90.72,181.42L-90.72,181.43C-90.74,181.45,-90.77,181.48,-90.79,181.5C-90.86,181.53,-90.93,181.51,-90.98,181.46C-90.99,181.45,-91,181.43,-91.01,181.42C-91.02,181.4,-91.02,181.39,-91.02,181.36C-91.02,181.33,-91.02,181.32,-91.01,181.3C-90.99,181.27,-90.97,181.24,-90.93,181.22C-90.91,181.21,-90.9,181.21,-90.87,181.21C-90.81,181.21,-90.76,181.23,-90.73,181.28L-90.72,181.3L-90.58,181.3C-90.44,181.31,-90.44,181.31,-90.42,181.32C-90.4,181.32,-90.4,181.33,-90.38,181.37C-90.36,181.39,-90.33,181.46,-90.31,181.51C-90.29,181.56,-90.27,181.6,-90.26,181.61C-90.25,181.63,-90.26,181.63,-90.31,181.63C-90.34,181.63,-90.37,181.63,-90.37,181.63z"/>
      <path style="stroke:none;fill:#007BFF;fill-rule:evenodd" d="M-87.69,181.81C-87.79,181.79,-87.87,181.72,-87.92,181.61C-87.96,181.52,-87.96,181.43,-87.92,181.35C-87.88,181.25,-87.77,181.16,-87.65,181.12C-87.64,181.12,-87.61,181.11,-87.59,181.11C-87.54,181.1,-87.5,181.1,-87.45,181.12C-87.35,181.15,-87.25,181.27,-87.22,181.39C-87.21,181.44,-87.22,181.52,-87.24,181.58C-87.28,181.66,-87.36,181.73,-87.46,181.78C-87.52,181.81,-87.55,181.82,-87.61,181.82C-87.65,181.82,-87.67,181.82,-87.69,181.81zM-87.61,181.65C-87.52,181.62,-87.42,181.54,-87.38,181.47C-87.37,181.44,-87.37,181.4,-87.38,181.36C-87.39,181.33,-87.41,181.3,-87.45,181.29C-87.47,181.28,-87.47,181.27,-87.51,181.28C-87.55,181.28,-87.59,181.29,-87.64,181.31C-87.71,181.35,-87.76,181.4,-87.78,181.45C-87.79,181.48,-87.79,181.48,-87.79,181.52C-87.79,181.55,-87.79,181.56,-87.78,181.57C-87.75,181.64,-87.69,181.67,-87.61,181.65z"/>
      <path style="stroke:none;fill:#007BFF;fill-rule:evenodd" d="M-91.18,182.04C-91.24,182.02,-91.28,181.95,-91.28,181.89C-91.28,181.85,-91.27,181.82,-91.24,181.78C-91.2,181.75,-91.18,181.74,-91.12,181.74C-91.08,181.74,-91.07,181.74,-91.05,181.75C-91.02,181.76,-90.99,181.79,-90.97,181.82L-90.96,181.84L-90.8,181.84L-90.64,181.84L-90.64,181.88C-90.64,181.9,-90.64,181.92,-90.64,181.93L-90.64,181.95L-90.8,181.95L-90.96,181.95L-90.98,181.97C-91,182,-91.04,182.03,-91.06,182.04C-91.07,182.04,-91.09,182.04,-91.12,182.05C-91.15,182.05,-91.16,182.05,-91.18,182.04z"/>
      <path style="stroke:none;fill:#007BFF;fill-rule:evenodd" d="M-90.43,182.1C-90.44,182.09,-90.45,182.09,-90.45,182.06L-90.45,182.04L-90.47,182.03C-90.51,182.01,-90.52,182,-90.54,181.98C-90.55,181.95,-90.56,181.9,-90.54,181.87C-90.53,181.85,-90.49,181.81,-90.47,181.81C-90.45,181.8,-90.45,181.8,-90.45,181.78C-90.44,181.75,-90.44,181.75,-90.43,181.74C-90.43,181.74,-90.4,181.74,-90.38,181.74L-90.33,181.74L-90.33,181.75C-90.32,181.75,-90.32,181.82,-90.32,181.93C-90.32,182.07,-90.32,182.09,-90.33,182.1C-90.34,182.1,-90.42,182.1,-90.43,182.1z"/>
      <path style="stroke:none;fill:#007BFF;fill-rule:evenodd" d="M-88.59,182.13L-88.59,182L-88.7,181.81C-88.76,181.71,-88.81,181.62,-88.81,181.62C-88.81,181.62,-88.78,181.62,-88.72,181.62L-88.63,181.62L-88.57,181.73C-88.53,181.79,-88.51,181.84,-88.51,181.84C-88.5,181.84,-88.48,181.79,-88.45,181.73L-88.39,181.62L-88.3,181.62C-88.25,181.62,-88.21,181.62,-88.21,181.62C-88.21,181.62,-88.41,181.97,-88.42,181.98C-88.43,181.99,-88.43,182.02,-88.43,182.12L-88.43,182.26L-88.51,182.26L-88.59,182.26L-88.59,182.13z"/>
      <path style="stroke:none;fill:#007BFF;fill-rule:evenodd" d="M-89.31,182.25C-89.31,182.25,-89.31,182.23,-89.31,182.2L-89.31,182.15L-89.26,182.14L-89.22,182.14L-89.22,181.94L-89.22,181.73L-89.26,181.73L-89.31,181.73L-89.31,181.67L-89.31,181.62L-89.14,181.62L-88.96,181.62L-88.96,181.67L-88.96,181.73L-89.01,181.73L-89.05,181.73L-89.05,181.94L-89.05,182.14L-89.01,182.14L-88.96,182.14L-88.96,182.2L-88.96,182.26L-89.13,182.26C-89.23,182.26,-89.31,182.25,-89.31,182.25z"/>
      <path style="stroke:none;fill:#007BFF;fill-rule:evenodd" d="M-89.91,182.26C-89.96,182.25,-89.99,182.23,-90.05,182.19C-90.12,182.15,-90.15,182.13,-90.19,182.11L-90.22,182.1L-90.22,182.05C-90.22,182.03,-90.22,181.94,-90.22,181.87L-90.22,181.73L-90.2,181.73C-90.16,181.71,-90.11,181.69,-90.06,181.65C-90.01,181.61,-89.95,181.59,-89.92,181.58C-89.82,181.55,-89.73,181.56,-89.65,181.61C-89.56,181.65,-89.5,181.72,-89.46,181.82C-89.45,181.85,-89.45,181.86,-89.45,181.92L-89.45,181.99L-89.47,182.03C-89.49,182.08,-89.51,182.12,-89.55,182.15C-89.6,182.21,-89.66,182.25,-89.74,182.26C-89.79,182.28,-89.86,182.27,-89.91,182.26zM-89.72,181.74L-89.72,181.7L-89.8,181.7L-89.87,181.7L-89.87,181.74L-89.87,181.77L-89.8,181.77L-89.72,181.77L-89.72,181.74zM-90.03,181.89L-90.03,181.7L-90.06,181.7L-90.1,181.7L-90.1,181.89L-90.1,182.08L-90.06,182.08L-90.03,182.08L-90.03,181.89zM-89.57,181.89L-89.57,181.7L-89.6,181.7L-89.64,181.7L-89.64,181.89L-89.64,182.08L-89.6,182.08L-89.57,182.08L-89.57,181.89zM-89.87,182.15L-89.87,182.08L-89.8,182.08L-89.72,182.08L-89.72,181.96L-89.72,181.85L-89.8,181.85L-89.87,181.85L-89.87,181.89L-89.87,181.92L-89.83,181.92L-89.79,181.93L-89.79,181.96L-89.79,182L-89.87,182L-89.95,182L-89.95,182.12C-89.95,182.18,-89.95,182.23,-89.94,182.23C-89.94,182.23,-89.93,182.23,-89.91,182.23L-89.87,182.23L-89.87,182.15z"/>
      <path style="stroke:none;fill:#007BFF;fill-rule:evenodd" d="M-92.15,182.55C-92.18,182.55,-92.22,182.54,-92.26,182.54C-92.29,182.53,-92.34,182.53,-92.37,182.53C-92.4,182.52,-92.43,182.52,-92.45,182.52C-92.47,182.51,-92.51,182.51,-92.54,182.51C-92.57,182.5,-92.62,182.5,-92.65,182.49C-92.68,182.49,-92.73,182.49,-92.76,182.48C-92.79,182.48,-92.81,182.48,-92.81,182.48C-92.81,182.47,-92.8,182.44,-92.78,182.39C-92.75,182.31,-92.75,182.31,-92.74,182.31C-92.74,182.31,-92.7,182.31,-92.67,182.32C-92.64,182.32,-92.59,182.33,-92.56,182.33C-92.53,182.34,-92.49,182.34,-92.48,182.35C-92.47,182.35,-92.44,182.35,-92.41,182.36C-92.38,182.36,-92.34,182.37,-92.32,182.37C-92.3,182.37,-92.29,182.38,-92.29,182.37C-92.29,182.37,-92.37,182.31,-92.48,182.24C-92.59,182.17,-92.67,182.11,-92.67,182.11C-92.68,182.1,-92.66,182.07,-92.65,182.02L-92.62,181.94L-92.6,181.94C-92.59,181.94,-92.56,181.95,-92.53,181.95C-92.5,181.95,-92.45,181.96,-92.43,181.96C-92.4,181.97,-92.37,181.97,-92.35,181.97C-92.33,181.98,-92.3,181.98,-92.2,181.99C-92.18,181.99,-92.16,182,-92.15,182C-92.15,182,-92.22,181.95,-92.34,181.87C-92.45,181.8,-92.54,181.75,-92.54,181.75C-92.54,181.74,-92.48,181.58,-92.48,181.58C-92.47,181.58,-91.88,181.98,-91.88,181.99C-91.88,181.99,-91.95,182.16,-91.95,182.16C-91.95,182.17,-91.99,182.16,-92.24,182.14C-92.27,182.14,-92.31,182.13,-92.33,182.13C-92.35,182.13,-92.38,182.12,-92.38,182.12C-92.39,182.12,-92.39,182.12,-92.38,182.13C-92.38,182.13,-92.3,182.18,-92.21,182.25C-92.11,182.31,-92.03,182.37,-92.03,182.37C-92.02,182.38,-92.09,182.55,-92.1,182.55C-92.1,182.55,-92.13,182.55,-92.15,182.55z"/>
      <path style="stroke:none;fill:#007BFF;fill-rule:evenodd" d="M-87.13,182.56C-87.14,182.56,-87.17,182.55,-87.18,182.54C-87.24,182.49,-87.27,182.44,-87.3,182.34C-87.31,182.31,-87.32,182.28,-87.32,182.28C-87.32,182.28,-87.33,182.28,-87.36,182.29C-87.48,182.32,-87.53,182.33,-87.54,182.33C-87.54,182.33,-87.58,182.16,-87.58,182.16C-87.58,182.16,-87.53,182.14,-87.47,182.13C-87.4,182.11,-87.3,182.09,-87.23,182.07C-87.17,182.06,-87.07,182.03,-87.01,182.02C-86.96,182,-86.91,181.99,-86.9,181.99C-86.9,181.99,-86.89,182.02,-86.87,182.12C-86.82,182.29,-86.82,182.31,-86.82,182.36C-86.82,182.47,-86.87,182.54,-86.98,182.57C-87.02,182.58,-87.09,182.58,-87.13,182.56zM-87.03,182.39C-86.99,182.38,-86.97,182.35,-86.97,182.3C-86.97,182.28,-86.98,182.21,-86.99,182.2C-86.99,182.2,-87.02,182.2,-87.08,182.22C-87.14,182.23,-87.18,182.24,-87.18,182.25C-87.19,182.25,-87.17,182.32,-87.16,182.34C-87.15,182.36,-87.12,182.39,-87.1,182.39C-87.08,182.4,-87.06,182.4,-87.03,182.39z"/>
      <path style="stroke:none;fill:#007BFF;fill-rule:evenodd" d="M-90.94,182.61C-90.97,182.59,-91,182.56,-91.01,182.53C-91.02,182.51,-91.02,182.5,-91.02,182.47C-91.02,182.44,-91.02,182.43,-91.01,182.41C-90.99,182.38,-90.97,182.35,-90.93,182.34C-90.91,182.33,-90.91,182.32,-90.86,182.32C-90.82,182.32,-90.82,182.32,-90.8,182.34C-90.77,182.35,-90.74,182.38,-90.72,182.4L-90.71,182.42L-90.6,182.42C-90.52,182.42,-90.48,182.42,-90.48,182.41C-90.47,182.41,-90.45,182.36,-90.43,182.3L-90.38,182.2L-90.33,182.2C-90.3,182.2,-90.28,182.2,-90.27,182.2C-90.26,182.21,-90.26,182.21,-90.27,182.22C-90.27,182.23,-90.29,182.27,-90.3,182.3C-90.32,182.34,-90.35,182.4,-90.36,182.43C-90.39,182.5,-90.41,182.52,-90.43,182.53C-90.44,182.53,-90.51,182.53,-90.58,182.53L-90.72,182.53L-90.73,182.55C-90.75,182.58,-90.77,182.6,-90.8,182.61C-90.81,182.62,-90.82,182.62,-90.86,182.62C-90.91,182.62,-90.91,182.62,-90.94,182.61z"/>
      <path style="stroke:none;fill:#007BFF;fill-rule:evenodd" d="M-89.82,182.83C-89.83,182.83,-89.83,182.81,-89.83,182.79L-89.83,182.74L-88.33,182.74L-86.83,182.74L-86.83,182.79L-86.83,182.83L-88.32,182.83C-89.15,182.83,-89.82,182.83,-89.82,182.83z"/>
      <path style="stroke:none;fill:#007BFF;fill-rule:evenodd" d="M-90.83,182.97L-90.83,182.93L-88.83,182.93L-86.83,182.93L-86.83,182.97L-86.83,183.01L-88.83,183.01L-90.83,183.01L-90.83,182.97z"/>
      <path style="stroke:none;fill:#007BFF;fill-rule:evenodd" d="M-92.82,183.15L-92.82,183.1L-89.82,183.1L-86.83,183.1L-86.83,183.15L-86.83,183.19L-89.82,183.19L-92.82,183.19L-92.82,183.15z"/>
    </symbol>
  </svg>

  <header class="hero">
    <div class="hero-inner">
      <div class="hero-left">
        <svg class="hero-logo" aria-hidden="true" focusable="false"><use href="#wdiLogo"></use></svg>

        <div class="hero-titles">
          <div id="heroTitle" class="hero-title">ESP32-CAM Robot</div>
          <div class="hero-subtitle">
            workshop-diy.org
            <span id="heroBuild" class="hero-badge">--</span>
          </div>
        </div>
      </div>

      <div class="hero-tabs" role="tablist" aria-label="View">
        <button id="tabDrive" class="hero-tab is-active" type="button"
                role="tab" aria-selected="true">Drive</button>
        <button id="tabProgram" class="hero-tab" type="button"
                role="tab" aria-selected="false">Program</button>
      </div>

      <div class="hero-right">
        <button id="settingsToggle" class="hero-pill" type="button"
                aria-controls="settingsSidebar" aria-expanded="false"
                title="Open settings"><span class="pill-icon">⚙</span><span class="pill-text">Settings</span></button>

        <button id="debugToggle" class="hero-pill" type="button"
                aria-controls="debugSidebar" aria-expanded="false"
                title="Open debug sidebar"><span class="pill-icon">☰</span><span class="pill-text">Debug</span></button>

        <div id="linkPill" class="hero-pill hero-link" aria-live="polite">
          <span class="pill-dot"></span><span id="linkText" class="pill-text">Connecting</span>
        </div>
      </div>
    </div>
  </header>

  <aside id="settingsSidebar" class="settings-sidebar" aria-label="Settings sidebar">
    <h2>Settings</h2>

    <details class="settings-section" data-pref="camera" open>
      <summary>Camera</summary>

      <div class="setting-row">
        <div class="setting-head">
          <label for="cameraResolution">Resolution</label>
        </div>
        <select id="cameraResolution" class="camera-select">
          <option value="QQVGA">QQVGA — 160×120</option>
          <option value="QVGA">QVGA — 320×240</option>
          <option value="VGA" selected>VGA — 640×480</option>
          <option value="SVGA" data-psram="1">SVGA — 800×600</option>
          <option value="XGA" data-psram="1">XGA — 1024×768</option>
          <option value="SXGA" data-psram="1">SXGA — 1280×1024</option>
          <option value="UXGA" data-psram="1">UXGA — 1600×1200</option>
        </select>
      </div>

      <div class="setting-row">
        <div class="setting-head">
          <label for="cameraRotation">Display rotation</label>
        </div>
        <select id="cameraRotation" class="camera-select">
          <option value="0">0° — normal</option>
          <option value="90">90° clockwise</option>
          <option value="180">180°</option>
          <option value="270">270° clockwise</option>
        </select>
        <div class="debug-small">
          Rotation is applied in the browser display. Vertical flip and
          horizontal mirror are still applied by the camera sensor.
        </div>
      </div>

      <div class="setting-row">
        <div class="setting-head">
          <label for="cameraQuality">JPEG quality</label>
          <span id="cameraQualityValue" class="setting-value">10</span>
        </div>
        <input id="cameraQuality" class="camera-range"
               type="range" min="4" max="63" step="1" value="10">
        <div class="debug-small">Lower number = better image / larger JPEG.</div>
      </div>

      <div class="setting-row">
        <div class="setting-head">
          <label for="cameraBrightness">Brightness</label>
          <span id="cameraBrightnessValue" class="setting-value">0</span>
        </div>
        <input id="cameraBrightness" class="camera-range"
               type="range" min="-2" max="2" step="1" value="0">
      </div>

      <div class="setting-row">
        <div class="setting-head">
          <label for="cameraContrast">Contrast</label>
          <span id="cameraContrastValue" class="setting-value">0</span>
        </div>
        <input id="cameraContrast" class="camera-range"
               type="range" min="-2" max="2" step="1" value="0">
      </div>

      <div class="setting-row">
        <div class="setting-head">
          <label for="cameraSaturation">Saturation</label>
          <span id="cameraSaturationValue" class="setting-value">0</span>
        </div>
        <input id="cameraSaturation" class="camera-range"
               type="range" min="-2" max="2" step="1" value="0">
      </div>

      <label class="camera-check">
        <input id="cameraVFlip" type="checkbox">
        Vertical flip
      </label>

      <label class="camera-check">
        <input id="cameraHMirror" type="checkbox">
        Horizontal mirror
      </label>

      <div class="setting-row">
        <div class="setting-head">
          <label for="ledBrightnessSlider">Flash LED brightness</label>
          <span id="ledBrightnessValue" class="setting-value">255 / 255 (100%)</span>
        </div>
        <input id="ledBrightnessSlider" class="camera-range"
               type="range" min="0" max="255" step="1" value="255">
        <div class="debug-small">
          Sets GPIO4 flash LED intensity. The OFF/ON button on the robot controls
          whether this brightness is applied.
        </div>
      </div>

      <button id="cameraReset" class="settings-action" type="button">
        Reset camera defaults
      </button>

      <div id="cameraStatus" class="camera-status">
        Open Settings to read camera status.
      </div>
    </details>

    <details class="settings-section" data-pref="robot">
      <summary>Robot</summary>

      <div class="setting-row">
        <div class="setting-head"><strong>Name</strong></div>
        <div class="robot-name-row">
          <input id="robotNameInput" class="ota-input" type="text"
                 maxlength="32" autocomplete="off"
                 placeholder="Name this robot">
          <button id="robotNameSave" class="slot-button" type="button">Save</button>
        </div>
        <div class="setting-note">
          Shown in the header and used for exported files. Eight identical
          robots in a room are only told apart by this.
        </div>
      </div>

      <div class="setting-row">
        <div class="setting-head">
          <strong>Speed limit</strong>
          <span id="speedCapValue" class="setting-value">255 / 255</span>
        </div>
        <input id="speedCapSlider" class="camera-range" type="range"
               min="20" max="255" step="5" value="255">
        <div class="setting-note">
          The robot refuses anything above this, however the command arrives.
        </div>
      </div>

      <div class="setting-row">
        <div class="setting-head"><strong>Wake-up numbers</strong></div>
        <div class="setting-note">
          Left wheel: <strong id="thresholdLeft">not measured</strong><br>
          Right wheel: <strong id="thresholdRight">not measured</strong>
        </div>
        <button id="activityOpen" class="slot-button" type="button">Measure them</button>
      </div>

      <div id="robotSettingsStatus" class="setting-note"></div>
    </details>

    <details class="settings-section" data-pref="wifi">
      <summary>Wi-Fi</summary>

      <div class="setting-row">
        <div class="setting-head">
          <strong>Now</strong>
          <span id="wifiNow" class="setting-value">--</span>
        </div>
      </div>

      <div class="setting-row">
        <button id="wifiScan" class="slot-button" type="button">Scan for networks</button>
        <div class="setting-note">
          A scan uses the same radio as the video, so expect a hiccup of a
          second or two.
        </div>
        <div id="wifiList" class="wifi-list"></div>
      </div>

      <div class="setting-row">
        <label class="ota-label" for="wifiSsidInput">Network name</label>
        <input id="wifiSsidInput" class="ota-input" type="text" maxlength="32"
               autocomplete="off" placeholder="Network name">

        <label class="ota-label" for="wifiPassInput">Password</label>
        <input id="wifiPassInput" class="ota-input" type="password" maxlength="64"
               autocomplete="off" placeholder="Empty for an open network">

        <button id="wifiConnect" class="program-action program-play" type="button">
          Save and connect
        </button>

        <div class="setting-note">
          The robot keeps its own access point running throughout, so a failed
          attempt cannot lock you out -- but you may be disconnected for a few
          seconds while it tries. The password is stored on the robot in plain
          text; treat it as convenience, not security.
        </div>

        <div id="wifiStatus" class="setting-note"></div>
      </div>
    </details>

    <details class="settings-section" data-pref="serial">
      <summary>USB Serial console</summary>

      <div id="webSerialSupport" class="serial-web-status">
        Checking browser serial support...
      </div>

      <div class="serial-toolbar">
        <select id="serialBaud" class="camera-select" aria-label="Serial baud rate">
          <option value="9600">9600</option>
          <option value="19200">19200</option>
          <option value="38400">38400</option>
          <option value="57600">57600</option>
          <option value="115200" selected>115200</option>
          <option value="230400">230400</option>
          <option value="460800">460800</option>
        </select>

        <button id="serialSelectPort" class="settings-action serial-inline-button" type="button">
          Select port
        </button>

        <button id="serialConnect" class="settings-action serial-inline-button" type="button" disabled>
          Connect
        </button>

        <button id="serialDisconnect" class="settings-action serial-inline-button" type="button" disabled>
          Disconnect
        </button>
      </div>

      <div class="serial-port-info">
        <span>Port</span>
        <strong id="serialPortLabel">None selected</strong>
      </div>

      <div class="serial-capture-actions">
        <label class="camera-check serial-autoscroll">
          <input id="serialAutoScroll" type="checkbox" checked>
          Auto-scroll
        </label>

        <button id="serialClear" class="debug-clear" type="button">Clear</button>
        <button id="serialSave" class="debug-clear" type="button">Save capture</button>
      </div>

      <pre id="serialTerminal" class="serial-terminal" aria-live="polite"></pre>

      <div class="serial-send-row">
        <input
          id="serialCommandInput"
          class="ota-input"
          type="text"
          autocomplete="off"
          spellcheck="false"
          placeholder="help, status, log, camera, stop">
        <button id="serialSend" class="settings-action serial-send-button" type="button" disabled>
          Send
        </button>
      </div>

      <ul class="serial-info">
        <li>ESP32 UART: 115200 baud, 8N1</li>
        <li>U0T / GPIO1 → USB-TTL RX</li>
        <li>U0R / GPIO3 ← USB-TTL TX</li>
        <li>Connect GND ↔ GND</li>
        <li>Use a 3.3V TTL serial adapter.</li>
      </ul>

      <div class="serial-commands">
        Commands: help · status · log · camera · stop
      </div>

      <div class="debug-small">
        Direct COM-port access uses the browser Web Serial API. Chrome/Edge
        require a secure page (HTTPS or localhost), so it may be unavailable
        when this robot page is opened directly from a LAN IP address.
      </div>
    </details>

    <details class="settings-section" data-pref="ota">
      <summary>Firmware update (OTA)</summary>

    <div class="ota-panel">
      <div class="ota-build">
        <span>Build</span>
        <strong id="dbgBuild">--</strong>
      </div>

      <label class="ota-label" for="otaPassword">OTA password</label>
      <input
        id="otaPassword"
        class="ota-input"
        type="password"
        inputmode="numeric"
        autocomplete="off"
        placeholder="Enter OTA password">

      <label class="ota-file-label" for="otaFile">Firmware .bin</label>
      <input
        id="otaFile"
        class="ota-file"
        type="file"
        accept=".bin,application/octet-stream">

      <button id="otaUploadButton" class="ota-upload" type="button">
        Upload firmware
      </button>

      <div class="ota-progress-shell" aria-hidden="true">
        <div id="otaProgressBar" class="ota-progress-bar"></div>
      </div>
      <div id="otaProgressText" class="ota-progress-text">No update selected.</div>

      <div class="ota-warning">
        Motors stop before update. Do not remove power while firmware is uploading.
      </div>
    </div>
    </details>
  </aside>

  <aside id="debugSidebar" class="debug-sidebar" aria-label="Debug sidebar">
    <h2>Robot Debug</h2>

    <div class="debug-grid">
      <span class="label">Motion</span><span id="dbgMotion" class="value">--</span>
      <span class="label">Left target</span><span id="dbgLeftTarget" class="value">--</span>
      <span class="label">Right target</span><span id="dbgRightTarget" class="value">--</span>
      <span class="label">Left output</span><span id="dbgLeftOutput" class="value">--</span>
      <span class="label">Right output</span><span id="dbgRightOutput" class="value">--</span>
      <span class="label">Flash LED</span><span id="dbgLed" class="value">--</span>
      <span class="label">Network mode</span><span id="dbgNetworkMode" class="value">--</span>
      <span class="label">STA status</span><span id="dbgStaStatus" class="value">--</span>
      <span class="label">Network SSID</span><span id="dbgNetworkSsid" class="value">--</span>
      <span class="label">Robot IP</span><span id="dbgRobotIp" class="value">--</span>
      <span class="label">AP clients</span><span id="dbgApClients" class="value">--</span>
      <span class="label">Wi-Fi RSSI</span><span id="dbgRssi" class="value">--</span>
      <span class="label">Uptime</span><span id="dbgUptime" class="value">--</span>
      <span class="label">Stream</span><span id="dbgStream" class="value">--</span>
    </div>

    <div class="debug-status-row">
      <span id="dbgConnection" class="debug-connection">Paused</span>

      <div class="debug-log-actions">
        <button id="exportDebugLog" class="debug-clear" type="button">Export log</button>
        <button id="clearDebugLog" class="debug-clear" type="button">Clear log</button>
      </div>
    </div>

    <div id="dbgActionStatus" class="debug-small"></div>

    <div id="dbgMessage" class="debug-message">Open the sidebar to start live debugging.</div>

    <div class="debug-log-title">Event log</div>
    <div id="dbgLog" class="debug-log" aria-live="polite"></div>

    <div class="debug-small">
      The ESP32 keeps the latest 64 debug events, with newest events shown first. Use Export log to save the visible status and event history as a text file. If normal Wi-Fi is unavailable,
      connect to the robot's fallback AP and open 192.168.4.1. Debug polling runs
      only while this sidebar is open, once a second. Stream shows the frame
      rate the robot is actually sending.
    </div>
  </aside>

  <div class="robot">
    <div id="videoFrame" class="video-frame">
      <img src="" id="photo" alt="ESP32-CAM video stream">

      <div id="streamStatus" class="stream-status" aria-live="polite"></div>

      <div class="video-footer">
        <div class="video-overlay video-brand">
<svg class="brand-logo" aria-hidden="true" focusable="false"><use href="#wdiLogo"></use></svg>
          <span>workshop-diy.org</span>
        </div>

        <div class="video-overlay video-telemetry">
          <span id="videoSsid">--</span>
          <span id="videoFps">-- fps</span>
          <span id="videoRssi">-- dBm</span>
          <span id="videoMotion">STOP</span>
        </div>
      </div>
    </div>

    <div id="programBar" class="program-bar">
      <button id="recordButton" class="program-action program-record" type="button">
        <span class="record-dot"></span><span id="recordLabel">Record</span>
      </button>

      <button id="photoButton" class="program-action" type="button">Photo</button>

      <button id="galleryButton" class="program-action" type="button" hidden>
        Photos <span id="galleryCount">0</span>
      </button>

      <span id="programStatus" class="program-status">Drive, and the robot writes down what you did.</span>

      <button id="programStopButton" class="program-action program-stop" type="button" hidden>Stop</button>
    </div>

    <div id="driveView">
    <div class="panel">
      <div class="ui-version">UI: Sync + Serial + Camera Settings + Rotation</div>

      <div class="sync-row">
        <label class="sync-control">
          <input id="syncMotors" type="checkbox">
          Sync motors
        </label>
        <span class="sync-note">When enabled, either control changes both.</span>
      </div>

      <div class="motor-control">
        <div class="speed-row">
          <label for="leftSpeedSlider">Left motor</label>
          <span id="leftSpeedValue" class="speed-value">220 / 255 (86%)</span>
        </div>

        <div class="motor-adjust">
          <button class="pwm-step" type="button"
                  data-motor="left" data-delta="-1"
                  aria-label="Decrease left motor speed by 1">−1</button>

          <input
            id="leftSpeedSlider"
            class="motor-slider"
            type="range"
            min="0"
            max="255"
            step="1"
            value="220"
            aria-label="Left motor speed">

          <button class="pwm-step" type="button"
                  data-motor="left" data-delta="1"
                  aria-label="Increase left motor speed by 1">+1</button>
        </div>

        <div class="speed-scale">
          <span>0</span>
          <span>Full range</span>
          <span>255</span>
        </div>
      </div>

      <div class="motor-control">
        <div class="speed-row">
          <label for="rightSpeedSlider">Right motor</label>
          <span id="rightSpeedValue" class="speed-value">220 / 255 (86%)</span>
        </div>

        <div class="motor-adjust">
          <button class="pwm-step" type="button"
                  data-motor="right" data-delta="-1"
                  aria-label="Decrease right motor speed by 1">−1</button>

          <input
            id="rightSpeedSlider"
            class="motor-slider"
            type="range"
            min="0"
            max="255"
            step="1"
            value="220"
            aria-label="Right motor speed">

          <button class="pwm-step" type="button"
                  data-motor="right" data-delta="1"
                  aria-label="Increase right motor speed by 1">+1</button>
        </div>

        <div class="speed-scale">
          <span>0</span>
          <span>Full range</span>
          <span>255</span>
        </div>
      </div>

      <div class="button-container">
        <button class="button forward drive" data-action="forward" aria-label="Forward">↑</button>
        <button id="ledButton" class="led-button led" type="button">OFF</button>

        <button class="button left drive" data-action="left" aria-label="Left">←</button>
        <button class="button stop" id="stopButton" type="button" aria-label="Stop">●</button>
        <button class="button right drive" data-action="right" aria-label="Right">→</button>

        <button class="button backward drive" data-action="backward" aria-label="Backward">↓</button>
      </div>

      <div class="note">
        Each motor can be set independently from 0 to 255.
        At very low values a motor may buzz without rotating; that lets students
        discover the real starting threshold of each motor.
        This PCB already uses a TB6612FNG H-bridge; this build keeps the existing forward/left/right UI while driving it through the schematic pinout.
      </div>
    </div>
    </div>

    <div id="programView" class="panel" hidden>
      <div class="program-head">
        <strong>Your program</strong>
        <span id="programCount" class="program-count">no steps yet</span>
      </div>

      <div id="programSteps" class="program-steps"></div>

      <div class="program-buttons">
        <button id="playButton" class="program-action program-play" type="button">Play</button>
        <button id="clearProgramButton" class="program-action" type="button">Clear</button>
      </div>

      <div class="program-slots">
        <div class="program-slot" data-slot="1">
          <span class="slot-name">Slot 1</span>
          <span class="slot-info" data-slot-info="1">empty</span>
          <button class="slot-button" data-slot-save="1" type="button">Save</button>
          <button class="slot-button" data-slot-load="1" type="button">Load</button>
        </div>
        <div class="program-slot" data-slot="2">
          <span class="slot-name">Slot 2</span>
          <span class="slot-info" data-slot-info="2">empty</span>
          <button class="slot-button" data-slot-save="2" type="button">Save</button>
          <button class="slot-button" data-slot-load="2" type="button">Load</button>
        </div>
        <div class="program-slot" data-slot="3">
          <span class="slot-name">Slot 3</span>
          <span class="slot-info" data-slot-info="3">empty</span>
          <button class="slot-button" data-slot-save="3" type="button">Save</button>
          <button class="slot-button" data-slot-load="3" type="button">Load</button>
        </div>
      </div>

      <div class="note">
        Each line is one instruction and the pause before it. Change a pause,
        delete a line, then press Play and watch what changes. The robot stops
        the moment you press Stop, leave this page, or switch away from it.
      </div>
    </div>
  </div>

  <div id="galleryModal" class="modal" hidden>
    <div class="modal-card">
      <div class="modal-head">
        <strong>Photos</strong>
        <button id="galleryClose" class="slot-button" type="button">Close</button>
      </div>
      <div id="galleryGrid" class="gallery-grid"></div>
      <div class="note">
        Photos live in this browser until you close the page. Save the ones
        you want to keep.
      </div>
    </div>
  </div>

  <div id="activityModal" class="modal" hidden>
    <div class="modal-card">
      <div class="modal-head">
        <strong>Find the wake-up number</strong>
        <button id="activityClose" class="slot-button" type="button">Close</button>
      </div>

      <p class="activity-line">
        Watch the <strong id="activityWheel">left</strong> wheel. Power is at
        <strong id="activityValue">20</strong> out of 255.
      </p>

      <div class="activity-buttons">
        <button id="activityHigher" class="program-action" type="button">Not moving - go higher</button>
        <button id="activityMoving" class="program-action program-play" type="button">It is moving!</button>
      </div>

      <p id="activityResult" class="activity-result"></p>

      <div class="note">
        A motor needs a push before it turns at all, and no two motors need
        the same one. Below that number it only buzzes - do not leave it there.
      </div>
    </div>
  </div>

  <script>
    const photo = document.getElementById("photo");
    const videoFrame = document.getElementById("videoFrame");
    const leftSpeedSlider = document.getElementById("leftSpeedSlider");
    const rightSpeedSlider = document.getElementById("rightSpeedSlider");
    const leftSpeedValue = document.getElementById("leftSpeedValue");
    const rightSpeedValue = document.getElementById("rightSpeedValue");
    const ledButton = document.getElementById("ledButton");
    const stopButton = document.getElementById("stopButton");
    const syncMotors = document.getElementById("syncMotors");

    const settingsToggle = document.getElementById("settingsToggle");
    const settingsSidebar = document.getElementById("settingsSidebar");
    const cameraResolution = document.getElementById("cameraResolution");
    const cameraRotation = document.getElementById("cameraRotation");
    const cameraQuality = document.getElementById("cameraQuality");
    const cameraQualityValue = document.getElementById("cameraQualityValue");
    const cameraBrightness = document.getElementById("cameraBrightness");
    const cameraBrightnessValue = document.getElementById("cameraBrightnessValue");
    const cameraContrast = document.getElementById("cameraContrast");
    const cameraContrastValue = document.getElementById("cameraContrastValue");
    const cameraSaturation = document.getElementById("cameraSaturation");
    const cameraSaturationValue = document.getElementById("cameraSaturationValue");
    const cameraVFlip = document.getElementById("cameraVFlip");
    const cameraHMirror = document.getElementById("cameraHMirror");
    const ledBrightnessSlider = document.getElementById("ledBrightnessSlider");
    const ledBrightnessValue = document.getElementById("ledBrightnessValue");
    const cameraReset = document.getElementById("cameraReset");
    const cameraStatus = document.getElementById("cameraStatus");

    const webSerialSupport = document.getElementById("webSerialSupport");
    const serialBaud = document.getElementById("serialBaud");
    const serialSelectPort = document.getElementById("serialSelectPort");
    const serialConnect = document.getElementById("serialConnect");
    const serialDisconnect = document.getElementById("serialDisconnect");
    const serialPortLabel = document.getElementById("serialPortLabel");
    const serialAutoScroll = document.getElementById("serialAutoScroll");
    const serialClear = document.getElementById("serialClear");
    const serialSave = document.getElementById("serialSave");
    const serialTerminal = document.getElementById("serialTerminal");
    const serialCommandInput = document.getElementById("serialCommandInput");
    const serialSend = document.getElementById("serialSend");

    const debugToggle = document.getElementById("debugToggle");
    const debugSidebar = document.getElementById("debugSidebar");
    const dbgMotion = document.getElementById("dbgMotion");
    const dbgLeftTarget = document.getElementById("dbgLeftTarget");
    const dbgRightTarget = document.getElementById("dbgRightTarget");
    const dbgLeftOutput = document.getElementById("dbgLeftOutput");
    const dbgRightOutput = document.getElementById("dbgRightOutput");
    const dbgLed = document.getElementById("dbgLed");
    const dbgNetworkMode = document.getElementById("dbgNetworkMode");
    const dbgStaStatus = document.getElementById("dbgStaStatus");
    const dbgNetworkSsid = document.getElementById("dbgNetworkSsid");
    const dbgRobotIp = document.getElementById("dbgRobotIp");
    const dbgApClients = document.getElementById("dbgApClients");
    const dbgRssi = document.getElementById("dbgRssi");
    const dbgUptime = document.getElementById("dbgUptime");
    const dbgStream = document.getElementById("dbgStream");
    const dbgMessage = document.getElementById("dbgMessage");
    const dbgConnection = document.getElementById("dbgConnection");
    const dbgLog = document.getElementById("dbgLog");
    const clearDebugLog = document.getElementById("clearDebugLog");
    const exportDebugLog = document.getElementById("exportDebugLog");
    const dbgBuild = document.getElementById("dbgBuild");
    const dbgActionStatus = document.getElementById("dbgActionStatus");
    const heroBuild = document.getElementById("heroBuild");
    const linkPill = document.getElementById("linkPill");
    const linkText = document.getElementById("linkText");

    // Only the icon changes when a sidebar opens; the label stays put.
    const settingsIcon = settingsToggle.querySelector(".pill-icon");
    const debugIcon = debugToggle.querySelector(".pill-icon");

    // What the header pill says about the robot as a whole.
    const LINK_STATES = {
      connecting: "Connecting",
      live: "Live",
      novideo: "No video",
      offline: "Offline"
    };

    function setLinkState(state) {
      if (!LINK_STATES[state]) return;

      linkText.textContent = LINK_STATES[state];
      linkPill.classList.remove(
        "is-live", "is-novideo", "is-offline"
      );

      if (state !== "connecting") linkPill.classList.add("is-" + state);
    }
    const otaPassword = document.getElementById("otaPassword");
    const otaFile = document.getElementById("otaFile");
    const otaUploadButton = document.getElementById("otaUploadButton");
    const otaProgressBar = document.getElementById("otaProgressBar");
    const otaProgressText = document.getElementById("otaProgressText");

    let ledState = false;
    let leftSpeedTimer = null;
    let rightSpeedTimer = null;
    let cameraSettingTimer = null;
    let cameraRotationDegrees = 0;
    let debugTimer = null;
    let lastEventId = 0;

    let selectedSerialPort = null;
    let serialReader = null;
    let serialReadLoopActive = false;
    let serialCaptureText = "";
    let debugLogCount = 0;

    const CAMERA_DIMENSIONS = {
      QQVGA: [160, 120],
      QVGA:  [320, 240],
      VGA:   [640, 480],
      SVGA:  [800, 600],
      XGA:   [1024, 768],
      SXGA:  [1280, 1024],
      UXGA:  [1600, 1200]
    };

    function cameraDimensions() {
      const selected = cameraResolution.value;
      return CAMERA_DIMENSIONS[selected] || [640, 480];
    }

    // Per-viewer preferences. Anything the robot owns -- camera tuning, motor
    // speeds, LED -- is saved on the robot instead, so a second browser does
    // not restore a different set of values over it.
    const PREF_PREFIX = "esp32Robot";

    function prefGet(key, fallback) {
      try {
        const value = localStorage.getItem(PREF_PREFIX + key);
        return value === null ? fallback : value;
      } catch (error) {
        return fallback;
      }
    }

    function prefSet(key, value) {
      try {
        localStorage.setItem(PREF_PREFIX + key, String(value));
      } catch (error) {
      }
    }

    function applyImageRotation(degrees) {
      const normalized =
        ((Number(degrees) || 0) % 360 + 360) % 360;

      cameraRotationDegrees = [0, 90, 180, 270].includes(normalized)
        ? normalized
        : 0;

      cameraRotation.value = String(cameraRotationDegrees);

      prefSet("CameraRotation", cameraRotationDegrees);

      const [sourceWidth, sourceHeight] = cameraDimensions();
      const quarterTurn =
        cameraRotationDegrees === 90 ||
        cameraRotationDegrees === 270;

      if (quarterTurn) {
        videoFrame.style.aspectRatio =
          sourceHeight + " / " + sourceWidth;
      } else {
        videoFrame.style.aspectRatio =
          sourceWidth + " / " + sourceHeight;
      }

      // Wait for the wrapper to settle, then size the unrotated image so its
      // rotated bounding box fits the wrapper exactly.
      requestAnimationFrame(() => {
        const frameWidth = videoFrame.clientWidth;
        const frameHeight = videoFrame.clientHeight;

        if (quarterTurn) {
          photo.style.width = frameHeight + "px";
          photo.style.height = frameWidth + "px";
        } else {
          photo.style.width = frameWidth + "px";
          photo.style.height = frameHeight + "px";
        }

        photo.style.transform =
          "translate(-50%, -50%) rotate(" +
          cameraRotationDegrees +
          "deg)";
      });
    }

    function restoreImageRotation() {
      applyImageRotation(prefGet("CameraRotation", "0"));
    }

    window.addEventListener("resize", () => {
      applyImageRotation(cameraRotationDegrees);
    });

    cameraRotation.addEventListener("change", () => {
      applyImageRotation(cameraRotation.value);
      cameraStatus.textContent =
        "Display rotation set to " +
        cameraRotationDegrees +
        "°";
    });

    // ---- Camera stream supervisor ---------------------------------------
    // The stream used to be started once and never looked at again, so any
    // drop -- a resolution change, a Wi-Fi hiccup, a second tab taking the
    // single stream slot -- left a frozen picture until the page was
    // reloaded by hand.

    const streamStatus = document.getElementById("streamStatus");
    const videoTelemetry = document.querySelector(".video-telemetry");
    const videoSsid = document.getElementById("videoSsid");
    const videoFps = document.getElementById("videoFps");
    const videoRssi = document.getElementById("videoRssi");
    const videoMotion = document.getElementById("videoMotion");

    // Below this the link is on its way out. The video usually survives a
    // while longer than the commands do, so this is the earliest honest
    // warning the picture can give a driver.
    const RSSI_WEAK_DBM = -75;
    const MOTION_TIMEOUT_FLASH_MS = 3000;

    let lastMotionTimeouts = null;
    let motionTimeoutFlashUntil = 0;

    // The readouts are dim until one of them matters.
    function refreshTelemetryEmphasis() {
      const awake =
        videoMotion.classList.contains("is-moving") ||
        videoRssi.classList.contains("is-weak") ||
        Date.now() < motionTimeoutFlashUntil;

      videoTelemetry.classList.toggle("is-awake", awake);
    }

    // Frame rate is measured on the robot, not here: a browser reports a
    // multipart image as loaded once, so the page cannot count frames.
    function setVideoFps(fps10) {
      videoFps.textContent = (fps10 === null || fps10 === undefined)
        ? "-- fps"
        : ((fps10 / 10).toFixed(1) + " fps");
    }

    // Which network the picture is arriving over. This is identity, not an
    // alarm: it stays at rest opacity and deliberately does not feed
    // refreshTelemetryEmphasis(), which means "something needs you now".
    function setVideoSsid(ssid) {
      videoSsid.textContent = ssid || "--";
    }

    function setVideoRssi(rssi, valid) {
      if (!valid) {
        videoRssi.textContent = "-- dBm";
        videoRssi.classList.remove("is-weak");
      } else {
        videoRssi.textContent = rssi + " dBm";
        videoRssi.classList.toggle("is-weak", rssi <= RSSI_WEAK_DBM);
      }

      refreshTelemetryEmphasis();
    }

    function setVideoMotion(text, moving) {
      // A timeout flash owns the field until it expires; it is the more
      // important thing to be reading.
      if (Date.now() < motionTimeoutFlashUntil) return;

      videoMotion.textContent = text;
      videoMotion.classList.toggle("is-moving", Boolean(moving));
      refreshTelemetryEmphasis();
    }

    // Called on press and release, so the field answers immediately rather
    // than at the next poll. The robot's own view arrives below and overrides
    // it -- which is the point: if a command was lost, this corrects itself.
    function showLocalMotion(action) {
      setVideoMotion(action ? action.toUpperCase() : "STOP", Boolean(action));
    }

    function applyTelemetry(data) {
      setVideoSsid(data.networkSsid);
      setVideoFps(data.streamActive ? data.streamFps10 : null);
      setVideoRssi(Number(data.rssi), Boolean(data.rssiValid));

      const timeouts = Number(data.motionTimeouts) || 0;

      if (lastMotionTimeouts !== null && timeouts > lastMotionTimeouts) {
        // The dead man's switch fired. Without this the robot just stops and
        // the reason is buried in an event log nobody is reading mid-drive.
        motionTimeoutFlashUntil = Date.now() + MOTION_TIMEOUT_FLASH_MS;

        videoMotion.textContent = "TIMEOUT";
        videoMotion.classList.remove("is-moving");
        videoMotion.classList.add("is-timeout");

        setTimeout(() => {
          videoMotion.classList.remove("is-timeout");
          refreshTelemetryEmphasis();
        }, MOTION_TIMEOUT_FLASH_MS);
      }

      lastMotionTimeouts = timeouts;

      const moving = data.motion && data.motion !== "STOPPED";
      setVideoMotion(
        moving ? (data.motion + " " + data.left + "/" + data.right) : "STOP",
        moving
      );

      refreshTelemetryEmphasis();
    }

    // 1x1 transparent GIF. Assigning it aborts the MJPEG connection cleanly;
    // an empty src would fire an error and re-request the page instead.
    const BLANK_IMAGE =
      "data:image/gif;base64,R0lGODlhAQABAIAAAAAAAP///yH5BAEAAAAALAAAAAABAAEAAAIBRAA7";

    const STREAM_RETRY_MIN_MS = 1000;
    const STREAM_RETRY_MAX_MS = 8000;
    const STREAM_CHECK_MS = 3000;

    // A new connection needs a moment to show up in the robot's own view of
    // the stream; do not judge it before then.
    const STREAM_GRACE_MS = 5000;

    let streamStopped = true;
    let streamStartedAtMs = 0;
    let streamRetryDelayMs = STREAM_RETRY_MIN_MS;
    let streamRetryTimer = null;

    function setStreamStatus(text) {
      streamStatus.textContent = text || "";
    }

    function streamUrl() {
      const url = new URL(window.location.href);

      // The cache buster matters on reconnect: without it a browser can hand
      // back the dead connection it already has for this URL.
      return url.protocol + "//" + url.hostname +
        ":81/stream?t=" + Date.now();
    }

    function startStream() {
      clearTimeout(streamRetryTimer);
      streamRetryTimer = null;

      streamStopped = false;
      streamStartedAtMs = Date.now();

      setVideoFps(null);
      setStreamStatus("Connecting to the camera...");
      photo.src = streamUrl();
    }

    function stopStream() {
      clearTimeout(streamRetryTimer);
      streamRetryTimer = null;

      streamStopped = true;
      setVideoFps(null);
      photo.src = BLANK_IMAGE;
    }

    function scheduleStreamRestart(reason) {
      if (streamRetryTimer !== null) return;

      setStreamStatus(reason);
      stopStream();

      streamRetryTimer = setTimeout(() => {
        streamRetryTimer = null;
        startStream();
      }, streamRetryDelayMs);

      // Back off, so a robot that is powered down is not hammered.
      streamRetryDelayMs = Math.min(
        streamRetryDelayMs * 2,
        STREAM_RETRY_MAX_MS
      );
    }

    photo.addEventListener("load", () => {
      if (streamStopped) return;

      // Browsers report a multipart image as loaded once, when the first
      // frame arrives -- so this says the stream started, not that it is
      // still running. checkStreamHealth() below answers the second question.
      streamRetryDelayMs = STREAM_RETRY_MIN_MS;
      setStreamStatus("");
    });

    photo.addEventListener("error", () => {
      if (streamStopped) return;
      scheduleStreamRestart("Camera stream dropped. Reconnecting...");
    });

    // A stream that ends cleanly -- a failed capture, a reboot, another tab
    // taking the single stream slot -- produces no error event at all: the
    // picture simply stops. The robot knows whether it is still sending, and
    // the control server answers even while the stream server is busy.
    async function checkStreamHealth() {
      if (document.hidden) return;

      let data = null;

      try {
        const response = await fetch("/camera?stream=1", {
          cache: "no-store"
        });

        if (!response.ok) return;

        data = await response.json();
      } catch (error) {
        // Not just the video: the robot is not answering at all.
        setLinkState("offline");
        return;
      }

      const live = Boolean(data.streamActive) && data.streamFps10 > 0;

      // The readouts and the header pill are reported whatever the stream is
      // doing; only the decision to restart it is held back below.
      applyTelemetry(data);
      setLinkState(live ? "live" : "novideo");

      if (streamStopped) return;
      if (Date.now() - streamStartedAtMs < STREAM_GRACE_MS) return;

      if (!live) {
        scheduleStreamRestart("Camera stream stopped. Reconnecting...");
      }
    }

    setInterval(checkStreamHealth, STREAM_CHECK_MS);

    window.addEventListener("pagehide", () => {
      // Close the connection on the way out so the robot's single stream slot
      // is free for the page that replaces this one.
      stopStream();
    });

    window.addEventListener("pageshow", (event) => {
      // Coming back through the browser's back/forward cache restores a page
      // whose stream was closed by pagehide, and fires no visibility change.
      if (event.persisted) startStream();
    });

    document.addEventListener("visibilitychange", () => {
      // The robot serves one viewer at a time; a hidden tab should not sit on
      // the slot, and it should not spend radio time on frames nobody sees.
      if (document.hidden) {
        stopStream();
        setStreamStatus("Stream paused while this tab is hidden.");
      } else {
        // Give the robot a moment to notice the socket we abandoned before
        // asking it for a new one, or it answers the request it is still
        // busy with and the reconnect has to back off instead.
        clearTimeout(streamRetryTimer);
        setStreamStatus("Connecting to the camera...");

        streamRetryTimer = setTimeout(() => {
          streamRetryTimer = null;
          startStream();
        }, 500);
      }
    });

    function restoreViewerPreferences() {
      const savedBaud = prefGet("SerialBaud", null);

      if (savedBaud &&
          [...serialBaud.options].some((o) => o.value === savedBaud)) {
        serialBaud.value = savedBaud;
      }

      serialAutoScroll.checked = prefGet("SerialAutoScroll", "1") === "1";

      showView(prefGet("View", "drive"));
      renderSlots();
      renderProgram();

      document.querySelectorAll(".settings-section[data-pref]")
        .forEach((section) => {
          const saved = prefGet("Section:" + section.dataset.pref, null);
          if (saved !== null) section.open = saved === "1";
        });
    }

    serialBaud.addEventListener("change", () => {
      prefSet("SerialBaud", serialBaud.value);
    });

    serialAutoScroll.addEventListener("change", () => {
      prefSet("SerialAutoScroll", serialAutoScroll.checked ? "1" : "0");
    });

    document.querySelectorAll(".settings-section[data-pref]")
      .forEach((section) => {
        const summary = section.querySelector("summary");
        if (!summary) return;

        // Saving on the "toggle" event would also record the browser's own
        // session-history restoration of <details>, which fires after load
        // and would overwrite the stored choice with the previous one. A
        // click is the only signal that means the person wanted this.
        summary.addEventListener("click", () => {
          // The click runs before the element flips, so the value being
          // chosen is the opposite of what it reads right now.
          prefSet("Section:" + section.dataset.pref, section.open ? "0" : "1");
        });
      });

    window.addEventListener("load", () => {
      restoreImageRotation();
      startStream();

      restoreViewerPreferences();

      // Again on the next task: Chromium reinstates <details> open state from
      // session history after load, and would otherwise reopen a section the
      // viewer had closed.
      setTimeout(restoreViewerPreferences, 60);

      // Reads the robot's build stamp, motor speeds and LED state. It sends
      // nothing: the robot is the source of truth for all three.
      adoptRobotState(false);
    });

    function request(path) {
      const xhr = new XMLHttpRequest();
      xhr.open("GET", path, true);
      xhr.send();
    }

    function sendAction(action) {
      request("/action?go=" + encodeURIComponent(action));
    }

    function clamp255(value) {
      const number = Number(value);
      if (!Number.isFinite(number)) return 0;
      return Math.max(0, Math.min(255, Math.round(number)));
    }

    function speedLabel(value) {
      const v = clamp255(value);
      const percent = Math.round((v / 255) * 100);
      return v + " / 255 (" + percent + "%)";
    }

    function ledBrightnessLabel(value) {
      const v = clamp255(value);
      const percent = Math.round((v / 255) * 100);
      return v + " / 255 (" + percent + "%)";
    }

    function sendMotorSpeed(motor, value) {
      const v = clamp255(value);
      recordStep({ kind: "speed", motor: motor, value: v });
      request("/action?" + motor + "Speed=" + v);
    }

    function setMotorUi(motor, value) {
      const v = clamp255(value);

      if (motor === "left") {
        leftSpeedSlider.value = String(v);
        leftSpeedValue.textContent = speedLabel(v);
      } else {
        rightSpeedSlider.value = String(v);
        rightSpeedValue.textContent = speedLabel(v);
      }

      return v;
    }

    function sendSyncedMotorSpeed(value) {
      const v = clamp255(value);
      setMotorUi("left", v);
      setMotorUi("right", v);
      sendMotorSpeed("left", v);
      sendMotorSpeed("right", v);
    }

    function scheduleMotorSpeed(motor, value) {
      const v = setMotorUi(motor, value);

      if (syncMotors.checked) {
        setMotorUi(motor === "left" ? "right" : "left", v);

        clearTimeout(leftSpeedTimer);
        clearTimeout(rightSpeedTimer);

        leftSpeedTimer = setTimeout(() => {
          sendMotorSpeed("left", v);
          sendMotorSpeed("right", v);
        }, 60);

        return;
      }

      if (motor === "left") {
        clearTimeout(leftSpeedTimer);
        leftSpeedTimer = setTimeout(() => sendMotorSpeed("left", v), 60);
      } else {
        clearTimeout(rightSpeedTimer);
        rightSpeedTimer = setTimeout(() => sendMotorSpeed("right", v), 60);
      }
    }

    function commitMotorSpeed(motor, value) {
      const v = setMotorUi(motor, value);

      clearTimeout(leftSpeedTimer);
      clearTimeout(rightSpeedTimer);

      if (syncMotors.checked) {
        sendSyncedMotorSpeed(v);
      } else {
        sendMotorSpeed(motor, v);
      }
    }

    leftSpeedSlider.addEventListener("input", () => {
      userAdjustedControls = true;
      scheduleMotorSpeed("left", leftSpeedSlider.value);
    });

    leftSpeedSlider.addEventListener("change", () => {
      commitMotorSpeed("left", leftSpeedSlider.value);
    });

    rightSpeedSlider.addEventListener("input", () => {
      userAdjustedControls = true;
      scheduleMotorSpeed("right", rightSpeedSlider.value);
    });

    rightSpeedSlider.addEventListener("change", () => {
      commitMotorSpeed("right", rightSpeedSlider.value);
    });

    syncMotors.addEventListener("change", () => {
      if (syncMotors.checked) {
        // Left motor becomes the initial reference when sync is enabled.
        sendSyncedMotorSpeed(leftSpeedSlider.value);
      }
    });

    document.querySelectorAll(".pwm-step").forEach((button) => {
      button.addEventListener("click", () => {
        const motor = button.dataset.motor;
        const delta = Number(button.dataset.delta) || 0;
        const slider = motor === "left"
          ? leftSpeedSlider
          : rightSpeedSlider;

        commitMotorSpeed(
          motor,
          clamp255(Number(slider.value) + delta)
        );
      });
    });


    function formatUptime(ms) {
      let totalSeconds = Math.floor(ms / 1000);
      const hours = Math.floor(totalSeconds / 3600);
      totalSeconds %= 3600;
      const minutes = Math.floor(totalSeconds / 60);
      const seconds = totalSeconds % 60;
      return String(hours).padStart(2, "0") + ":" +
             String(minutes).padStart(2, "0") + ":" +
             String(seconds).padStart(2, "0");
    }

    function appendDebugEvent(event) {
      if (!event || !event.message) return;

      const entry = document.createElement("div");
      entry.className = "debug-log-entry";

      entry.textContent =
        "[" + formatUptime(event.timeMs) + "] #" + event.id + "  " + event.message;

      // Newest events go at the TOP of the log.
      dbgLog.prepend(entry);
      debugLogCount++;

      // Keep only the newest 60 entries.
      while (debugLogCount > 60 && dbgLog.lastChild) {
        dbgLog.removeChild(dbgLog.lastChild);
        debugLogCount--;
      }

      // Keep the newest event visible.
      dbgLog.scrollTop = 0;
    }

    clearDebugLog.addEventListener("click", () => {
      dbgLog.textContent = "";
      debugLogCount = 0;
      dbgActionStatus.textContent = "Event log view cleared.";
      // lastEventId is intentionally kept. Clearing the view should not make
      // old buffered ESP32 events reappear on the next refresh.
    });

    function safeFilePart(value) {
      return String(value || "")
        .trim()
        .replace(/[^a-zA-Z0-9._-]+/g, "_")
        .replace(/^_+|_+$/g, "");
    }

    exportDebugLog.addEventListener("click", () => {
      const eventLines = Array.from(
        dbgLog.querySelectorAll(".debug-log-entry")
      ).map((entry) => entry.textContent);

      const now = new Date();
      const exportedAt = now.toLocaleString();

      const header = [
        "ESP32-CAM Robot Debug Log",
        "Exported: " + exportedAt,
        "",
        "STATUS",
        "Motion: " + dbgMotion.textContent,
        "Left target: " + dbgLeftTarget.textContent,
        "Right target: " + dbgRightTarget.textContent,
        "Left output: " + dbgLeftOutput.textContent,
        "Right output: " + dbgRightOutput.textContent,
        "Flash LED: " + dbgLed.textContent,
        "Network mode: " + dbgNetworkMode.textContent,
        "STA status: " + dbgStaStatus.textContent,
        "Network SSID: " + dbgNetworkSsid.textContent,
        "Robot IP: " + dbgRobotIp.textContent,
        "AP clients: " + dbgApClients.textContent,
        "Wi-Fi RSSI: " + dbgRssi.textContent,
        "Uptime: " + dbgUptime.textContent,
        "Build: " + dbgBuild.textContent,
        "",
        "LATEST MESSAGE",
        dbgMessage.textContent || "(none)",
        "",
        "EVENT LOG (newest first)"
      ];

      const body = eventLines.length
        ? eventLines
        : ["(no events currently displayed)"];

      const content = header.concat(body).join("\r\n") + "\r\n";

      // UTF-8 BOM + real CRLF line endings give a clean Windows .txt file.
      const blob = new Blob(["\uFEFF", content], {
        type: "text/plain;charset=utf-8"
      });

      const url = URL.createObjectURL(blob);
      const link = document.createElement("a");

      const stamp =
        now.getFullYear() +
        String(now.getMonth() + 1).padStart(2, "0") +
        String(now.getDate()).padStart(2, "0") + "_" +
        String(now.getHours()).padStart(2, "0") +
        String(now.getMinutes()).padStart(2, "0") +
        String(now.getSeconds()).padStart(2, "0");

      const robotName =
        safeFilePart(dbgNetworkSsid.textContent) || "ESP32-Robot";

      link.href = url;
      link.download = robotName + "_debug_" + stamp + ".txt";
      document.body.appendChild(link);
      link.click();
      link.remove();

      setTimeout(() => URL.revokeObjectURL(url), 1000);

      dbgActionStatus.textContent = "Debug log exported as a text file.";
    });

    function stopDebugPolling() {
      if (debugTimer !== null) {
        clearInterval(debugTimer);
        debugTimer = null;
      }

      dbgConnection.textContent = "Paused";
      dbgConnection.classList.remove("live", "error");
    }

    function startDebugPolling() {
      // Polling exists to feed this sidebar. The OTA flow restarts it when an
      // upload finishes, and OTA now lives in the settings sidebar -- which
      // means the debug sidebar is closed at that moment. Without this guard
      // the poll would run on against a panel nobody is looking at.
      if (!debugSidebar.classList.contains("open")) return;
      if (debugTimer !== null) return;

      refreshDebug();
      // Every poll is its own connection on the same radio the video uses.
      // Once a second is plenty for a status panel.
      debugTimer = setInterval(refreshDebug, 1000);
    }

    function serialAppend(textChunk) {
      if (!textChunk) return;

      serialCaptureText += textChunk;

      // Keep the in-browser capture bounded to ~1 MB.
      if (serialCaptureText.length > 1000000) {
        serialCaptureText = serialCaptureText.slice(-750000);
      }

      serialTerminal.textContent = serialCaptureText;

      if (serialAutoScroll.checked) {
        serialTerminal.scrollTop = serialTerminal.scrollHeight;
      }
    }

    function serialSetStatus(message, state) {
      webSerialSupport.textContent = message;
      webSerialSupport.classList.remove("ok", "error");

      if (state) {
        webSerialSupport.classList.add(state);
      }
    }

    function serialPortDescription(port) {
      if (!port || typeof port.getInfo !== "function") {
        return "Selected serial port";
      }

      const info = port.getInfo();
      const parts = [];

      if (info.usbVendorId !== undefined) {
        parts.push(
          "VID 0x" +
          Number(info.usbVendorId).toString(16).padStart(4, "0").toUpperCase()
        );
      }

      if (info.usbProductId !== undefined) {
        parts.push(
          "PID 0x" +
          Number(info.usbProductId).toString(16).padStart(4, "0").toUpperCase()
        );
      }

      return parts.length ? parts.join(" · ") : "Selected serial port";
    }

    function updateSerialButtons() {
      const supported = "serial" in navigator;
      const isOpen = Boolean(
        selectedSerialPort &&
        selectedSerialPort.readable &&
        selectedSerialPort.writable
      );

      serialSelectPort.disabled = !supported || isOpen;
      serialConnect.disabled = !supported || !selectedSerialPort || isOpen;
      serialDisconnect.disabled = !isOpen;
      serialSend.disabled = !isOpen;
      serialBaud.disabled = isOpen;
    }

    function detectWebSerial() {
      if (!("serial" in navigator)) {
        const reason = window.isSecureContext
          ? "This browser does not expose Web Serial. Use current Chrome or Edge."
          : "Web Serial is blocked because this page is not a secure context. " +
            "Chrome/Edge require HTTPS or localhost for direct COM-port access.";

        serialSetStatus(reason, "error");
        updateSerialButtons();
        return;
      }

      serialSetStatus(
        "Web Serial ready. Select your USB-TTL adapter, then connect at 115200 baud.",
        "ok"
      );
      updateSerialButtons();
    }

    async function readSerialLoop() {
      if (!selectedSerialPort || !selectedSerialPort.readable) return;

      serialReadLoopActive = true;
      const decoder = new TextDecoder();

      try {
        serialReader = selectedSerialPort.readable.getReader();

        while (serialReadLoopActive) {
          const result = await serialReader.read();

          if (result.done) break;

          if (result.value) {
            serialAppend(
              decoder.decode(result.value, { stream: true })
            );
          }
        }

        serialAppend(decoder.decode());
      } catch (error) {
        if (serialReadLoopActive) {
          serialAppend(
            "\n[SERIAL READ ERROR] " + error.message + "\n"
          );
        }
      } finally {
        if (serialReader) {
          try {
            serialReader.releaseLock();
          } catch (error) {
          }
        }

        serialReader = null;
        serialReadLoopActive = false;
      }
    }

    async function disconnectSerialPort() {
      serialReadLoopActive = false;

      if (serialReader) {
        try {
          await serialReader.cancel();
        } catch (error) {
        }
      }

      if (selectedSerialPort) {
        try {
          await selectedSerialPort.close();
        } catch (error) {
        }
      }

      serialAppend("\n[SERIAL] Disconnected\n");
      serialSetStatus("Serial port disconnected.", "");
      updateSerialButtons();
    }

    serialSelectPort.addEventListener("click", async () => {
      if (!("serial" in navigator)) {
        detectWebSerial();
        return;
      }

      try {
        selectedSerialPort = await navigator.serial.requestPort();
        serialPortLabel.textContent =
          serialPortDescription(selectedSerialPort);

        serialSetStatus(
          "Port selected. Click Connect to start capturing UART output.",
          "ok"
        );
      } catch (error) {
        if (error.name !== "NotFoundError") {
          serialSetStatus(
            "Port selection failed: " + error.message,
            "error"
          );
        }
      }

      updateSerialButtons();
    });

    serialConnect.addEventListener("click", async () => {
      if (!selectedSerialPort) return;

      try {
        const baudRate = Math.max(
          300,
          Math.min(2000000, Number(serialBaud.value) || 115200)
        );

        await selectedSerialPort.open({
          baudRate: baudRate,
          dataBits: 8,
          stopBits: 1,
          parity: "none",
          flowControl: "none"
        });

        serialCaptureText = "";
        serialTerminal.textContent = "";

        serialAppend(
          "[SERIAL] Connected at " + baudRate + " baud\n"
        );

        serialSetStatus(
          "Connected and capturing UART output.",
          "ok"
        );

        updateSerialButtons();
        readSerialLoop();
      } catch (error) {
        serialSetStatus(
          "Could not open serial port: " + error.message,
          "error"
        );
        updateSerialButtons();
      }
    });

    serialDisconnect.addEventListener("click", () => {
      disconnectSerialPort();
    });

    serialClear.addEventListener("click", () => {
      serialCaptureText = "";
      serialTerminal.textContent = "";
    });

    serialSave.addEventListener("click", () => {
      const now = new Date();

      const stamp =
        now.getFullYear() +
        String(now.getMonth() + 1).padStart(2, "0") +
        String(now.getDate()).padStart(2, "0") + "_" +
        String(now.getHours()).padStart(2, "0") +
        String(now.getMinutes()).padStart(2, "0") +
        String(now.getSeconds()).padStart(2, "0");

      const header =
        "ESP32-CAM Robot USB Serial Capture\r\n" +
        "Captured: " + now.toLocaleString() + "\r\n" +
        "Baud: " + serialBaud.value + "\r\n" +
        "Port: " + serialPortLabel.textContent + "\r\n" +
        "\r\n";

      const normalized =
        serialCaptureText.replace(/\r?\n/g, "\r\n");

      const blob = new Blob(
        ["\uFEFF", header, normalized],
        { type: "text/plain;charset=utf-8" }
      );

      const url = URL.createObjectURL(blob);
      const link = document.createElement("a");

      link.href = url;
      link.download =
        "ESP32_Robot_USB_Serial_" + stamp + ".txt";

      document.body.appendChild(link);
      link.click();
      link.remove();

      setTimeout(() => URL.revokeObjectURL(url), 1000);
    });

    async function sendSerialCommand() {
      if (
        !selectedSerialPort ||
        !selectedSerialPort.writable
      ) {
        return;
      }

      const command = serialCommandInput.value.trim();
      if (!command) return;

      const writer = selectedSerialPort.writable.getWriter();

      try {
        const encoder = new TextEncoder();
        await writer.write(
          encoder.encode(command + "\r\n")
        );

        serialAppend("> " + command + "\n");
        serialCommandInput.value = "";
      } catch (error) {
        serialAppend(
          "\n[SERIAL WRITE ERROR] " + error.message + "\n"
        );
      } finally {
        writer.releaseLock();
      }
    }

    serialSend.addEventListener("click", sendSerialCommand);

    serialCommandInput.addEventListener("keydown", (event) => {
      if (event.key === "Enter") {
        event.preventDefault();
        sendSerialCommand();
      }
    });

    if ("serial" in navigator) {
      navigator.serial.addEventListener("disconnect", (event) => {
        if (event.target === selectedSerialPort) {
          serialAppend("\n[SERIAL] USB device disconnected\n");
          serialReadLoopActive = false;
          updateSerialButtons();
        }
      });
    }

    detectWebSerial();

    function closeSettingsSidebar() {
      settingsSidebar.classList.remove("open");
      settingsToggle.setAttribute("aria-expanded", "false");
      settingsIcon.textContent = "⚙";
      settingsToggle.title = "Open settings";
    }

    function closeDebugSidebar() {
      debugSidebar.classList.remove("open");
      debugToggle.setAttribute("aria-expanded", "false");
      debugIcon.textContent = "☰";
      debugToggle.title = "Open debug sidebar";
      stopDebugPolling();
    }

    async function refreshCameraSettings() {
      try {
        cameraStatus.textContent = "Reading camera settings...";

        const response = await fetch("/camera?get=1", {
          cache: "no-store"
        });

        const data = await response.json();

        if (!response.ok) {
          throw new Error(data.error || ("HTTP " + response.status));
        }

        cameraResolution.value = data.resolution;
        applyImageRotation(cameraRotationDegrees);
        cameraQuality.value = String(data.quality);
        cameraBrightness.value = String(data.brightness);
        cameraContrast.value = String(data.contrast);
        cameraSaturation.value = String(data.saturation);
        cameraVFlip.checked = Boolean(data.vflip);
        cameraHMirror.checked = Boolean(data.hmirror);

        cameraQualityValue.textContent = data.quality;
        cameraBrightnessValue.textContent = data.brightness;
        cameraContrastValue.textContent = data.contrast;
        cameraSaturationValue.textContent = data.saturation;

        cameraResolution.querySelectorAll("option[data-psram='1']")
          .forEach((option) => {
            option.disabled = !data.psram;
          });

        cameraStatus.textContent =
          data.resolution + ", JPEG quality " + data.quality +
          ", PSRAM " + (data.psram ? "available" : "not available");
      } catch (error) {
        cameraStatus.textContent =
          "Camera status error: " + error.message;
      }
    }

    async function setCameraSetting(name, value) {
      try {
        cameraStatus.textContent = "Applying " + name + "...";

        const response = await fetch(
          "/camera?" +
          encodeURIComponent(name) + "=" +
          encodeURIComponent(value),
          { cache: "no-store" }
        );

        const data = await response.json();

        if (!response.ok) {
          throw new Error(data.error || ("HTTP " + response.status));
        }

        await refreshCameraSettings();
      } catch (error) {
        cameraStatus.textContent =
          "Camera setting failed: " + error.message;
      }
    }

    function scheduleCameraSetting(name, value) {
      clearTimeout(cameraSettingTimer);
      cameraSettingTimer = setTimeout(() => {
        setCameraSetting(name, value);
      }, 120);
    }

    // Highest possible event id: asks /status for the status fields alone,
    // with no event backlog attached to the reply.
    const STATUS_WITHOUT_EVENTS = "4294967295";

    let buildFetched = false;

    // dbgBuild sits in the OTA card, which is in this sidebar, but it is
    // filled by the debug poll -- which only runs while the other sidebar is
    // open. Fetch it once, on demand: a build stamp cannot change without a
    // reboot, and a dash on the one field that confirms a flash worked is
    // worse than an extra request.
    async function ensureBuildInfo() {
      if (buildFetched) return;
      await adoptRobotState(true);
    }

    // The page used to push its own slider defaults into the robot on every
    // load, so opening a second tab reset the motor speeds and the LED under
    // whoever was driving. The robot owns those values -- and now remembers
    // them across a reboot -- so the page reads them instead.
    let robotStateAdopted = false;
    let userAdjustedControls = false;

    async function adoptRobotState(buildOnly) {
      let data = null;

      try {
        const response = await fetch(
          "/status?after=" + STATUS_WITHOUT_EVENTS,
          { cache: "no-store" }
        );

        if (!response.ok) return;

        data = await response.json();
      } catch (error) {
        return;
      }

      if (data.build) {
        dbgBuild.textContent = data.build;
        heroBuild.textContent = data.build;
        buildFetched = true;
      }

      showCurrentNetwork(data);

      if (data.robotName) applyRobotName(data.robotName);
      if (data.maxPwm) applySpeedCap(data.maxPwm);
      applyThresholds(data.leftThreshold, data.rightThreshold);

      // Once only, and never over a control the driver has already touched.
      if (buildOnly || robotStateAdopted || userAdjustedControls) return;
      robotStateAdopted = true;

      applyRobotName(data.robotName);
      applySpeedCap(data.maxPwm);
      applyThresholds(data.leftThreshold, data.rightThreshold);

      setMotorUi("left", data.leftTarget);
      setMotorUi("right", data.rightTarget);

      ledState = Boolean(data.ledEnabled);
      ledButton.classList.toggle("led-on", ledState);
      ledButton.textContent = ledState ? "ON" : "OFF";

      ledBrightnessSlider.value = String(clamp255(data.ledBrightness));
      ledBrightnessValue.textContent =
        ledBrightnessLabel(ledBrightnessSlider.value);
    }

    settingsToggle.addEventListener("click", () => {
      const isOpen = settingsSidebar.classList.toggle("open");
      settingsToggle.setAttribute("aria-expanded", isOpen ? "true" : "false");
      settingsIcon.textContent = isOpen ? "×" : "⚙";
      settingsToggle.title = isOpen ? "Close settings" : "Open settings";

      if (isOpen) {
        closeDebugSidebar();
        refreshCameraSettings();
        ensureBuildInfo();
      }
    });

    cameraResolution.addEventListener("change", async () => {
      // The sensor cannot be resized cleanly underneath a running stream, and
      // the video frame's aspect ratio has to follow the new size.
      stopStream();
      await setCameraSetting("resolution", cameraResolution.value);
      startStream();
    });

    cameraQuality.addEventListener("input", () => {
      cameraQualityValue.textContent = cameraQuality.value;
      scheduleCameraSetting("quality", cameraQuality.value);
    });

    cameraBrightness.addEventListener("input", () => {
      cameraBrightnessValue.textContent = cameraBrightness.value;
      scheduleCameraSetting("brightness", cameraBrightness.value);
    });

    cameraContrast.addEventListener("input", () => {
      cameraContrastValue.textContent = cameraContrast.value;
      scheduleCameraSetting("contrast", cameraContrast.value);
    });

    cameraSaturation.addEventListener("input", () => {
      cameraSaturationValue.textContent = cameraSaturation.value;
      scheduleCameraSetting("saturation", cameraSaturation.value);
    });

    cameraVFlip.addEventListener("change", () => {
      setCameraSetting("vflip", cameraVFlip.checked ? 1 : 0);
    });

    cameraHMirror.addEventListener("change", () => {
      setCameraSetting("hmirror", cameraHMirror.checked ? 1 : 0);
    });

    cameraReset.addEventListener("click", async () => {
      try {
        cameraStatus.textContent = "Resetting camera settings...";
        stopStream();
        const response = await fetch("/camera?reset=1", {
          cache: "no-store"
        });
        const data = await response.json();

        if (!response.ok) {
          throw new Error(data.error || ("HTTP " + response.status));
        }

        applyImageRotation(0);
        await refreshCameraSettings();
        startStream();
      } catch (error) {
        cameraStatus.textContent =
          "Camera reset failed: " + error.message;
        startStream();
      }
    });

    debugToggle.addEventListener("click", () => {
      const isOpen = debugSidebar.classList.toggle("open");
      debugToggle.setAttribute("aria-expanded", isOpen ? "true" : "false");
      debugIcon.textContent = isOpen ? "×" : "☰";
      debugToggle.title = isOpen ? "Close debug sidebar" : "Open debug sidebar";

      if (isOpen) {
        closeSettingsSidebar();
        startDebugPolling();
      } else {
        stopDebugPolling();
      }
    });

    async function refreshDebug() {
      try {
        const response = await fetch(
          "/status?after=" + encodeURIComponent(lastEventId),
          { cache: "no-store" }
        );
        if (!response.ok) throw new Error("HTTP " + response.status);
        const data = await response.json();

        dbgMotion.textContent = data.motion;
        dbgLeftTarget.textContent = data.leftTarget + " / 255";
        dbgRightTarget.textContent = data.rightTarget + " / 255";
        dbgLeftOutput.textContent = data.leftOutput + " / 255";
        dbgRightOutput.textContent = data.rightOutput + " / 255";
        dbgLed.textContent =
          (data.ledEnabled ? "ON " : "OFF ") +
          data.ledBrightness + " / 255";
        showCurrentNetwork(data);
        dbgNetworkMode.textContent = data.networkMode || "--";
        dbgStaStatus.textContent = data.staStatus || "--";
        dbgNetworkSsid.textContent = data.networkSsid || "--";
        dbgRobotIp.textContent = data.robotIp || "--";
        dbgApClients.textContent = String(data.apClients ?? 0);
        dbgRssi.textContent =
          data.rssiValid ? (data.rssi + " dBm") : "N/A";
        dbgUptime.textContent = formatUptime(data.uptimeMs);
        if (!streamStopped) {
          setVideoFps(data.streamActive ? data.streamFps10 : null);
        }

        const streamDrops = Number(data.streamDrops) || 0;
        dbgStream.textContent =
          (data.streamActive
            ? ((data.streamFps10 / 10).toFixed(1) + " fps")
            : "no viewer") +
          (streamDrops ? (" (" + streamDrops + " ended)") : "");
        if (data.build) {
          dbgBuild.textContent = data.build;
          heroBuild.textContent = data.build;
          buildFetched = true;
        }

        const message = data.message || "(no message)";
        dbgMessage.textContent = message;

        if (Array.isArray(data.events)) {
          data.events.forEach((event) => {
            if (event.id > lastEventId) {
              appendDebugEvent(event);
              lastEventId = event.id;
            }
          });
        }

        // If the ESP32 history wrapped while the sidebar was closed, advance
        // to the newest known sequence after receiving the retained events.
        if (Number.isFinite(data.latestEventId) && data.latestEventId > lastEventId) {
          lastEventId = data.latestEventId;
        }

        dbgConnection.textContent = "Live";
        dbgConnection.classList.add("live");
        dbgConnection.classList.remove("error");
      } catch (error) {
        const message = "Status connection error: " + error.message;
        dbgMessage.textContent = message;
        dbgConnection.textContent = "Error";
        dbgConnection.classList.add("error");
        dbgConnection.classList.remove("live");
        // Connection errors are browser-side events, so show them directly.
        appendDebugEvent({
          id: "browser",
          timeMs: 0,
          message: message
        });
      }
    }

    otaUploadButton.addEventListener("click", () => {
      const file = otaFile.files && otaFile.files[0];
      const password = otaPassword.value;

      if (!file) {
        otaProgressText.textContent = "Select a compiled firmware .bin file first.";
        return;
      }

      if (!file.name.toLowerCase().endsWith(".bin")) {
        otaProgressText.textContent = "Please choose an Arduino compiled .bin file.";
        return;
      }

      if (!password) {
        otaProgressText.textContent = "Enter the OTA password.";
        return;
      }

      const confirmed = window.confirm(
        "Upload " + file.name + " (" + Math.round(file.size / 1024) +
        " KB)?\\n\\nThe motors will stop and the robot will reboot after success."
      );

      if (!confirmed) return;

      // Reduce ESP32-CAM load during the firmware transfer.
      sendAction("stop");
      stopDebugPolling();

      otaUploadButton.disabled = true;
      otaFile.disabled = true;
      otaPassword.disabled = true;
      otaProgressBar.style.width = "0%";
      otaProgressText.textContent = "Starting upload...";

      const xhr = new XMLHttpRequest();
      xhr.open("POST", "/update", true);
      xhr.setRequestHeader("Content-Type", "application/octet-stream");
      xhr.setRequestHeader("X-OTA-Password", password);

      xhr.upload.addEventListener("progress", (event) => {
        if (!event.lengthComputable) return;

        const percent = Math.min(
          100,
          Math.round((event.loaded / event.total) * 100)
        );

        otaProgressBar.style.width = percent + "%";
        otaProgressText.textContent =
          "Uploading: " + percent + "%  (" +
          Math.round(event.loaded / 1024) + " / " +
          Math.round(event.total / 1024) + " KB)";
      });

      xhr.addEventListener("load", () => {
        if (xhr.status >= 200 && xhr.status < 300) {
          otaProgressBar.style.width = "100%";
          otaProgressText.textContent =
            "Firmware accepted. Robot is rebooting...";

          // Give the ESP32 time to restart, then try the same page again.
          setTimeout(() => {
            window.location.reload();
          }, 7000);
        } else {
          otaProgressText.textContent =
            "Update failed: " + (xhr.responseText || ("HTTP " + xhr.status));

          otaUploadButton.disabled = false;
          otaFile.disabled = false;
          otaPassword.disabled = false;
          startDebugPolling();
        }
      });

      xhr.addEventListener("error", () => {
        otaProgressText.textContent =
          "Upload connection failed. The robot may have restarted or Wi-Fi was lost.";

        otaUploadButton.disabled = false;
        otaFile.disabled = false;
        otaPassword.disabled = false;
        startDebugPolling();
      });

      xhr.send(file);
    });

    // ---- Hold-to-drive ---------------------------------------------------
    // Commands go out as fire-and-forget requests, so any one of them can be
    // lost. The robot therefore stops by itself if it hears nothing for
    // MOTION_TIMEOUT_MS (600 ms in the firmware), and a held button repeats
    // its command well inside that window. The repeats are what keep the
    // robot moving; the release is no longer the only thing standing between
    // a held button and a wheel that never stops.
    const DRIVE_KEEPALIVE_MS = 250;

    // A dropped stop is the one loss with consequences, so send it twice.
    const DRIVE_STOP_REPEAT_MS = 150;

    let activeDriveAction = null;
    let driveKeepaliveTimer = null;
    let driveStopRepeatTimer = null;

    function clearDriveKeepalive() {
      activeDriveAction = null;

      clearInterval(driveKeepaliveTimer);
      driveKeepaliveTimer = null;
    }

    function sendStopTwice() {
      showLocalMotion(null);
      recordStep({ kind: "go", action: "stop" });
      sendAction("stop");

      clearTimeout(driveStopRepeatTimer);
      driveStopRepeatTimer = setTimeout(() => {
        driveStopRepeatTimer = null;
        sendAction("stop");
      }, DRIVE_STOP_REPEAT_MS);
    }

    function beginDrive(action) {
      clearDriveKeepalive();

      activeDriveAction = action;
      showLocalMotion(action);
      recordStep({ kind: "go", action: action });
      sendAction(action);

      driveKeepaliveTimer = setInterval(() => {
        if (!activeDriveAction) return;
        sendAction(activeDriveAction);
      }, DRIVE_KEEPALIVE_MS);
    }

    function endDrive() {
      if (!activeDriveAction) return;

      clearDriveKeepalive();
      sendStopTwice();
    }

    document.querySelectorAll(".drive").forEach((button) => {
      const action = button.dataset.action;

      button.addEventListener("pointerdown", (event) => {
        event.preventDefault();

        // activeDriveAction is the single source of truth for "a button is
        // held", so the safety nets below can end a drive that this button
        // started without leaving it unable to start another one.
        if (activeDriveAction) return;

        // Capture keeps the release on this button when the finger slides
        // off it. It is an optimisation, not a requirement: if the browser
        // refuses, driving must still start.
        try {
          if (button.setPointerCapture) {
            button.setPointerCapture(event.pointerId);
          }
        } catch (error) {
        }

        beginDrive(action);
      });

      const stopOnce = (event) => {
        if (event) event.preventDefault();

        // pointerup is often followed by lostpointercapture.
        // Only the first release event does the work.
        endDrive();
      };

      button.addEventListener("pointerup", stopOnce);
      button.addEventListener("pointercancel", stopOnce);
      button.addEventListener("lostpointercapture", stopOnce);
    });

    // Releases the browser may never report on the button itself: the window
    // losing focus mid-press, the tab being hidden, the page going away.
    // A running program drives the robot exactly as a held button does, so
    // everything that ends a drive ends a replay too.
    window.addEventListener("blur", () => { stopPlayback(); endDrive(); });
    window.addEventListener("pagehide", () => { stopPlayback(); endDrive(); });

    document.addEventListener("visibilitychange", () => {
      if (document.hidden) {
        stopPlayback();
        endDrive();
      }
    });

    stopButton.addEventListener("pointerdown", (event) => {
      event.preventDefault();
      clearDriveKeepalive();
      sendStopTwice();
    });


    // ---- Record and replay -----------------------------------------------
    // Every command the page sends already passes through beginDrive(),
    // sendStopTwice() and sendMotorSpeed(), so a recording is just those
    // calls with the pause before each one written down. Playing it back
    // calls the same functions, which means a replay gets the keepalives and
    // the dead man's switch for free, exactly like a person driving.

    const tabDrive = document.getElementById("tabDrive");
    const tabProgram = document.getElementById("tabProgram");
    const driveView = document.getElementById("driveView");
    const programView = document.getElementById("programView");
    const recordButton = document.getElementById("recordButton");
    const recordLabel = document.getElementById("recordLabel");
    const programStatus = document.getElementById("programStatus");
    const programStopButton = document.getElementById("programStopButton");
    const programSteps = document.getElementById("programSteps");
    const programCount = document.getElementById("programCount");
    const playButton = document.getElementById("playButton");
    const clearProgramButton = document.getElementById("clearProgramButton");

    // Long enough for anything a child records by hand, short enough that a
    // stuck finger cannot fill the browser's storage.
    const PROGRAM_MAX_STEPS = 200;

    // Two slider moves inside this window are one adjustment, not two steps.
    const SPEED_COALESCE_MS = 500;

    let program = [];
    let recording = false;
    let replaying = false;
    let lastStepMs = 0;
    let playTimer = null;
    let playIndex = 0;

    function stepDescription(step) {
      if (step.kind === "speed") {
        return (step.motor === "left" ? "Left motor " : "Right motor ") +
          step.value;
      }

      if (step.action === "forward") return "Forward";
      if (step.action === "left") return "Left";
      if (step.action === "right") return "Right";
      return "Stop";
    }

    function recordStep(step) {
      // A replay drives through these same functions; recording that would
      // append the program to itself.
      if (!recording || replaying) return;
      if (program.length >= PROGRAM_MAX_STEPS) return;

      const now = Date.now();
      const previous = program[program.length - 1];

      if (previous) {
        // A held button repeats itself every 250 ms and a dragged slider
        // fires continuously. Neither is a new instruction.
        if (step.kind === "go" && previous.kind === "go" &&
            previous.action === step.action) {
          return;
        }

        if (step.kind === "speed" && previous.kind === "speed" &&
            previous.motor === step.motor &&
            now - lastStepMs < SPEED_COALESCE_MS) {
          previous.value = step.value;
          renderProgram();
          return;
        }
      }

      step.delay = program.length === 0
        ? 0
        : Math.min(60, Math.round((now - lastStepMs) / 100) / 10);

      lastStepMs = now;
      program.push(step);
      renderProgram();
    }

    function renderProgram() {
      programSteps.textContent = "";

      program.forEach((step, index) => {
        const row = document.createElement("div");
        row.className = "program-step";
        if (replaying && index === playIndex) row.classList.add("is-current");

        const number = document.createElement("span");
        number.className = "step-index";
        number.textContent = String(index + 1);

        const delay = document.createElement("input");
        delay.className = "step-delay";
        delay.type = "number";
        delay.min = "0";
        delay.max = "60";
        delay.step = "0.1";
        delay.value = String(step.delay);
        delay.setAttribute("aria-label", "Pause before step " + (index + 1));

        delay.addEventListener("change", () => {
          const seconds = Number(delay.value);
          step.delay = Number.isFinite(seconds)
            ? Math.max(0, Math.min(60, seconds))
            : 0;
          delay.value = String(step.delay);
          updateProgramCount();
        });

        const description = document.createElement("span");
        description.className = "step-desc";
        description.textContent = stepDescription(step);

        const remove = document.createElement("button");
        remove.className = "step-remove";
        remove.type = "button";
        remove.textContent = "×";
        remove.setAttribute("aria-label", "Delete step " + (index + 1));

        remove.addEventListener("click", () => {
          program.splice(index, 1);
          renderProgram();
        });

        row.append(number, delay, description, remove);
        programSteps.append(row);
      });

      updateProgramCount();
    }

    function programSeconds() {
      return program.reduce((total, step) => total + (step.delay || 0), 0);
    }

    function updateProgramCount() {
      if (program.length === 0) {
        programCount.textContent = "no steps yet";
      } else {
        programCount.textContent =
          program.length + " step" + (program.length === 1 ? "" : "s") +
          " - " + programSeconds().toFixed(1) + "s";
      }

      playButton.disabled = program.length === 0 || recording;
      clearProgramButton.disabled = program.length === 0 || recording;
    }

    function setProgramStatus(text) {
      programStatus.textContent = text;
    }

    function startRecording() {
      stopPlayback();

      program = [];
      recording = true;
      lastStepMs = Date.now();

      recordButton.classList.add("is-recording");
      recordLabel.textContent = "Recording";
      programStopButton.hidden = false;

      setProgramStatus("Drive the robot. Every command is written down.");
      renderProgram();
    }

    function stopRecording() {
      if (!recording) return;

      recording = false;
      recordButton.classList.remove("is-recording");
      recordLabel.textContent = "Record";
      programStopButton.hidden = replaying;

      setProgramStatus(
        program.length
          ? ("Recorded " + program.length + " steps. Open Program to play it.")
          : "Nothing recorded."
      );

      updateProgramCount();
    }

    function stopPlayback() {
      if (!replaying) return;

      clearTimeout(playTimer);
      playTimer = null;
      replaying = false;
      playIndex = 0;

      // Whatever the program was in the middle of, the robot stops.
      clearDriveKeepalive();
      sendStopTwice();

      programStopButton.hidden = recording;
      playButton.disabled = program.length === 0;
      setProgramStatus("Stopped.");
      renderProgram();
    }

    function runStep() {
      if (!replaying) return;

      if (playIndex >= program.length) {
        const finished = program.length;
        stopPlayback();
        setProgramStatus("Finished " + finished + " steps.");
        return;
      }

      const step = program[playIndex];

      playTimer = setTimeout(() => {
        if (!replaying) return;

        if (step.kind === "speed") {
          setMotorUi(step.motor, step.value);
          sendMotorSpeed(step.motor, step.value);
        } else if (step.action === "stop") {
          clearDriveKeepalive();
          sendStopTwice();
        } else {
          // beginDrive() starts the keepalive, so a replayed drive survives
          // the robot's 600 ms motion timeout just as a held button does.
          beginDrive(step.action);
        }

        setProgramStatus(
          "Playing step " + (playIndex + 1) + " of " + program.length + "."
        );

        playIndex++;
        renderProgram();
        runStep();
      }, Math.max(0, (step.delay || 0) * 1000));
    }

    function startPlayback() {
      if (recording || replaying || program.length === 0) return;

      replaying = true;
      playIndex = 0;
      playButton.disabled = true;
      programStopButton.hidden = false;

      setProgramStatus("Playing...");
      runStep();
    }

    recordButton.addEventListener("click", () => {
      if (recording) {
        stopRecording();
      } else {
        startRecording();
      }
    });

    programStopButton.addEventListener("click", () => {
      stopRecording();
      stopPlayback();
    });

    playButton.addEventListener("click", startPlayback);

    clearProgramButton.addEventListener("click", () => {
      if (recording || replaying) return;

      program = [];
      renderProgram();
      setProgramStatus("Cleared.");
    });

    // ---- Slots ------------------------------------------------------------
    // A recording is something the child made, so it lives in their browser.
    // The robot's own settings stay on the robot.

    // Slots live on the robot, not in this browser: a program should follow
    // the robot round the classroom, not the tablet that recorded it.
    async function readSlot(slot) {
      try {
        const response = await fetch("/program?slot=" + slot, {
          cache: "no-store"
        });

        if (!response.ok) return null;

        const loaded = await response.json();
        return Array.isArray(loaded) ? loaded : null;
      } catch (error) {
        return null;
      }
    }

    async function renderSlots() {
      const infos = [...document.querySelectorAll("[data-slot-info]")];

      for (const info of infos) {
        const loaded = await readSlot(info.dataset.slotInfo);
        const steps = loaded ? loaded.length : 0;

        info.textContent = steps
          ? (steps + " step" + (steps === 1 ? "" : "s"))
          : "empty";
      }
    }

    document.querySelectorAll("[data-slot-save]").forEach((button) => {
      button.addEventListener("click", async () => {
        if (!program.length) {
          setProgramStatus("Nothing to save yet.");
          return;
        }

        const slot = button.dataset.slotSave;
        setProgramStatus("Saving to slot " + slot + "...");

        try {
          const response = await fetch("/program?slot=" + slot, {
            method: "POST",
            body: JSON.stringify(program)
          });

          if (!response.ok) throw new Error("HTTP " + response.status);

          await renderSlots();
          setProgramStatus("Saved to slot " + slot + " on the robot.");
        } catch (error) {
          setProgramStatus("Could not save: " + error.message);
        }
      });
    });

    document.querySelectorAll("[data-slot-load]").forEach((button) => {
      button.addEventListener("click", async () => {
        if (recording || replaying) return;

        const slot = button.dataset.slotLoad;
        const loaded = await readSlot(slot);

        if (!loaded || !loaded.length) {
          setProgramStatus("Slot " + slot + " is empty.");
          return;
        }

        program = loaded.slice(0, PROGRAM_MAX_STEPS);
        renderProgram();
        setProgramStatus("Loaded slot " + slot + ".");
      });
    });

    // ---- Views ------------------------------------------------------------
    // The video stays above both views, so a program can be watched running.

    function showView(view) {
      const wantsProgram = view === "program";

      driveView.hidden = wantsProgram;
      programView.hidden = !wantsProgram;

      tabDrive.classList.toggle("is-active", !wantsProgram);
      tabProgram.classList.toggle("is-active", wantsProgram);
      tabDrive.setAttribute("aria-selected", String(!wantsProgram));
      tabProgram.setAttribute("aria-selected", String(wantsProgram));

      prefSet("View", view);
    }

    tabDrive.addEventListener("click", () => showView("drive"));
    tabProgram.addEventListener("click", () => showView("program"));


    // ---- Robot identity and limits ---------------------------------------

    const robotNameInput = document.getElementById("robotNameInput");
    const robotNameSave = document.getElementById("robotNameSave");
    const speedCapSlider = document.getElementById("speedCapSlider");
    const speedCapValue = document.getElementById("speedCapValue");
    const thresholdLeft = document.getElementById("thresholdLeft");
    const thresholdRight = document.getElementById("thresholdRight");
    const robotSettingsStatus = document.getElementById("robotSettingsStatus");

    function applyRobotName(name) {
      const trimmed = String(name || "").trim() || "ESP32-CAM Robot";

      heroTitle.textContent = trimmed;
      document.title = trimmed;

      if (document.activeElement !== robotNameInput) {
        robotNameInput.value = trimmed;
      }
    }

    function applySpeedCap(limit) {
      const capped = Math.max(20, Math.min(255, Number(limit) || 255));

      speedCapSlider.value = String(capped);
      speedCapValue.textContent = capped + " / 255";

      // The firmware is the authority; this just stops the sliders offering
      // numbers the robot will refuse.
      leftSpeedSlider.max = String(capped);
      rightSpeedSlider.max = String(capped);

      if (Number(leftSpeedSlider.value) > capped) setMotorUi("left", capped);
      if (Number(rightSpeedSlider.value) > capped) setMotorUi("right", capped);
    }

    function applyThresholds(left, right) {
      thresholdLeft.textContent = left ? String(left) : "not measured";
      thresholdRight.textContent = right ? String(right) : "not measured";
    }

    robotNameSave.addEventListener("click", () => {
      const name = robotNameInput.value.trim().slice(0, 32);
      if (!name) return;

      request("/action?robotName=" + encodeURIComponent(name));
      applyRobotName(name);
      robotSettingsStatus.textContent = "Name saved.";
    });

    speedCapSlider.addEventListener("input", () => {
      speedCapValue.textContent = speedCapSlider.value + " / 255";
    });

    speedCapSlider.addEventListener("change", () => {
      applySpeedCap(speedCapSlider.value);
      request("/action?maxPwm=" + encodeURIComponent(speedCapSlider.value));
      robotSettingsStatus.textContent =
        "Speed limit " + speedCapSlider.value + " / 255.";
    });

    // ---- Photos -----------------------------------------------------------

    const photoButton = document.getElementById("photoButton");
    const galleryButton = document.getElementById("galleryButton");
    const galleryCount = document.getElementById("galleryCount");
    const galleryModal = document.getElementById("galleryModal");
    const galleryGrid = document.getElementById("galleryGrid");
    const galleryClose = document.getElementById("galleryClose");

    // Object URLs, held for the session. Downloading is how a photo is kept:
    // a few VGA frames would be most of the browser's storage quota.
    let photos = [];

    function photoStamp(date) {
      const pad = (n) => String(n).padStart(2, "0");
      return date.getFullYear() + pad(date.getMonth() + 1) + pad(date.getDate()) +
        "_" + pad(date.getHours()) + pad(date.getMinutes()) + pad(date.getSeconds());
    }

    function renderGallery() {
      galleryCount.textContent = String(photos.length);
      galleryButton.hidden = photos.length === 0;

      galleryGrid.textContent = "";

      photos.forEach((photo, index) => {
        const cell = document.createElement("div");
        cell.className = "gallery-cell";

        const image = document.createElement("img");
        image.className = "gallery-image";
        image.src = photo.url;
        image.alt = "Photo " + (index + 1);

        const row = document.createElement("div");
        row.className = "gallery-actions";

        const save = document.createElement("a");
        save.className = "slot-button";
        save.textContent = "Save";
        save.href = photo.url;
        save.download = photo.name;

        const drop = document.createElement("button");
        drop.className = "slot-button";
        drop.type = "button";
        drop.textContent = "Delete";
        drop.addEventListener("click", () => {
          URL.revokeObjectURL(photo.url);
          photos.splice(index, 1);
          renderGallery();
        });

        row.append(save, drop);
        cell.append(image, row);
        galleryGrid.append(cell);
      });
    }

    photoButton.addEventListener("click", async () => {
      photoButton.disabled = true;
      setProgramStatus("Taking a photo...");

      try {
        const response = await fetch("/capture?t=" + Date.now(), {
          cache: "no-store"
        });

        if (!response.ok) throw new Error("HTTP " + response.status);

        const blob = await response.blob();
        const name = (robotNameInput.value.trim() || "robot")
          .replace(/[^a-zA-Z0-9._-]+/g, "_") + "_" +
          photoStamp(new Date()) + ".jpg";

        photos.push({ url: URL.createObjectURL(blob), name: name });
        renderGallery();

        setProgramStatus(
          "Photo " + photos.length + " taken. Open Photos to keep it."
        );
      } catch (error) {
        setProgramStatus("Photo failed: " + error.message);
      } finally {
        photoButton.disabled = false;
      }
    });

    galleryButton.addEventListener("click", () => {
      renderGallery();
      galleryModal.hidden = false;
    });

    galleryClose.addEventListener("click", () => {
      galleryModal.hidden = true;
    });

    // ---- Wake-up number activity -----------------------------------------
    // Walks the PWM up one step at a time and asks whether the wheel turned.
    // The two motors will disagree, often by a lot, and that difference is
    // the whole lesson: identical parts are not identical.

    const activityModal = document.getElementById("activityModal");
    const activityOpen = document.getElementById("activityOpen");
    const activityClose = document.getElementById("activityClose");
    const activityWheel = document.getElementById("activityWheel");
    const activityValue = document.getElementById("activityValue");
    const activityHigher = document.getElementById("activityHigher");
    const activityMoving = document.getElementById("activityMoving");
    const activityResult = document.getElementById("activityResult");

    const ACTIVITY_START_PWM = 20;
    const ACTIVITY_STEP = 5;

    let activityWheelName = "left";
    let activityPwm = ACTIVITY_START_PWM;

    // The activity drives the motors at test values; whatever the robot was
    // set to before goes back when it ends.
    let activitySpeedsBefore = null;

    // One motor at a time. Reuse the existing steering commands: turning right
    // runs the left wheel only, and turning left runs the right wheel only.
    function activityAction() {
      return activityWheelName === "left" ? "right" : "left";
    }

    function activityStop() {
      clearDriveKeepalive();
      sendStopTwice();
    }

    function activityDrive() {
      const capped = Math.min(activityPwm, Number(speedCapSlider.value) || 255);

      activityValue.textContent = String(capped);
      setMotorUi(activityWheelName, capped);
      sendMotorSpeed(activityWheelName, capped);

      // beginDrive keeps the keepalive running, so the wheel stays powered
      // while the child watches it.
      beginDrive(activityAction());
    }

    function activityStart(wheel, keepResult) {
      activityWheelName = wheel;
      activityPwm = ACTIVITY_START_PWM;

      // Chaining to the second wheel keeps the first wheel's answer on
      // screen; only a fresh run clears it.
      if (!keepResult) activityResult.textContent = "";

      activityWheel.textContent = wheel === "left" ? "left" : "right";
      activityDrive();
    }

    activityOpen.addEventListener("click", () => {
      stopPlayback();
      closeSettingsSidebar();

      activitySpeedsBefore = {
        left: Number(leftSpeedSlider.value),
        right: Number(rightSpeedSlider.value)
      };

      activityModal.hidden = false;
      activityStart("left", false);
    });

    activityHigher.addEventListener("click", () => {
      if (activityPwm >= 255) {
        activityStop();
        activityResult.textContent =
          "Full power and still nothing. Check the wiring or the battery.";
        return;
      }

      activityPwm = Math.min(255, activityPwm + ACTIVITY_STEP);
      activityDrive();
    });

    activityMoving.addEventListener("click", () => {
      const found = Number(activityValue.textContent) || 0;
      activityStop();

      request(
        "/action?" + activityWheelName + "Threshold=" +
        encodeURIComponent(found)
      );

      if (activityWheelName === "left") {
        thresholdLeft.textContent = String(found);
      } else {
        thresholdRight.textContent = String(found);
      }

      if (activityWheelName === "left") {
        activityResult.textContent =
          "Left wheel wakes up at " + found + ". Now the right one.";
        setTimeout(() => activityStart("right", true), 1600);
      } else {
        const left = Number(thresholdLeft.textContent) || 0;
        const gap = Math.abs(left - found);

        activityResult.textContent =
          "Right wheel wakes up at " + found + ". " +
          (left
            ? ("The two differ by " + gap +
               (gap > 10
                 ? " -- that is why the robot pulls to one side."
                 : " -- close enough to drive straight."))
            : "");
      }
    });

    function closeActivity() {
      activityStop();
      activityModal.hidden = true;

      // Put the driving speeds back where the activity found them.
      if (activitySpeedsBefore) {
        setMotorUi("left", activitySpeedsBefore.left);
        sendMotorSpeed("left", activitySpeedsBefore.left);
        setMotorUi("right", activitySpeedsBefore.right);
        sendMotorSpeed("right", activitySpeedsBefore.right);
        activitySpeedsBefore = null;
      }
    }

    activityClose.addEventListener("click", closeActivity);


    // ---- Choosing a network ----------------------------------------------
    // The credentials used to be compiled in, so moving the robot to another
    // room meant reflashing it. They now live in NVS and can be set from here.

    const wifiNow = document.getElementById("wifiNow");
    const wifiScan = document.getElementById("wifiScan");
    const wifiList = document.getElementById("wifiList");
    const wifiSsidInput = document.getElementById("wifiSsidInput");
    const wifiPassInput = document.getElementById("wifiPassInput");
    const wifiConnect = document.getElementById("wifiConnect");
    const wifiStatus = document.getElementById("wifiStatus");

    const WIFI_WATCH_MS = 30000;
    const WIFI_POLL_MS = 2000;

    function describeNetwork(data) {
      if (!data) return "--";

      const mode = data.networkMode || "--";
      const ssid = data.networkSsid || "--";

      return data.staStatus === "WL_CONNECTED"
        ? (ssid + " - " + (data.robotIp || "") + " (" + mode + ")")
        : (mode + " - " + ssid);
    }

    function showCurrentNetwork(data) {
      wifiNow.textContent = describeNetwork(data);
    }

    wifiScan.addEventListener("click", async () => {
      wifiScan.disabled = true;
      wifiList.textContent = "";
      wifiStatus.textContent = "Scanning. The video will stutter for a moment.";

      try {
        const response = await fetch("/wifi?scan=1", { cache: "no-store" });
        const data = await response.json();

        // The robot explains itself -- "Stop the robot before scanning" is
        // more use to a child than a status code.
        if (!response.ok) {
          throw new Error(data.error || ("HTTP " + response.status));
        }
        const networks = Array.isArray(data.networks) ? data.networks : [];

        networks.sort((a, b) => Number(b.rssi) - Number(a.rssi));

        if (!networks.length) {
          wifiStatus.textContent = "No networks found.";
          return;
        }

        networks.forEach((network) => {
          const row = document.createElement("button");
          row.className = "wifi-row";
          row.type = "button";

          const name = document.createElement("span");
          name.className = "wifi-name";
          name.textContent = network.ssid + (network.secure ? "" : " (open)");

          const signal = document.createElement("span");
          signal.className = "wifi-signal";
          signal.textContent = network.rssi + " dBm";

          row.append(name, signal);

          row.addEventListener("click", () => {
            wifiSsidInput.value = network.ssid;
            wifiPassInput.value = "";
            wifiPassInput.focus();
            wifiStatus.textContent = "Selected " + network.ssid + ".";
          });

          wifiList.append(row);
        });

        wifiStatus.textContent =
          "Found " + networks.length + ". Pick one, then type its password.";
      } catch (error) {
        wifiStatus.textContent = "Scan failed: " + error.message;
      } finally {
        wifiScan.disabled = false;
      }
    });

    async function watchWifiOutcome(wanted) {
      const until = Date.now() + WIFI_WATCH_MS;

      while (Date.now() < until) {
        await new Promise((resolve) => setTimeout(resolve, WIFI_POLL_MS));

        let data = null;

        try {
          const response = await fetch(
            "/status?after=" + STATUS_WITHOUT_EVENTS,
            { cache: "no-store" }
          );

          if (response.ok) data = await response.json();
        } catch (error) {
          // The robot is off changing channel; that is expected here.
          wifiStatus.textContent = "Waiting for the robot to come back...";
          continue;
        }

        if (!data) continue;

        showCurrentNetwork(data);

        if (data.staStatus === "WL_CONNECTED" && data.networkSsid === wanted) {
          wifiStatus.textContent =
            "Connected to " + wanted + " at " + data.robotIp +
            ". You can switch your device back to that network and open " +
            "http://" + data.robotIp + " - the robot's own access point " +
            "stays up either way.";
          return;
        }
      }

      wifiStatus.textContent =
        "Not connected yet. The robot keeps retrying on its own, and its " +
        "access point is still here. Check the password, or the event log.";
    }

    wifiConnect.addEventListener("click", async () => {
      const wanted = wifiSsidInput.value.trim();

      if (!wanted) {
        wifiStatus.textContent = "Pick a network first.";
        return;
      }

      wifiConnect.disabled = true;
      wifiStatus.textContent = "Saving and connecting...";

      try {
        const response = await fetch(
          "/wifi?ssid=" + encodeURIComponent(wanted) +
          "&password=" + encodeURIComponent(wifiPassInput.value),
          { cache: "no-store" }
        );

        if (!response.ok) {
          const failed = await response.json().catch(() => ({}));
          throw new Error(failed.error || ("HTTP " + response.status));
        }

        wifiPassInput.value = "";
        await watchWifiOutcome(wanted);
      } catch (error) {
        wifiStatus.textContent = "Could not save: " + error.message;
      } finally {
        wifiConnect.disabled = false;
      }
    });

    let ledBrightnessTimer = null;

    ledBrightnessSlider.addEventListener("input", () => {
      userAdjustedControls = true;
      const value = clamp255(ledBrightnessSlider.value);
      ledBrightnessValue.textContent = ledBrightnessLabel(value);

      clearTimeout(ledBrightnessTimer);
      ledBrightnessTimer = setTimeout(() => {
        request(
          "/action?ledBrightness=" +
          encodeURIComponent(value)
        );
      }, 60);
    });

    ledBrightnessSlider.addEventListener("change", () => {
      const value = clamp255(ledBrightnessSlider.value);
      clearTimeout(ledBrightnessTimer);
      ledBrightnessValue.textContent = ledBrightnessLabel(value);
      request(
        "/action?ledBrightness=" +
        encodeURIComponent(value)
      );
    });

    ledButton.addEventListener("click", () => {
      ledState = !ledState;
      ledButton.classList.toggle("led-on", ledState);
      ledButton.textContent = ledState ? "ON" : "OFF";
      request("/action?led=" + (ledState ? "on" : "off"));
    });
  </script>
</body>
</html>
)rawliteral";

// Whether the generated gzip asset still matches the literal below it.
static bool indexGzUsable = false;

static uint32_t fnv1a32(const char *data, size_t len) {
  uint32_t hash = 2166136261UL;

  for (size_t i = 0; i < len; i++) {
    hash ^= (uint8_t)data[i];
    hash *= 16777619UL;
  }

  return hash;
}

// The UI is stored twice: as the readable literal the sketch is edited in,
// and as the gzipped copy that is actually sent. If someone edits the UI and
// forgets to re-run tools/gzip_ui.py the two disagree, and serving the stale
// gzip would hand the browser an old page with no hint as to why. Check once
// at boot and fall back to the literal instead.
static void checkIndexGzAsset() {
  size_t len = strlen(INDEX_HTML);
  char dbg[128];

  indexGzUsable =
    (len == INDEX_HTML_SOURCE_LEN) &&
    (fnv1a32(INDEX_HTML, len) == INDEX_HTML_SOURCE_HASH);

  if (indexGzUsable) {
    snprintf(
      dbg,
      sizeof(dbg),
      "BOOT: UI served gzipped; %u bytes instead of %u",
      (unsigned int)INDEX_HTML_GZ_LEN,
      (unsigned int)len
    );
  } else {
    snprintf(
      dbg,
      sizeof(dbg),
      "WARN: UI gzip asset is stale; serving %u bytes uncompressed. Re-run tools/gzip_ui.py",
      (unsigned int)len
    );
  }

  setDebugMessage(dbg);
}

static esp_err_t index_handler(httpd_req_t *req) {
  httpd_resp_set_type(req, "text/html");
  httpd_resp_set_hdr(
    req,
    "Cache-Control",
    "no-store, no-cache, must-revalidate, max-age=0"
  );
  httpd_resp_set_hdr(req, "Pragma", "no-cache");
  httpd_resp_set_hdr(req, "Expires", "0");
  httpd_resp_set_hdr(req, "Permissions-Policy", "serial=(self)");

  if (indexGzUsable) {
    httpd_resp_set_hdr(req, "Content-Encoding", "gzip");

    return httpd_resp_send(
      req,
      (const char *)INDEX_HTML_GZ,
      INDEX_HTML_GZ_LEN
    );
  }

  return httpd_resp_send(
    req,
    (const char *)INDEX_HTML,
    strlen(INDEX_HTML)
  );
}

// A single still, on the control server, so it works while the stream server
// is busy. The driver hands out the newest frame, so this is whatever the
// camera is seeing right now.
static esp_err_t wifi_handler(httpd_req_t *req) {
  // Room for an SSID and a password, both percent-encoded.
  char query[320] = {0};

  if (httpd_req_get_url_query_len(req) == 0 ||
      httpd_req_get_url_query_str(req, query, sizeof(query)) != ESP_OK) {
    httpd_resp_set_status(req, "400 Bad Request");
    httpd_resp_set_type(req, "application/json");
    return httpd_resp_send(req, "{\"error\":\"Missing query\"}",
                           HTTPD_RESP_USE_STRLEN);
  }

  httpd_resp_set_type(req, "application/json");
  httpd_resp_set_hdr(req, "Cache-Control", "no-store");

  char value[96] = {0};

  // /wifi?scan=1 -- a scan uses the same radio as the access point, so this
  // is a deliberate button in the UI, never something that runs on a timer.
  if (httpd_query_key_value(query, "scan", value, sizeof(value)) == ESP_OK) {
    // A scan blocks this server for several seconds, which starves the motion
    // keepalive and would trip the dead man's switch part-way through a
    // manoeuvre. Refuse rather than stop the robot out from under someone.
    if (motionState != MOTION_STOPPED) {
      httpd_resp_set_status(req, "409 Conflict");
      return httpd_resp_send(
        req,
        "{\"error\":\"Stop the robot before scanning\"}",
        HTTPD_RESP_USE_STRLEN
      );
    }

    setDebugMessage("NET: Scanning for networks");

    // The station cannot scan while it is trying to associate, and after the
    // boot attempt fails it keeps trying in the background for as long as it
    // is up -- which is exactly the state the fallback AP leaves it in. Stand
    // it down first, or every scan comes back empty.
    bool wasConnected = (WiFi.status() == WL_CONNECTED);

    WiFi.disconnect(false, false);
    delay(120);

    int found = WiFi.scanNetworks();

    if (found < 0) {
      // One retry: the first scan after standing the station down sometimes
      // reports busy rather than a result.
      WiFi.scanDelete();
      delay(400);
      found = WiFi.scanNetworks();
    }

    // Put the station back to whatever it was doing before.
    if (wasConnected || ssid[0] != '\0') {
      WiFi.begin(ssid, password);
      lastWiFiRetryMs = millis();
    }

    if (found < 0) {
      WiFi.scanDelete();

      char dbg[80];
      snprintf(dbg, sizeof(dbg), "NET: Scan failed with code %d", found);
      setDebugMessage(dbg);

      char body[96];
      snprintf(
        body,
        sizeof(body),
        "{\"error\":\"The radio refused the scan (code %d). Try again.\"}",
        found
      );

      httpd_resp_set_status(req, "503 Service Unavailable");
      return httpd_resp_send(req, body, HTTPD_RESP_USE_STRLEN);
    }

    if (found > 15) found = 15;

    String body = "{\"networks\":[";

    for (int i = 0; i < found; i++) {
      char name[64] = {0};
      WiFi.SSID(i).toCharArray(name, sizeof(name));
      sanitizeJsonText(name);

      if (name[0] == '\0') continue;

      if (body.endsWith("[") == false) body += ",";

      body += "{\"ssid\":\"";
      body += name;
      body += "\",\"rssi\":";
      body += String((long)WiFi.RSSI(i));
      body += ",\"secure\":";
      body += (WiFi.encryptionType(i) == WIFI_AUTH_OPEN) ? "false" : "true";
      body += "}";
    }

    body += "]}";

    WiFi.scanDelete();

    char dbg[64];
    snprintf(dbg, sizeof(dbg), "NET: Scan found %d networks", found);
    setDebugMessage(dbg);

    return httpd_resp_send(req, body.c_str(), body.length());
  }

  // /wifi?ssid=...&password=...
  if (httpd_query_key_value(query, "ssid", value, sizeof(value)) == ESP_OK) {
    urlDecode(value);

    if (value[0] == '\0') {
      httpd_resp_set_status(req, "400 Bad Request");
      return httpd_resp_send(req, "{\"error\":\"Empty network name\"}",
                             HTTPD_RESP_USE_STRLEN);
    }

    strncpy(ssid, value, sizeof(ssid) - 1);
    ssid[sizeof(ssid) - 1] = '\0';

    char pass[96] = {0};

    if (httpd_query_key_value(query, "password", pass, sizeof(pass)) == ESP_OK) {
      urlDecode(pass);
    }

    strncpy(password, pass, sizeof(password) - 1);
    password[sizeof(password) - 1] = '\0';

    char dbg[96];
    snprintf(dbg, sizeof(dbg), "NET: Network set to %s", ssid);
    setDebugMessage(dbg);

    noteSettingsChanged();

    // Save now rather than on the usual delay: the attempt that follows may
    // take the radio away mid-write.
    saveSettings();
    settingsDirty = false;

    wifiApplyRequested = true;

    return httpd_resp_send(req, "{\"ok\":true,\"applying\":true}",
                           HTTPD_RESP_USE_STRLEN);
  }

  httpd_resp_set_status(req, "400 Bad Request");
  return httpd_resp_send(req, "{\"error\":\"Unknown Wi-Fi request\"}",
                         HTTPD_RESP_USE_STRLEN);
}

static esp_err_t capture_handler(httpd_req_t *req) {
  camera_fb_t *fb = esp_camera_fb_get();

  if (!fb) {
    httpd_resp_send_500(req);
    return ESP_FAIL;
  }

  esp_err_t res = ESP_OK;

  httpd_resp_set_type(req, "image/jpeg");
  httpd_resp_set_hdr(req, "Content-Disposition", "inline; filename=robot.jpg");
  httpd_resp_set_hdr(req, "Cache-Control", "no-store");

  if (fb->format == PIXFORMAT_JPEG) {
    res = httpd_resp_send(req, (const char *)fb->buf, fb->len);
    esp_camera_fb_return(fb);
  } else {
    uint8_t *jpgBuf = NULL;
    size_t jpgLen = 0;
    bool converted = frame2jpg(fb, 80, &jpgBuf, &jpgLen);
    esp_camera_fb_return(fb);

    if (!converted) {
      httpd_resp_send_500(req);
      return ESP_FAIL;
    }

    res = httpd_resp_send(req, (const char *)jpgBuf, jpgLen);
    free(jpgBuf);
  }

  return res;
}

static esp_err_t program_handler(httpd_req_t *req) {
  char query[32] = {0};
  char slot[8] = {0};

  if (httpd_req_get_url_query_len(req) == 0 ||
      httpd_req_get_url_query_str(req, query, sizeof(query)) != ESP_OK ||
      httpd_query_key_value(query, "slot", slot, sizeof(slot)) != ESP_OK) {
    httpd_resp_set_status(req, "400 Bad Request");
    httpd_resp_set_type(req, "application/json");
    return httpd_resp_send(req, "{\"error\":\"Missing slot\"}",
                           HTTPD_RESP_USE_STRLEN);
  }

  char key[16] = {0};

  if (!programSlotKey(slot, key, sizeof(key))) {
    httpd_resp_set_status(req, "400 Bad Request");
    httpd_resp_set_type(req, "application/json");
    return httpd_resp_send(req, "{\"error\":\"Slot must be 1, 2 or 3\"}",
                           HTTPD_RESP_USE_STRLEN);
  }

  httpd_resp_set_type(req, "application/json");
  httpd_resp_set_hdr(req, "Cache-Control", "no-store");

  if (req->method == HTTP_GET) {
    String stored = "";

    if (settingsStore.begin(SETTINGS_NAMESPACE, true)) {
      stored = settingsStore.getString(key, "");
      settingsStore.end();
    }

    if (stored.length() == 0) stored = "[]";

    return httpd_resp_send(req, stored.c_str(), stored.length());
  }

  // POST: the body is the program, as the JSON array the browser holds.
  if (req->content_len == 0 || req->content_len > PROGRAM_SLOT_MAX) {
    httpd_resp_set_status(req, "413 Payload Too Large");
    return httpd_resp_send(req, "{\"error\":\"Program too long\"}",
                           HTTPD_RESP_USE_STRLEN);
  }

  char *body = (char *)malloc(req->content_len + 1);

  if (!body) {
    httpd_resp_send_500(req);
    return ESP_FAIL;
  }

  size_t received = 0;

  while (received < req->content_len) {
    int chunk = httpd_req_recv(req, body + received, req->content_len - received);

    if (chunk <= 0) {
      free(body);
      httpd_resp_send_500(req);
      return ESP_FAIL;
    }

    received += chunk;
  }

  body[received] = '\0';

  bool ok = false;

  if (settingsStore.begin(SETTINGS_NAMESPACE, false)) {
    ok = settingsStore.putString(key, body) > 0;
    settingsStore.end();
  }

  free(body);

  char dbg[64];
  snprintf(dbg, sizeof(dbg), "PROGRAM: Slot %s %s", slot,
           ok ? "saved" : "could not be saved");
  setDebugMessage(dbg);

  return httpd_resp_send(req, ok ? "{\"ok\":true}" : "{\"ok\":false}",
                         HTTPD_RESP_USE_STRLEN);
}

static esp_err_t stream_handler(httpd_req_t *req) {
  camera_fb_t *fb = NULL;
  esp_err_t res = ESP_OK;
  size_t jpgLen = 0;
  uint8_t *jpgBuf = NULL;
  char partBuf[160];

  if (streamClientActive) {
    setDebugMessage("CAMERA: Refused a second stream client");
    httpd_resp_set_status(req, "503 Service Unavailable");
    httpd_resp_set_type(req, "text/plain");
    return httpd_resp_send(
      req,
      "The camera stream is already in use by another browser.",
      HTTPD_RESP_USE_STRLEN
    );
  }

  streamClientActive = true;
  streamFps10 = 0;

  // Opening a stream is not worth an event of its own; a stream that ends is,
  // and it is logged once below with how long it lasted. A viewer that keeps
  // reconnecting would otherwise fill the 64-event history with pairs of
  // lines and push out whatever caused the drops.
  unsigned long streamStartedMs = millis();

  res = httpd_resp_set_type(req, _STREAM_CONTENT_TYPE);

  if (res == ESP_OK) {
    httpd_resp_set_hdr(req, "Cache-Control", "no-store");
  }

  // Frame rate is measured over a rolling one-second window.
  unsigned long windowStartMs = millis();
  uint32_t windowFrames = 0;

  while (res == ESP_OK) {
    fb = esp_camera_fb_get();

    if (!fb) {
      Serial.println("Camera capture failed");
      res = ESP_FAIL;
    } else {
      if (fb->format == PIXFORMAT_JPEG) {
        jpgLen = fb->len;
        jpgBuf = fb->buf;
      } else {
        bool converted = frame2jpg(fb, 80, &jpgBuf, &jpgLen);
        esp_camera_fb_return(fb);
        fb = NULL;

        if (!converted) {
          Serial.println("JPEG compression failed");
          res = ESP_FAIL;
        }
      }
    }

    if (res == ESP_OK) {
      size_t hlen = snprintf(partBuf, sizeof(partBuf), _STREAM_PART, jpgLen);
      res = httpd_resp_send_chunk(req, partBuf, hlen);
    }

    if (res == ESP_OK) {
      res = httpd_resp_send_chunk(req, (const char *)jpgBuf, jpgLen);
    }

    if (fb) {
      esp_camera_fb_return(fb);
      fb = NULL;
      jpgBuf = NULL;
    } else if (jpgBuf) {
      free(jpgBuf);
      jpgBuf = NULL;
    }

    if (res != ESP_OK) break;

    windowFrames++;

    unsigned long now = millis();
    unsigned long elapsed = now - windowStartMs;

    if (elapsed >= 1000) {
      streamFps10 = (uint32_t)((windowFrames * 10000UL) / elapsed);
      windowStartMs = now;
      windowFrames = 0;
    }
  }

  streamClientActive = false;
  streamFps10 = 0;
  streamDropCount++;

  char endDbg[96];
  snprintf(
    endDbg,
    sizeof(endDbg),
    "CAMERA: Stream ended after %lus (%lu since boot)",
    (unsigned long)((millis() - streamStartedMs + 500) / 1000),
    (unsigned long)streamDropCount
  );
  setDebugMessage(endDbg);

  return res;
}

// httpd_query_key_value() hands back the raw query value, so anything the
// browser encoded is still encoded. A Wi-Fi password full of %40 and + is
// not the password.
static void urlDecode(char *text) {
  if (!text) return;

  char *read = text;
  char *write = text;

  while (*read) {
    if (*read == '%' && isxdigit((unsigned char)read[1]) &&
        isxdigit((unsigned char)read[2])) {
      char hex[3] = { read[1], read[2], '\0' };
      *write++ = (char)strtol(hex, NULL, 16);
      read += 3;
    } else if (*read == '+') {
      *write++ = ' ';
      read++;
    } else {
      *write++ = *read++;
    }
  }

  *write = '\0';
}

static void sanitizeJsonText(char *text) {
  if (!text) return;

  for (size_t i = 0; text[i] != '\0'; i++) {
    // Our debug messages are simple ASCII. Replace characters that would need
    // JSON escaping so the response always remains valid.
    if (text[i] == '"' || text[i] == '\\' ||
        text[i] == '\r' || text[i] == '\n' ||
        (uint8_t)text[i] < 0x20) {
      text[i] = ' ';
    }
  }
}

// Which network the robot is reachable on right now. One resolver for both
// payloads: the Wi-Fi panel reads /status and the video overlay reads
// /camera?stream=1, and the two must never disagree about which network the
// picture is arriving over. ipOut may be NULL for callers that only want the
// name. Both outputs come back already safe to paste into JSON.
static void resolveNetworkIdentity(
  char *ssidOut,
  size_t ssidLen,
  char *ipOut,
  size_t ipLen
) {
  IPAddress ip(0, 0, 0, 0);

  if (WiFi.status() == WL_CONNECTED) {
    WiFi.SSID().toCharArray(ssidOut, ssidLen);
    ip = WiFi.localIP();
  } else if (fallbackApActive) {
    strncpy(ssidOut, fallbackApSsid, ssidLen - 1);
    ssidOut[ssidLen - 1] = '\0';
    ip = WiFi.softAPIP();
  } else {
    strncpy(ssidOut, "(none)", ssidLen - 1);
    ssidOut[ssidLen - 1] = '\0';
  }

  sanitizeJsonText(ssidOut);

  if (ipOut) {
    snprintf(ipOut, ipLen, "%u.%u.%u.%u", ip[0], ip[1], ip[2], ip[3]);
    sanitizeJsonText(ipOut);
  }
}

static esp_err_t status_handler(httpd_req_t *req) {
  uint32_t afterId = 0;

  // Optional query: /status?after=<last event id seen by browser>
  char query[64] = {0};
  char value[24] = {0};

  if (httpd_req_get_url_query_len(req) > 0 &&
      httpd_req_get_url_query_str(req, query, sizeof(query)) == ESP_OK &&
      httpd_query_key_value(query, "after", value, sizeof(value)) == ESP_OK) {
    afterId = strtoul(value, NULL, 10);
  }

  char messageCopy[128];
  uint8_t sizeCopy;
  uint8_t headCopy;
  uint32_t latestEventId;

  portENTER_CRITICAL(&debugMux);
  strncpy(messageCopy, lastDebugMessage, sizeof(messageCopy) - 1);
  messageCopy[sizeof(messageCopy) - 1] = '\0';
  sizeCopy = debugEventSize;
  headCopy = debugEventHead;
  latestEventId = debugEventSequence;
  portEXIT_CRITICAL(&debugMux);

  sanitizeJsonText(messageCopy);

  char networkSsid[64] = "";
  char robotIp[24] = "";
  const char *mode = networkModeName();

  long rssi = 0;
  // Same source as the video overlay, so the panel and the picture cannot
  // disagree -- and so the reading is not "N/A" for everyone on the AP.
  bool rssiValid = currentLinkRssi(&rssi);
  unsigned int apClients = fallbackApActive ? WiFi.softAPgetStationNum() : 0;

  resolveNetworkIdentity(
    networkSsid, sizeof(networkSsid),
    robotIp, sizeof(robotIp)
  );

  // Room for the status fields plus retained debug events.
  const size_t JSON_SIZE = 12288;
  char *json = (char *)malloc(JSON_SIZE);
  if (!json) {
    httpd_resp_send_500(req);
    return ESP_FAIL;
  }

  size_t used = 0;
  int written = snprintf(
    json,
    JSON_SIZE,
    "{\"motion\":\"%s\","
    "\"leftTarget\":%d,"
    "\"rightTarget\":%d,"
    "\"leftOutput\":%d,"
    "\"rightOutput\":%d,"
    "\"ledEnabled\":%s,"
    "\"ledBrightness\":%d,"
    "\"networkMode\":\"%s\","
    "\"staStatus\":\"%s\","
    "\"networkSsid\":\"%s\","
    "\"robotIp\":\"%s\","
    "\"apClients\":%u,"
    "\"rssi\":%ld,"
    "\"rssiValid\":%s,"
    "\"uptimeMs\":%lu,"
    "\"streamActive\":%s,"
    "\"streamFps10\":%lu,"
    "\"streamDrops\":%lu,"
    "\"robotName\":\"%s\","
    "\"maxPwm\":%d,"
    "\"leftThreshold\":%d,"
    "\"rightThreshold\":%d,"
    "\"build\":\"%s %s\","
    "\"message\":\"%s\","
    "\"latestEventId\":%lu,"
    "\"events\":[",
    motionName(motionState),
    leftMotorSpeed,
    rightMotorSpeed,
    currentLeftPWM,
    currentRightPWM,
    ledEnabled ? "true" : "false",
    ledBrightness,
    mode,
    wifiStatusName(WiFi.status()),
    networkSsid,
    robotIp,
    apClients,
    rssi,
    rssiValid ? "true" : "false",
    (unsigned long)millis(),
    streamClientActive ? "true" : "false",
    (unsigned long)streamFps10,
    (unsigned long)streamDropCount,
    robotName,
    maxMotorPWM,
    leftThreshold,
    rightThreshold,
    __DATE__,
    __TIME__,
    messageCopy,
    (unsigned long)latestEventId
  );

  if (written < 0 || (size_t)written >= JSON_SIZE) {
    free(json);
    httpd_resp_send_500(req);
    return ESP_FAIL;
  }
  used = (size_t)written;

  // Oldest event is head-size (wrapped into the circular buffer).
  uint8_t oldest = (headCopy + DEBUG_EVENT_COUNT - sizeCopy) % DEBUG_EVENT_COUNT;
  bool firstEvent = true;

  for (uint8_t i = 0; i < sizeCopy; i++) {
    uint8_t index = (oldest + i) % DEBUG_EVENT_COUNT;
    DebugEvent eventCopy;

    // Copy one event atomically. Keeping the critical section this short
    // avoids interfering with motor/camera work.
    portENTER_CRITICAL(&debugMux);
    eventCopy = debugEvents[index];
    portEXIT_CRITICAL(&debugMux);

    if (eventCopy.id <= afterId || eventCopy.id == 0) {
      continue;
    }

    sanitizeJsonText(eventCopy.message);

    written = snprintf(
      json + used,
      JSON_SIZE - used,
      "%s{\"id\":%lu,\"timeMs\":%lu,\"message\":\"%s\"}",
      firstEvent ? "" : ",",
      (unsigned long)eventCopy.id,
      (unsigned long)eventCopy.timeMs,
      eventCopy.message
    );

    if (written < 0 || (size_t)written >= (JSON_SIZE - used)) {
      break;
    }

    used += (size_t)written;
    firstEvent = false;
  }

  if (used + 3 >= JSON_SIZE) {
    free(json);
    httpd_resp_send_500(req);
    return ESP_FAIL;
  }

  json[used++] = ']';
  json[used++] = '}';
  json[used] = '\0';

  httpd_resp_set_type(req, "application/json");
  httpd_resp_set_hdr(req, "Cache-Control", "no-store");
  esp_err_t result = httpd_resp_send(req, json, used);

  free(json);
  return result;
}

static esp_err_t sendCameraStatus(httpd_req_t *req) {
  sensor_t *sensor = esp_camera_sensor_get();

  if (!sensor) {
    httpd_resp_set_status(req, "503 Service Unavailable");
    httpd_resp_set_type(req, "application/json");
    return httpd_resp_send(
      req,
      "{\"error\":\"Camera sensor unavailable\"}",
      HTTPD_RESP_USE_STRLEN
    );
  }

  char json[320];

  snprintf(
    json,
    sizeof(json),
    "{\"resolution\":\"%s\","
    "\"quality\":%u,"
    "\"brightness\":%d,"
    "\"contrast\":%d,"
    "\"saturation\":%d,"
    "\"vflip\":%u,"
    "\"hmirror\":%u,"
    "\"psram\":%s}",
    frameSizeName(sensor->status.framesize),
    (unsigned int)sensor->status.quality,
    (int)sensor->status.brightness,
    (int)sensor->status.contrast,
    (int)sensor->status.saturation,
    (unsigned int)sensor->status.vflip,
    (unsigned int)sensor->status.hmirror,
    cameraHasPsram ? "true" : "false"
  );

  httpd_resp_set_type(req, "application/json");
  httpd_resp_set_hdr(req, "Cache-Control", "no-store");
  return httpd_resp_send(req, json, HTTPD_RESP_USE_STRLEN);
}

static esp_err_t camera_handler(httpd_req_t *req) {
  sensor_t *sensor = esp_camera_sensor_get();

  if (!sensor) {
    httpd_resp_set_status(req, "503 Service Unavailable");
    httpd_resp_set_type(req, "application/json");
    return httpd_resp_send(
      req,
      "{\"error\":\"Camera sensor unavailable\"}",
      HTTPD_RESP_USE_STRLEN
    );
  }

  char query[128] = {0};
  char value[32] = {0};

  if (httpd_req_get_url_query_len(req) == 0) {
    return sendCameraStatus(req);
  }

  if (httpd_req_get_url_query_str(
        req,
        query,
        sizeof(query)
      ) != ESP_OK) {
    httpd_resp_set_status(req, "400 Bad Request");
    httpd_resp_set_type(req, "application/json");
    return httpd_resp_send(
      req,
      "{\"error\":\"Invalid camera query\"}",
      HTTPD_RESP_USE_STRLEN
    );
  }

  if (httpd_query_key_value(
        query,
        "get",
        value,
        sizeof(value)
      ) == ESP_OK) {
    return sendCameraStatus(req);
  }

  // Cheap liveness probe for the browser's stream watchdog. It lives on the
  // control server, so it still answers while the stream server is busy.
  if (httpd_query_key_value(
        query,
        "stream",
        value,
        sizeof(value)
      ) == ESP_OK) {
    long rssi = 0;
    bool rssiValid = currentLinkRssi(&rssi);

    // The overlay names the network on the picture itself, and this probe --
    // not /status -- is what feeds it.
    char networkSsid[64] = "";
    resolveNetworkIdentity(networkSsid, sizeof(networkSsid), NULL, 0);

    // An SSID is up to 32 characters, so the worst case outgrew the 224 this
    // used to be. A truncated body loses its closing brace, and the browser
    // reads a robot that is answering perfectly well as offline.
    char body[320];

    snprintf(
      body,
      sizeof(body),
      "{\"streamActive\":%s,\"streamFps10\":%lu,"
      "\"rssi\":%ld,\"rssiValid\":%s,"
      "\"motion\":\"%s\",\"left\":%d,\"right\":%d,"
      "\"motionTimeouts\":%lu,\"networkSsid\":\"%s\"}",
      streamClientActive ? "true" : "false",
      (unsigned long)streamFps10,
      rssi,
      rssiValid ? "true" : "false",
      motionName(motionState),
      currentLeftPWM,
      currentRightPWM,
      (unsigned long)motionTimeoutCount,
      networkSsid
    );

    httpd_resp_set_type(req, "application/json");
    return httpd_resp_send(req, body, HTTPD_RESP_USE_STRLEN);
  }

  if (httpd_query_key_value(
        query,
        "reset",
        value,
        sizeof(value)
      ) == ESP_OK) {
    framesize_t defaultFrame =
      cameraHasPsram ? FRAMESIZE_VGA : FRAMESIZE_QVGA;

    int result = 0;
    result |= sensor->set_framesize(sensor, defaultFrame);
    result |= sensor->set_quality(sensor, cameraHasPsram ? 10 : 12);
    result |= sensor->set_brightness(sensor, 0);
    result |= sensor->set_contrast(sensor, 0);
    result |= sensor->set_saturation(sensor, 0);
    result |= sensor->set_vflip(sensor, 0);
    result |= sensor->set_hmirror(sensor, 0);

    if (result != 0) {
      httpd_resp_set_status(req, "500 Internal Server Error");
      httpd_resp_set_type(req, "application/json");
      return httpd_resp_send(
        req,
        "{\"error\":\"Camera reset failed\"}",
        HTTPD_RESP_USE_STRLEN
      );
    }

    setDebugMessage("CAMERA: Settings reset to defaults");
    noteSettingsChanged();
    return sendCameraStatus(req);
  }

  int result = 0;
  char dbg[128];

  if (httpd_query_key_value(
        query,
        "resolution",
        value,
        sizeof(value)
      ) == ESP_OK) {
    framesize_t requested;

    if (!parseFrameSize(value, &requested)) {
      httpd_resp_set_status(req, "400 Bad Request");
      httpd_resp_set_type(req, "application/json");
      return httpd_resp_send(
        req,
        "{\"error\":\"Unsupported resolution\"}",
        HTTPD_RESP_USE_STRLEN
      );
    }

    if (!cameraHasPsram && frameSizeNeedsPsram(requested)) {
      httpd_resp_set_status(req, "400 Bad Request");
      httpd_resp_set_type(req, "application/json");
      return httpd_resp_send(
        req,
        "{\"error\":\"This resolution requires PSRAM\"}",
        HTTPD_RESP_USE_STRLEN
      );
    }

    result = sensor->set_framesize(sensor, requested);
    snprintf(dbg, sizeof(dbg), "CAMERA: Resolution -> %s", value);

  } else if (httpd_query_key_value(
               query,
               "quality",
               value,
               sizeof(value)
             ) == ESP_OK) {
    int requested = constrain(atoi(value), 4, 63);
    result = sensor->set_quality(sensor, requested);
    snprintf(dbg, sizeof(dbg), "CAMERA: JPEG quality -> %d", requested);

  } else if (httpd_query_key_value(
               query,
               "brightness",
               value,
               sizeof(value)
             ) == ESP_OK) {
    int requested = constrain(atoi(value), -2, 2);
    result = sensor->set_brightness(sensor, requested);
    snprintf(dbg, sizeof(dbg), "CAMERA: Brightness -> %d", requested);

  } else if (httpd_query_key_value(
               query,
               "contrast",
               value,
               sizeof(value)
             ) == ESP_OK) {
    int requested = constrain(atoi(value), -2, 2);
    result = sensor->set_contrast(sensor, requested);
    snprintf(dbg, sizeof(dbg), "CAMERA: Contrast -> %d", requested);

  } else if (httpd_query_key_value(
               query,
               "saturation",
               value,
               sizeof(value)
             ) == ESP_OK) {
    int requested = constrain(atoi(value), -2, 2);
    result = sensor->set_saturation(sensor, requested);
    snprintf(dbg, sizeof(dbg), "CAMERA: Saturation -> %d", requested);

  } else if (httpd_query_key_value(
               query,
               "vflip",
               value,
               sizeof(value)
             ) == ESP_OK) {
    int requested = atoi(value) ? 1 : 0;
    result = sensor->set_vflip(sensor, requested);
    snprintf(dbg, sizeof(dbg), "CAMERA: Vertical flip -> %s",
             requested ? "ON" : "OFF");

  } else if (httpd_query_key_value(
               query,
               "hmirror",
               value,
               sizeof(value)
             ) == ESP_OK) {
    int requested = atoi(value) ? 1 : 0;
    result = sensor->set_hmirror(sensor, requested);
    snprintf(dbg, sizeof(dbg), "CAMERA: Horizontal mirror -> %s",
             requested ? "ON" : "OFF");

  } else {
    httpd_resp_set_status(req, "400 Bad Request");
    httpd_resp_set_type(req, "application/json");
    return httpd_resp_send(
      req,
      "{\"error\":\"Unknown camera setting\"}",
      HTTPD_RESP_USE_STRLEN
    );
  }

  if (result != 0) {
    httpd_resp_set_status(req, "500 Internal Server Error");
    httpd_resp_set_type(req, "application/json");
    return httpd_resp_send(
      req,
      "{\"error\":\"Camera sensor rejected the setting\"}",
      HTTPD_RESP_USE_STRLEN
    );
  }

  setDebugMessage(dbg);
  noteSettingsChanged();
  return sendCameraStatus(req);
}

static bool otaPasswordValid(httpd_req_t *req) {
  size_t len = httpd_req_get_hdr_value_len(req, "X-OTA-Password");
  if (len == 0 || len >= 64) return false;

  char supplied[64] = {0};

  if (httpd_req_get_hdr_value_str(
        req,
        "X-OTA-Password",
        supplied,
        sizeof(supplied)
      ) != ESP_OK) {
    return false;
  }

  return strcmp(supplied, OTA_PASSWORD) == 0;
}

static esp_err_t update_handler(httpd_req_t *req) {
  if (!otaPasswordValid(req)) {
    setDebugMessage("OTA: Rejected update - wrong password");
    httpd_resp_set_status(req, "401 Unauthorized");
    httpd_resp_set_type(req, "text/plain");
    httpd_resp_send(req, "Wrong OTA password", HTTPD_RESP_USE_STRLEN);
    return ESP_OK;
  }

  if (req->content_len <= 0) {
    httpd_resp_set_status(req, "400 Bad Request");
    httpd_resp_send(req, "Firmware file is empty", HTTPD_RESP_USE_STRLEN);
    return ESP_OK;
  }

  otaInProgress = true;
  commandStop();
  ledEnabled = false;
  applyLedOutput();
  setDebugMessage("OTA: Firmware upload started; motors and flash LED stopped");

  size_t firmwareSize = (size_t)req->content_len;

  if (!Update.begin(firmwareSize, U_FLASH)) {
    char dbg[128];
    snprintf(
      dbg,
      sizeof(dbg),
      "OTA: Update.begin failed; error %u",
      (unsigned int)Update.getError()
    );
    setDebugMessage(dbg);

    otaInProgress = false;
    httpd_resp_set_status(req, "400 Bad Request");
    httpd_resp_set_type(req, "text/plain");
    httpd_resp_send(
      req,
      "OTA could not start. Check that an OTA-capable partition scheme is flashed by USB.",
      HTTPD_RESP_USE_STRLEN
    );
    return ESP_OK;
  }

  const size_t BUFFER_SIZE = 4096;
  uint8_t *buffer = (uint8_t *)malloc(BUFFER_SIZE);

  if (!buffer) {
    Update.abort();
    otaInProgress = false;
    httpd_resp_set_status(req, "500 Internal Server Error");
    httpd_resp_send(req, "Not enough RAM for OTA buffer", HTTPD_RESP_USE_STRLEN);
    return ESP_OK;
  }

  size_t remaining = firmwareSize;
  size_t writtenTotal = 0;
  bool receiveFailed = false;

  while (remaining > 0) {
    int toRead = (remaining > BUFFER_SIZE) ? BUFFER_SIZE : (int)remaining;
    int received = httpd_req_recv(req, (char *)buffer, toRead);

    if (received == HTTPD_SOCK_ERR_TIMEOUT) {
      continue;
    }

    if (received <= 0) {
      receiveFailed = true;
      break;
    }

    size_t written = Update.write(buffer, (size_t)received);

    if (written != (size_t)received) {
      receiveFailed = true;
      break;
    }

    writtenTotal += written;
    remaining -= (size_t)received;
  }

  free(buffer);

  if (receiveFailed || writtenTotal != firmwareSize) {
    Update.abort();

    char dbg[128];
    snprintf(
      dbg,
      sizeof(dbg),
      "OTA: Upload failed after %u / %u bytes; error %u",
      (unsigned int)writtenTotal,
      (unsigned int)firmwareSize,
      (unsigned int)Update.getError()
    );
    setDebugMessage(dbg);

    otaInProgress = false;
    httpd_resp_set_status(req, "500 Internal Server Error");
    httpd_resp_set_type(req, "text/plain");
    httpd_resp_send(req, "Firmware transfer failed", HTTPD_RESP_USE_STRLEN);
    return ESP_OK;
  }

  if (!Update.end(true)) {
    char dbg[128];
    snprintf(
      dbg,
      sizeof(dbg),
      "OTA: Firmware validation failed; error %u",
      (unsigned int)Update.getError()
    );
    setDebugMessage(dbg);

    otaInProgress = false;
    httpd_resp_set_status(req, "400 Bad Request");
    httpd_resp_set_type(req, "text/plain");
    httpd_resp_send(req, "Firmware validation failed", HTTPD_RESP_USE_STRLEN);
    return ESP_OK;
  }

  setDebugMessage("OTA: Firmware update successful; rebooting");

  httpd_resp_set_type(req, "text/plain");
  httpd_resp_set_hdr(req, "Connection", "close");
  httpd_resp_send(req, "OK - rebooting", HTTPD_RESP_USE_STRLEN);

  delay(750);
  ESP.restart();

  return ESP_OK;
}

static esp_err_t action_handler(httpd_req_t *req) {
  char query[128] = {0};
  int len = httpd_req_get_url_query_len(req) + 1;

  if (len <= 1 || len > (int)sizeof(query)) {
    httpd_resp_send_404(req);
    return ESP_OK;
  }

  if (httpd_req_get_url_query_str(req, query, sizeof(query)) != ESP_OK) {
    httpd_resp_send_404(req);
    return ESP_OK;
  }

  char value[32] = {0};

  // Independent full-range motor sliders.
  // /action?leftSpeed=0-255
  if (httpd_query_key_value(query, "leftSpeed", value, sizeof(value)) == ESP_OK) {
    leftMotorSpeed = constrain(atoi(value), MIN_PWM, MAX_PWM);
    noteSettingsChanged();

    char dbg[96];
    snprintf(dbg, sizeof(dbg), "Left speed set to %d / 255", leftMotorSpeed);
    setDebugMessage(dbg);

    if (motionState != MOTION_STOPPED) {
      applyMotion();
    }

    httpd_resp_send(req, "", HTTPD_RESP_USE_STRLEN);
    return ESP_OK;
  }

  // /action?rightSpeed=0-255
  if (httpd_query_key_value(query, "rightSpeed", value, sizeof(value)) == ESP_OK) {
    rightMotorSpeed = constrain(atoi(value), MIN_PWM, MAX_PWM);
    noteSettingsChanged();

    char dbg[96];
    snprintf(dbg, sizeof(dbg), "Right speed set to %d / 255", rightMotorSpeed);
    setDebugMessage(dbg);

    if (motionState != MOTION_STOPPED) {
      applyMotion();
    }

    httpd_resp_send(req, "", HTTPD_RESP_USE_STRLEN);
    return ESP_OK;
  }

  // Flash LED brightness: /action?ledBrightness=0-255
  if (httpd_query_key_value(
        query,
        "ledBrightness",
        value,
        sizeof(value)
      ) == ESP_OK) {
    ledBrightness = clampLedPWM(atoi(value));
    noteSettingsChanged();
    applyLedOutput();

    char dbg[96];
    snprintf(
      dbg,
      sizeof(dbg),
      "Flash LED brightness set to %d / 255",
      ledBrightness
    );
    setDebugMessage(dbg);

    httpd_resp_send(req, "", HTTPD_RESP_USE_STRLEN);
    return ESP_OK;
  }

  // Flash LED: /action?led=on|off
  if (httpd_query_key_value(query, "led", value, sizeof(value)) == ESP_OK) {
    ledEnabled = (strcmp(value, "on") == 0);
    noteSettingsChanged();
    applyLedOutput();

    char dbg[96];
    snprintf(
      dbg,
      sizeof(dbg),
      "Flash LED %s at %d / 255",
      ledEnabled ? "ON" : "OFF",
      ledBrightness
    );
    setDebugMessage(dbg);

    httpd_resp_send(req, "", HTTPD_RESP_USE_STRLEN);
    return ESP_OK;
  }

  // Robot name: /action?robotName=<text>
  if (httpd_query_key_value(query, "robotName", value, sizeof(value)) == ESP_OK) {
    // The query value arrives percent-encoded for anything unusual; the UI
    // only offers plain characters, so trim and store as-is.
    urlDecode(value);
    strncpy(robotName, value, sizeof(robotName) - 1);
    robotName[sizeof(robotName) - 1] = '\0';
    sanitizeJsonText(robotName);

    if (robotName[0] == '\0') {
      strncpy(robotName, "ESP32-CAM Robot", sizeof(robotName) - 1);
    }

    char dbg[80];
    snprintf(dbg, sizeof(dbg), "SETTINGS: Robot name is now %s", robotName);
    setDebugMessage(dbg);

    noteSettingsChanged();
    httpd_resp_send(req, "", HTTPD_RESP_USE_STRLEN);
    return ESP_OK;
  }

  // Speed ceiling: /action?maxPwm=1-255
  if (httpd_query_key_value(query, "maxPwm", value, sizeof(value)) == ESP_OK) {
    maxMotorPWM = constrain(atoi(value), 1, MAX_PWM);

    // Anything already above the new ceiling comes down to it.
    leftMotorSpeed = clampMotorPWM(leftMotorSpeed);
    rightMotorSpeed = clampMotorPWM(rightMotorSpeed);

    if (motionState != MOTION_STOPPED) applyMotion();

    char dbg[80];
    snprintf(dbg, sizeof(dbg), "SETTINGS: Speed limit set to %d / 255", maxMotorPWM);
    setDebugMessage(dbg);

    noteSettingsChanged();
    httpd_resp_send(req, "", HTTPD_RESP_USE_STRLEN);
    return ESP_OK;
  }

  // Measured motor thresholds: /action?leftThreshold=0-255
  if (httpd_query_key_value(query, "leftThreshold", value, sizeof(value)) == ESP_OK) {
    leftThreshold = constrain(atoi(value), 0, MAX_PWM);
    noteSettingsChanged();
    httpd_resp_send(req, "", HTTPD_RESP_USE_STRLEN);
    return ESP_OK;
  }

  if (httpd_query_key_value(query, "rightThreshold", value, sizeof(value)) == ESP_OK) {
    rightThreshold = constrain(atoi(value), 0, MAX_PWM);
    noteSettingsChanged();
    httpd_resp_send(req, "", HTTPD_RESP_USE_STRLEN);
    return ESP_OK;
  }

  // Motion: /action?go=forward|left|right|stop
  if (httpd_query_key_value(query, "go", value, sizeof(value)) == ESP_OK) {
    MotionState requested = MOTION_STOPPED;

    if (strcmp(value, "forward") == 0) {
      requested = MOTION_FORWARD;
    } else if (strcmp(value, "backward") == 0) {
      requested = MOTION_BACKWARD;
    } else if (strcmp(value, "left") == 0) {
      requested = MOTION_LEFT;
    } else if (strcmp(value, "right") == 0) {
      requested = MOTION_RIGHT;
    }
    // Anything else stops, so an unknown command can never leave a wheel
    // turning.

    if (requested == motionState) {
      // A repeat of the state we are already in: the keepalive a held button
      // sends, or the second copy of a release. Refresh the deadline and say
      // nothing -- logging these would bury the event log several times a
      // second and hide the commands that matter.
      noteMotionCommand();

      if (requested == MOTION_STOPPED) {
        stopMotors();
      }

    } else if (requested == MOTION_FORWARD) {
      setDebugMessage("Command: FORWARD");
      moveForward();

    } else if (requested == MOTION_BACKWARD) {
      setDebugMessage("Command: BACKWARD");
      moveBackward();

    } else if (requested == MOTION_LEFT) {
      setDebugMessage("Command: LEFT");
      turnLeft();

    } else if (requested == MOTION_RIGHT) {
      setDebugMessage("Command: RIGHT");
      turnRight();

    } else {
      setDebugMessage("Command: STOP");
      commandStop();
    }
  }

  httpd_resp_send(req, "", HTTPD_RESP_USE_STRLEN);
  return ESP_OK;
}

bool startCameraServer() {
  httpd_config_t config = HTTPD_DEFAULT_CONFIG();
  config.server_port = 80;
  // The control server registers nine routes.  Leave some headroom for future
  // routes, but do not reserve the default seven client sockets: two HTTP
  // servers plus the Wi-Fi stack can otherwise exhaust the ESP32's socket/file
  // descriptor budget on camera builds.
  config.max_uri_handlers = 12;
  config.max_open_sockets = 4;
  config.lru_purge_enable = true;
  config.recv_wait_timeout = 5;
  config.send_wait_timeout = 5;

  httpd_uri_t index_uri = {
    .uri = "/",
    .method = HTTP_GET,
    .handler = index_handler,
    .user_ctx = NULL
  };

  httpd_uri_t cmd_uri = {
    .uri = "/action",
    .method = HTTP_GET,
    .handler = action_handler,
    .user_ctx = NULL
  };

  httpd_uri_t status_uri = {
    .uri = "/status",
    .method = HTTP_GET,
    .handler = status_handler,
    .user_ctx = NULL
  };

  httpd_uri_t camera_uri = {
    .uri = "/camera",
    .method = HTTP_GET,
    .handler = camera_handler,
    .user_ctx = NULL
  };

  httpd_uri_t wifi_uri = {
    .uri = "/wifi",
    .method = HTTP_GET,
    .handler = wifi_handler,
    .user_ctx = NULL
  };

  httpd_uri_t capture_uri = {
    .uri = "/capture",
    .method = HTTP_GET,
    .handler = capture_handler,
    .user_ctx = NULL
  };

  httpd_uri_t program_get_uri = {
    .uri = "/program",
    .method = HTTP_GET,
    .handler = program_handler,
    .user_ctx = NULL
  };

  httpd_uri_t program_post_uri = {
    .uri = "/program",
    .method = HTTP_POST,
    .handler = program_handler,
    .user_ctx = NULL
  };

  httpd_uri_t update_uri = {
    .uri = "/update",
    .method = HTTP_POST,
    .handler = update_handler,
    .user_ctx = NULL
  };

  httpd_uri_t stream_uri = {
    .uri = "/stream",
    .method = HTTP_GET,
    .handler = stream_handler,
    .user_ctx = NULL
  };

  // Never print "ready" unless the listening socket was actually created.
  // The old code silently ignored httpd_start() failures, which made a dead
  // port 80 look like a browser problem.
  camera_httpd = NULL;
  esp_err_t err = httpd_start(&camera_httpd, &config);
  if (err != ESP_OK) {
    char dbg[128];
    snprintf(
      dbg,
      sizeof(dbg),
      "ERROR: HTTP control server port 80 failed: 0x%x (%s), free heap %u",
      (unsigned int)err,
      esp_err_to_name(err),
      (unsigned int)ESP.getFreeHeap()
    );
    setDebugMessage(dbg);
    return false;
  }

  {
    char dbg[96];
    snprintf(
      dbg,
      sizeof(dbg),
      "HTTP: control server listening on port 80; free heap %u",
      (unsigned int)ESP.getFreeHeap()
    );
    setDebugMessage(dbg);
  }

  bool routesOk = true;

#define REGISTER_CONTROL_URI(uriDef) do {                                      \
    esp_err_t registerErr = httpd_register_uri_handler(camera_httpd, &(uriDef)); \
    if (registerErr != ESP_OK) {                                               \
      char dbg[144];                                                           \
      snprintf(                                                                \
        dbg, sizeof(dbg),                                                      \
        "ERROR: HTTP route %s %s failed: 0x%x (%s)",                         \
        ((uriDef).method == HTTP_POST ? "POST" : "GET"),                   \
        (uriDef).uri,                                                          \
        (unsigned int)registerErr,                                             \
        esp_err_to_name(registerErr)                                           \
      );                                                                       \
      setDebugMessage(dbg);                                                    \
      routesOk = false;                                                        \
    }                                                                          \
  } while (0)

  REGISTER_CONTROL_URI(index_uri);
  REGISTER_CONTROL_URI(cmd_uri);
  REGISTER_CONTROL_URI(status_uri);
  REGISTER_CONTROL_URI(camera_uri);
  REGISTER_CONTROL_URI(wifi_uri);
  REGISTER_CONTROL_URI(capture_uri);
  REGISTER_CONTROL_URI(program_get_uri);
  REGISTER_CONTROL_URI(program_post_uri);
  REGISTER_CONTROL_URI(update_uri);

#undef REGISTER_CONTROL_URI

  if (!routesOk) {
    setDebugMessage("ERROR: One or more HTTP control routes failed to register");
    httpd_stop(camera_httpd);
    camera_httpd = NULL;
    return false;
  }

  // The stream uses a separate server because its handler owns one worker for
  // the entire MJPEG connection.  Keep its socket allowance deliberately
  // small so the control UI remains reachable.
  config.server_port = 81;
  config.ctrl_port += 1;
  config.stack_size = 8192;
  config.max_open_sockets = 2;
  config.max_uri_handlers = 2;
  config.recv_wait_timeout = 5;
  config.send_wait_timeout = 5;

  stream_httpd = NULL;
  err = httpd_start(&stream_httpd, &config);
  if (err != ESP_OK) {
    // Control on port 80 is still useful without live video, so keep it up and
    // report the degraded state rather than making the whole UI unreachable.
    char dbg[128];
    snprintf(
      dbg,
      sizeof(dbg),
      "WARN: HTTP stream server port 81 failed: 0x%x (%s), free heap %u",
      (unsigned int)err,
      esp_err_to_name(err),
      (unsigned int)ESP.getFreeHeap()
    );
    setDebugMessage(dbg);
    return true;
  }

  err = httpd_register_uri_handler(stream_httpd, &stream_uri);
  if (err != ESP_OK) {
    char dbg[120];
    snprintf(
      dbg,
      sizeof(dbg),
      "WARN: HTTP stream route failed: 0x%x (%s)",
      (unsigned int)err,
      esp_err_to_name(err)
    );
    setDebugMessage(dbg);
    httpd_stop(stream_httpd);
    stream_httpd = NULL;
    return true;
  }

  {
    char dbg[96];
    snprintf(
      dbg,
      sizeof(dbg),
      "HTTP: stream server listening on port 81; free heap %u",
      (unsigned int)ESP.getFreeHeap()
    );
    setDebugMessage(dbg);
  }

  return true;
}
